;===================================================================================================
;
;  Copyright (C) 2009-2010, MDS Technology CO., LTD. All Rights Reserved.
; INFORMATION IN THIS CMM IS PROVIDED IN CONNECTION WITH MDS TECHNOLOGY INC. 
; MDS TECHNOLOGY INC. HAS ALL OF RIGHTS ALLOWED LEGALLY. 
; ANY INTELLECTUAL PROPERTY RIGHTS GRANTED BY THIS CMM IS NOT ALLOWED TO DISCLOSE, TRANSMIT, 
; REPRODUCTION WITH ELECTRICALLY OR NON-ELECTRICALLY WITHOUT THE PRIOR WRITTEN CONSENT OF 
; MDS TECHNOLOGY INC. 
; ALL KIND OF CONDUCT IS PROHIBITED THAT INFRINGEMENT RIGHT OF MDS TECHNOLOGY INC.
;
;===================================================================================================
;  MDS Technology Co. Contact Point  : http://www.trace32.com, TRACE32@mdstec.com  
;===================================================================================================
;  Revision History:
;  Author                	Date D/M/Y       Number    Description of Changes
;  -------------------------   ------------    ----------  ----------------------------------------
;  Justin Sung               	Oct-13-11                  ver 0.1
;===================================================================================================
;  Name:
;       target_sysup.cmm
;  Usage:
;       do target_sysup.cmm [cpu]
;===================================================================================================

;===================================================================================================
B::
ENTRY &cpu_mode

IF "&cpu_mode"=="rpm"
(
	SYSTEM.CPU CORTEXM3
	SYSTEM.OPTION ENRESET ON
	SYSTEM.JTAGCLOCK 15.0MHZ 
	SYSTEM.OPTION RESBREAK OFF
	SYSTEM.CONFIG SLAVE OFF
	SYSTEM.CONFIG MEMORYACCESSPORT 3.
	SYSTEM.CONFIG DEBUGACCESSPORT 1. 
	SYSTEM.MEMACCESS DAP
	SYSTEM.CONFIG DAPIRPOST 16.
	SYSTEM.CONFIG DAPDRPOST 2.
	SYSTEM.CONFIG DAPIRPRE 0.
	SYSTEM.CONFIG DAPDRPRE 0.
	SYSTEM.OPTION RESBREAK OFF
	SYSTEM.OPTION WAITRESET 3ms
)
ELSE IF "&cpu_mode"=="krait"
(
	system.res
	PRINT "Single CORE"
	SYSTEM.CPU CORTEXA7
	SYSTEM.CONFIG SLAVE ON
 
	SYSTEM.JTAGCLOCK 15.0MHZ
	SYSTEM.CONFIG.MULTITAP NONE
	SYSTEM.CONFIG.MEMORYACCESSPORT 	0.
	SYSTEM.CONFIG.DEBUGACCESSPORT 	1.
	SYSTEM.CONFIG.JTAGACCESSPORT 	2.
	SYSTEM.OPTION ENRESET OFF
	SYSTEM.OPTION CFLUSH OFF
	SYSTEM.CONFIG.DAPIRPOST 	16.
	SYSTEM.CONFIG.DAPDRPOST 	2.
	SYSTEM.CONFIG.DAPIRPRE 		0.
	SYSTEM.CONFIG.DAPDRPRE 		0.
	SYSTEM.MEMACCESS DAP
	;SYSTEM.CONFIG CTICONFIG		CORTEXV1
	SYSTEM.CONFIG.FUNNELBASE	0X80045000	
	SYSTEM.CONFIG.ETBBASE		0x80022000
	
	SYSTEM.CONFIG COREBASE         	0X80030000 
	SYSTEM.CONFIG ETMBASE          	0X8003C000 
	SYSTEM.CONFIG ETMFUNNELPORT    	0.
	;SYSTEM.CONFIG.CTIBASE		0X80041000
	
	TRONCHIP.SET FIQ OFF 
	TRONCHIP.SET IRQ OFF
	TRONCHIP.SET DABORT OFF 
	TRONCHIP.SET PABORT OFF  
	TRONCHIP.SET UNDEF OFF
	TRONCHIP.SET SWI OFF 
	TRONCHIP.SET RESET OFF
	// Turn off ETM 
	ETM.OFF	
	
	IF OS.FILE("~~\percortexa9mpcore.per")
		per.rp ~~\percortexa9mpcore
)
ELSE IF "&cpu_mode"=="krait_smp"||"&cpu_mode"=="ramdump_android"
(
	system.res
	PRINT "Quad CORE"
	;SYSTEM.CPU krait
    SYSTEM.CPU CORTEXA7MPCORE
	SYSTEM.CONFIG CORENUMBER 4.
	THREAD.ASSIGN 1. 2. 3. 4.

	SYSTEM.CONFIG SLAVE ON
 
	SYSTEM.JTAGCLOCK 15.0MHZ
	SYSTEM.CONFIG.MULTITAP NONE
	SYSTEM.CONFIG.MEMORYACCESSPORT 	0.
	SYSTEM.CONFIG.DEBUGACCESSPORT 	1.
	SYSTEM.CONFIG.JTAGACCESSPORT 	2.
	SYSTEM.OPTION ENRESET OFF
	SYSTEM.OPTION CFLUSH OFF
	SYSTEM.CONFIG.DAPIRPOST 	16.
	SYSTEM.CONFIG.DAPDRPOST 	2.
	SYSTEM.CONFIG.DAPIRPRE 		0.
	SYSTEM.CONFIG.DAPDRPRE 		0.
	
	IF "&cpu_mode"!="ramdump_android"
		SYSTEM.MEMACCESS DAP
	;SYSTEM.CONFIG CTICONFIG		CORTEXV1
	SYSTEM.CONFIG.FUNNELBASE	0X80045000	
	SYSTEM.CONFIG.ETBBASE		0x80022000
	
	SYSTEM.CONFIG COREBASE         	0X80030000 0X80032000 0X80034000 0X80036000
	SYSTEM.CONFIG ETMBASE          	0X8003C000 0X8003D000 0X8003E000 0X8003F000
	SYSTEM.CONFIG ETMFUNNELPORT    	0. 1. 2. 4.
	;SYSTEM.CONFIG.CTIBASE		0X80041000 0X80042000 0X80043000 0X80044000
	
	TRONCHIP.SET FIQ OFF 
	TRONCHIP.SET IRQ OFF
	TRONCHIP.SET DABORT OFF 
	TRONCHIP.SET PABORT OFF  
	TRONCHIP.SET UNDEF OFF
	TRONCHIP.SET SWI OFF 
	TRONCHIP.SET RESET OFF
	// Turn off ETM 
	ETM.OFF	

	IF OS.FILE("~~\percortexa9mpcore.per")
		per.rp ~~\percortexa9mpcore
)
ELSE IF "&cpu_mode"=="krait_smp2"
(
	system.res
	PRINT "Quad CORE"
	;SYSTEM.CPU krait
    SYSTEM.CPU CORTEXA7MPCORE
	SYSTEM.CONFIG CORENUMBER 2.
	THREAD.ASSIGN 1. 2.

	SYSTEM.CONFIG SLAVE ON
 
	SYSTEM.JTAGCLOCK 15.0MHZ
	SYSTEM.CONFIG.MULTITAP NONE
	SYSTEM.CONFIG.MEMORYACCESSPORT 	0.
	SYSTEM.CONFIG.DEBUGACCESSPORT 	1.
	SYSTEM.CONFIG.JTAGACCESSPORT 	2.
	SYSTEM.OPTION ENRESET OFF
	SYSTEM.OPTION CFLUSH OFF
	SYSTEM.CONFIG.DAPIRPOST 	16.
	SYSTEM.CONFIG.DAPDRPOST 	2.
	SYSTEM.CONFIG.DAPIRPRE 		0.
	SYSTEM.CONFIG.DAPDRPRE 		0.
	
	IF "&cpu_mode"!="ramdump_android"
		SYSTEM.MEMACCESS DAP
	;SYSTEM.CONFIG CTICONFIG		CORTEXV1
	SYSTEM.CONFIG.FUNNELBASE	0X80045000	
	SYSTEM.CONFIG.ETBBASE		0x80022000
	
	SYSTEM.CONFIG COREBASE         	0X80030000 0X80032000 
	SYSTEM.CONFIG ETMBASE          	0X8003C000 0X8003D000 
	SYSTEM.CONFIG ETMFUNNELPORT    	0. 1.
	;SYSTEM.CONFIG.CTIBASE		0X80041000 0X80042000 
	
	TRONCHIP.SET FIQ OFF 
	TRONCHIP.SET IRQ OFF
	TRONCHIP.SET DABORT OFF 
	TRONCHIP.SET PABORT OFF  
	TRONCHIP.SET UNDEF OFF
	TRONCHIP.SET SWI OFF 
	TRONCHIP.SET RESET OFF
	// Turn off ETM 
	ETM.OFF	

	IF OS.FILE("~~\percortexa9mpcore.per")
		per.rp ~~\percortexa9mpcore
)
ELSE IF "&cpu_mode"=="q6sw"
(
	SYSTEM.CPU HEXAGONV5 
	SYSTEM.CONFIG SLAVE ON    
	SYSTEM.JTAGCLOCK 15.0MHZ
	SYSTEM.CONFIG.DAPIRPOST 16.
	SYSTEM.CONFIG.DAPDRPOST 2.
	SYSTEM.CONFIG.DAPIRPRE 0.
	SYSTEM.CONFIG.DAPDRPRE 0.
	SYSTEM.CONFIG.MEMORYACCESSPORT 0
	SYSTEM.CONFIG.DEBUGACCESSPORT 1
	SYSTEM.CONFIG.JTAGACCESSPORT 2
	SYSTEM.CONFIG.COREJTAGPORT 0
	
	MMU.TABLEWALK ON
)
ELSE IF "&cpu_mode"=="adsp"
(
	SYSTEM.CPU HEXAGONV5 
	SYSTEM.CONFIG SLAVE ON    
	SYSTEM.JTAGCLOCK 15.0MHZ
	SYSTEM.CONFIG.DAPIRPOST 16.
	SYSTEM.CONFIG.DAPDRPOST 2.
	SYSTEM.CONFIG.DAPIRPRE 0.
	SYSTEM.CONFIG.DAPDRPRE 0.
	SYSTEM.CONFIG.MEMORYACCESSPORT 0
	SYSTEM.CONFIG.DEBUGACCESSPORT 1
	SYSTEM.CONFIG.JTAGACCESSPORT 2
	SYSTEM.CONFIG.COREJTAGPORT 1

	MMU.TABLEWALK ON
)
ELSE IF "&cpu_mode"=="lpass"
(

)
ELSE IF "&cpu_mode"=="dsps"
(

)

ENDDO
;===================================================================================================