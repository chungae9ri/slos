;===================================================================================================
;
;  Copyright (C) 2009-2010, MDS Technology CO., LTD. All Rights Reserved.
; INFORMATION IN THIS CMM IS PROVIDED IN CONNECTION WITH MDS TECHNOLOGY INC. 
; MDS TECHNOLOGY INC. HAS ALL OF RIGHTS ALLOWED LEGALLY. 
; ANY INTELLECTUAL PROPERTY RIGHTS GRANTED BY THIS CMM IS NOT ALLOWED TO DISCLOSE, TRANSMIT, 
; REPRODUCTION WITH ELECTRICALLY OR NON-ELECTRICALLY WITHOUT THE PRIOR WRITTEN CONSENT OF 
; MDS TECHNOLOGY INC. 
; ALL KIND OF CONDUCT IS PROHIBITED THAT INFRINGEMENT RIGHT OF MDS TECHNOLOGY INC.
;
;===================================================================================================
;  MDS Technology Co. Contact Point  : http://www.trace32.com, TRACE32@mdstec.com  
;===================================================================================================
;  Revision History:
;  Author                	Date D/M/Y       Number    Description of Changes
;  -------------------------   ------------    ----------  ----------------------------------------
;  Justin, Sung               	04-09-12                  ver 0.1
;===================================================================================================
;  Name:
;       target.cmm
;  Usage:
;       DO target.cmm
;===================================================================================================

;===================================================================================================
B::
ENTRY &mode

IF (CPUFAMILY()=="ARM")&&(SIMULATOR())
(
	MENU.ReProgram
	(
		ADD
		MENU
		(
			POPUP "Simulator"
			(
				MENUITEM "[=7V4@K@a06VEvDEj3r3Aa@Cx6R7Es5U030]Android Restore Setting"
				(	
					IF "&G_Build_Base"!=os.pwd()
						CHDIR &G_Build_Base
					DODECRYPT "mdstechnology" android_restore_setting_ui.emm dialog
				)				
			)
		)
	)
)
ELSE IF (CPUFAMILY()=="QDSP6")&&(SIMULATOR())
(
	DODECRYPT "mdstechnology" tsp_menu.emm
	MENU.ReProgram
	(
		ADD
		MENU
		(
			POPUP "Simulator"
			(
				MENUITEM "RAMDump Restore(QDSP6 SW)"                                             
				(
					IF "&G_Build_Base"!=os.pwd()
						CHDIR &G_Build_Base
					DODECRYPT "mdstechnology" q6sw_ramdump_setting_ui.emm dialog
				)
				MENUITEM "RAMDump Restore(LPASS)"                                             
				(
					IF "&G_Build_Base"!=os.pwd()
						CHDIR &G_Build_Base
					DODECRYPT "mdstechnology" lpass_ramdump_setting_ui.emm dialog
				)				
			)
		)
	)
)
ELSE IF "&mode"=="krait"
(
	MENU.ReProgram
	(
		ADD
		MENU
		(
			POPUP "Tar&get"
			(
				MENUITEM "Krait - &Attach"
				(
					IF "&G_Build_Base"!=os.pwd()
						CHDIR &G_Build_Base
					sys.d
					DO target_sysup krait
					system.config slave off
					sys.m.a
					IF run()
						break
						
					DO linux_common.cmm KERNEL_LOAD
					DO setup_window.cmm
				)
				
				MENUITEM "Krait SMP2 - &Attach"
				(
					IF "&G_Build_Base"!=os.pwd()
						CHDIR &G_Build_Base
					sys.reset
					DO target_sysup krait_smp2
					system.config slave off
					sys.m.a
					IF run()
						break

					DO linux_common.cmm KERNEL_LOAD
					DO setup_window.cmm
				)

				;SEPARATOR
				;POPUP "Debugging Power Issue"
				;(
				;	MENUITEM "Clock Dump"         	"DO power_issue_debugging.cmm clock_dump"
				;	MENUITEM "GPIO Dump"     	"DO power_issue_debugging.cmm gpio_dump"
				;)
				
				;SEPARATOR
				;MENUITEM "RAM Dump - Krait"
				;(
				;	IF "&G_Build_Base"!=os.pwd()
				;		CHDIR &G_Build_Base
				;		
				;	winclear
				;	area.reset
				;	area
				;	DO std_savelogs_apps.cmm
				;)
			)
		)
	)
)
ELSE IF "&mode"=="q6sw"
(
	MENU.ReProgram
	(
		ADD
		MENU
		(
			POPUP "Tar&get"
			(
				MENUITEM "QDSP6 SW(Attach) - Debug"
				(
					IF "&G_Build_Base"!=os.pwd()
						CHDIR &G_Build_Base
					DO debug_auto_q6sw.cmm q6sw_attach false
				)
			)
		)
		
		ADD
		TOOLBAR
		(
			TOOLITEM "Target Setting..."  		"[=7V4@K@a06VEvDEj3r3Aa@Cx6R7Es5U030]"
			(
				IF "&G_Build_Base"!=os.pwd()
					CHDIR &G_Build_Base			
				DODECRYPT "mdstechnology" global_setting_ui.emm dialog
			)
			TOOLITEM "Reset"  		"[=9Vj@UjDv0t1l$07DRbYmN66jvPvOul$0T0ll04Y0ucFDcdcMnoIyuQQMIEA73073lB0RqqponW$1x0VW1861nEWRDGEkZccvosrjbTLD6TJRzE0V$1tu1jsWwsmzsx$$r$wrjbTLD6pG70E0z7tlWoRB6ollKMIEA7]"
			(
				IF "&G_Build_Base"!=os.pwd()
					CHDIR &G_Build_Base
				DO reset.cmm
			)
			SEPARATOR
		)
	)
)
ELSE IF "&mode"=="adsp"
(
	MENU.ReProgram
	(
		ADD
		MENU
		(
			POPUP "Tar&get"
			(
				MENUITEM "ADSP(Attach) - Debug"
				(
					IF "&G_Build_Base"!=os.pwd()
						CHDIR &G_Build_Base
					DO debug_auto_adsp.cmm adsp_attach false
				)
			)
		)
		
		ADD
		TOOLBAR
		(
			TOOLITEM "Target Setting..."  		"[=7V4@K@a06VEvDEj3r3Aa@Cx6R7Es5U030]"
			(
				IF "&G_Build_Base"!=os.pwd()
					CHDIR &G_Build_Base			
				DODECRYPT "mdstechnology" global_setting_ui.emm dialog
			)
			TOOLITEM "Reset"  		"[=9Vj@UjDv0t1l$07DRbYmN66jvPvOul$0T0ll04Y0ucFDcdcMnoIyuQQMIEA73073lB0RqqponW$1x0VW1861nEWRDGEkZccvosrjbTLD6TJRzE0V$1tu1jsWwsmzsx$$r$wrjbTLD6pG70E0z7tlWoRB6ollKMIEA7]"
			(
				IF "&G_Build_Base"!=os.pwd()
					CHDIR &G_Build_Base
				DO reset.cmm
			)
			SEPARATOR
		)
	)
)
ELSE IF "&mode"=="dsps"
(
	MENU.ReProgram
	(
		ADD
		MENU
		(
			POPUP "Tar&get"
			(
				MENUITEM "ARM7_DSPS - &Attach"
				(
					IF "&G_Build_Base"!=os.pwd()
						CHDIR &G_Build_Base       
				) 

				MENUITEM "ARM7_DSPS - &Load symbols"
				(
					IF "&G_Build_Base"!=os.pwd()
						CHDIR &G_Build_Base
				)			
			)
		)
	)
)
ELSE
(
	IF (CPUFAMILY()=="QDSP6")
	(
		MENU.ReProgram
		(
			ADD
			MENU
			(
				POPUP "Tar&get"
				(
					MENUITEM "QDSP6 SW - Debug"
					(
						IF "&G_Build_Base"!=os.pwd()
							CHDIR &G_Build_Base					
						DO start_powerview.cmm q6sw
						DO debug_auto_q6sw.cmm q6sw_debug false
					)
					
					MENUITEM "QDSP6 SW - Attach"
					(
						IF "&G_Build_Base"!=os.pwd()
							CHDIR &G_Build_Base					
						DO start_powerview.cmm q6sw
						DO debug_auto_q6sw.cmm q6sw_attach false
					)
						
					MENUITEM "Recover F3"
					(
						IF "&G_Build_Base"!=os.pwd()
							CHDIR &G_Build_Base				
		
						IF "&G_Build_Base"!=os.pwd()
							CHDIR &G_Build_Base
						DO start_powerview.cmm q6sw
						DO recover_f3.cmm
					)
				)
			)
			
			ADD
			TOOLBAR
			(
				TOOLITEM "Target Setting..."  		"[=7V4@K@a06VEvDEj3r3Aa@Cx6R7Es5U030]"
				(
					IF "&G_Build_Base"!=os.pwd()
						CHDIR &G_Build_Base			
					DODECRYPT "mdstechnology" global_setting_ui.emm dialog
				)
				TOOLITEM "Reset"  		"[=9Vj@UjDv0t1l$07DRbYmN66jvPvOul$0T0ll04Y0ucFDcdcMnoIyuQQMIEA73073lB0RqqponW$1x0VW1861nEWRDGEkZccvosrjbTLD6TJRzE0V$1tu1jsWwsmzsx$$r$wrjbTLD6pG70E0z7tlWoRB6ollKMIEA7]"
				(
					IF "&G_Build_Base"!=os.pwd()
						CHDIR &G_Build_Base
					DO reset.cmm
				)
				SEPARATOR
			)			
		)		
	)
	ELSE
	(
		MENU.ReProgram
		(
			ADD
			MENU
			(
				POPUP "Tar&get"
				(
					MENUITEM "&EMMC Write (MENU)"
					(
						IF "&G_Build_Base"!=os.pwd()
							CHDIR &G_Build_Base
						DO start_powerview.cmm rpm_krait
						DO debug_auto_rpm.cmm emmc_write_menu false
					)
					
					MENUITEM "&EMMC Erase"
					(
						IF "&G_Build_Base"!=os.pwd()
							CHDIR &G_Build_Base
						DO start_powerview.cmm rpm_krait				
						DO debug_auto_rpm.cmm emmc_erase false
					)				
				
					MENUITEM "EMMC Write (TZ)"
					(
						IF "&G_Build_Base"!=os.pwd()
							CHDIR &G_Build_Base
						DO start_powerview.cmm rpm_krait				
						DO debug_auto_rpm.cmm emmc_write_tz false
					)	

					MENUITEM "EMMC Write (TZ - dir)"
					(
						IF "&G_Build_Base"!=os.pwd()
							CHDIR &G_Build_Base
						DO start_powerview.cmm rpm_krait				
						DO debug_auto_rpm.cmm emmc_write_dir false
					)

					SEPARATOR
					POPUP "RPM"
					(			
						MENUITEM "RPM Debug"
						(
							IF "&G_Build_Base"!=os.pwd()
								CHDIR &G_Build_Base
							DO start_powerview.cmm rpm
							DO debug_auto_rpm.cmm rpm_debug false
						)
					)

					POPUP "Krait"
					(
						MENUITEM "Krait - &Attach"
						(
							IF "&G_Build_Base"!=os.pwd()
								CHDIR &G_Build_Base
							sys.d
							DO target_sysup krait
							system.config slave off
							sys.m.a
							IF run()
								break
								
							DO linux_common.cmm KERNEL_LOAD
							DO setup_window.cmm
						) 

						MENUITEM "Krait SMP - &Attach"
						(
							IF "&G_Build_Base"!=os.pwd()
								CHDIR &G_Build_Base
							sys.reset
							DO target_sysup krait_smp
							system.config slave off
							sys.m.a
							IF run()
								break
								
							DO linux_common.cmm KERNEL_LOAD
							DO setup_window.cmm
						)	
						

						;SEPARATOR
						;POPUP "Debugging Power Issue"
						;(
						;	MENUITEM "Clock Dump"         	"DO power_issue_debugging.cmm clock_dump"
						;	MENUITEM "GPIO Dump"     		"DO power_issue_debugging.cmm gpio_dump"
						;)
						
						;SEPARATOR
						;MENUITEM "RAM Dump - Krait"
						;(
						;	IF "&G_Build_Base"!=os.pwd()
						;		CHDIR &G_Build_Base
						;	winclear
						;	area.reset
						;	area
						;	DO std_savelogs_apps.cmm
						;)				
					)
					
					POPUP "QDSP6 SW"
					(
					)

					POPUP "DSPS"
					(
					)
					
					SEPARATOR
					POPUP "RPM+Krait"
					(
						MENUITEM "RPM + SBL1 Debug"
						(
							IF "&G_Build_Base"!=os.pwd()
								CHDIR &G_Build_Base
							DO debug_auto_rpm.cmm rpm_sbl1_debug false
						)
						
						MENUITEM "RPM + LK(Bootloader) Debug"
						(
							IF "&G_Build_Base"!=os.pwd()
								CHDIR &G_Build_Base
							DO debug_auto_rpm.cmm rpm_lk_debug false
						)				

						MENUITEM "RPM + Kernel Debug"
						(
							IF "&G_Build_Base"!=os.pwd()
								CHDIR &G_Build_Base
							DO debug_auto_rpm.cmm rpm_kernel_debug false

						) 			
					
						MENUITEM "RPM + Kernel SMP2 Debug"
						(
							IF "&G_Build_Base"!=os.pwd()
								CHDIR &G_Build_Base
							DO debug_auto_rpm.cmm rpm_kernelsmp2_debug false
						) 

						MENUITEM "RPM + Kernel SMP4 Debug"
						(
							IF "&G_Build_Base"!=os.pwd()
								CHDIR &G_Build_Base
							DO debug_auto_rpm.cmm rpm_kernelsmp_debug false
						) 				
					)

					POPUP "RPM+QDSP6 SW"
					(
						MENUITEM "RPM + QDSP6 SW Debug"
						(
							IF "&G_Build_Base"!=os.pwd()
								CHDIR &G_Build_Base
							;DO start_powerview.cmm rpm_q6sw
							DO debug_auto_rpm.cmm rpm_q6sw_debug false
						) 				
					)

					POPUP "RPM+Krait+QDSP6 SW"
					(
						MENUITEM "RPM + Kernel SMP + QDSP6 SW Debug"
						(
							IF "&G_Build_Base"!=os.pwd()
								CHDIR &G_Build_Base
							DO debug_auto_rpm.cmm rpm_krait_q6sw_debug false
						) 				
					)

					POPUP "RPM+Krait+ADSP"
					(
						MENUITEM "RPM + Kernel SMP + ADSP Debug"
						(
							IF "&G_Build_Base"!=os.pwd()
								CHDIR &G_Build_Base
							DO debug_auto_rpm.cmm rpm_krait_adsp_debug false
						) 				
					)

					POPUP "RPM+ADSP"
					(
						MENUITEM "RPM + ADSP Debug"
						(
							IF "&G_Build_Base"!=os.pwd()
								CHDIR &G_Build_Base
							;DO start_powerview.cmm rpm_q6sw
							DO debug_auto_rpm.cmm rpm_adsp_debug false
						) 
						MENUITEM "RPM + ADSP Attach"
						(
							IF "&G_Build_Base"!=os.pwd()
								CHDIR &G_Build_Base

							WinClear
							SYStem.Down		; stops debugger target connection
							Break.Delete		; remove any left breakpoints
							synch.reset		; reset synch

							AREA.Reset
							AREA.CREATE DEBUG
							AREA.CREATE LOG

							PATH + &G_MSFolder_Dir/../../../common/tools/cmm/common
							PATH + &G_MSFolder_Dir/../../../common/tools/cmm/rpm

							&RPM_ELF_FileName="&G_MSFolder_Dir/..\..\../rpm_proc\core\bsp\rpm\build\RPM_AAAAANAAR.elf"

							do target_sysup.cmm rpm
							sys.m.a
							
							DO start_powerview.cmm rpm_adsp

							IF (!Y.EXIST(main))
							(
								IF !OS.FILE(&RPM_ELF_FileName)
								(
									PRINT "Select RPM ELF file in browser: "
									DIALOG.FILE &G_MSFolder_Dir/../../../rpm_proc/build/ms\rpm*.elf
									ENTRY &RPM_ELF_FileName
			
									IF "&RPM_ELF_FileName"==""
									(
										PRINT "Failed to select file. Exiting..."
										END
									)	
								) 
		
								Data.Load.ELF &RPM_ELF_FileName /nocode /noclear /strippart "rpm_proc" /sourcepath &G_MSFolder_Dir/..\..\../rpm_proc
							)

							IF RUN()
								BREAK

							DO sync.cmm init
							INTERCOM.EXECUTE &intercom_handle DO debug_auto_adsp.cmm rpm_adsp_attach &isReset

							IF "&G_Setting_Reset"=="true"
								&G_Setting_Reset="false"

							IF !RUN()
								GO
						) 				
					)


					;POPUP "RPM+Krait+DSPS"
					;(
					;	MENUITEM "RPM + Kernel SMP + DSPS Debug"
					;	(
					;		IF "&G_Build_Base"!=os.pwd()
					;			CHDIR &G_Build_Base
					;		DO start_powerview.cmm rpm_krait_dsps
					;		DO debug_auto_rpm.cmm rpm_krait_dsps_debug false
					;	) 				
					;)

					;POPUP "RPM+QDSP6 SW"
					;(
					;	MENUITEM "RPM + QDSP6 SW Debug"
					;	(
					;		IF "&G_Build_Base"!=os.pwd()
					;			CHDIR &G_Build_Base
					;		DO start_powerview.cmm rpm_q6sw
					;		DO debug_auto_rpm.cmm rpm_q6sw_debug false
					;	)				
					;)

					;SEPARATOR
					;MENUITEM "RAM Dump (EBI)" "DO ./std_savelogs.cmm"
				)
			)
			
			ADD
			TOOLBAR
			(
				TOOLITEM "Target Setting..."  		"[=7V4@K@a06VEvDEj3r3Aa@Cx6R7Es5U030]"
				(
					IF "&G_Build_Base"!=os.pwd()
						CHDIR &G_Build_Base			
					DODECRYPT "mdstechnology" global_setting_ui.emm dialog
				)
				TOOLITEM "Reset"  		"[=9Vj@UjDv0t1l$07DRbYmN66jvPvOul$0T0ll04Y0ucFDcdcMnoIyuQQMIEA73073lB0RqqponW$1x0VW1861nEWRDGEkZccvosrjbTLD6TJRzE0V$1tu1jsWwsmzsx$$r$wrjbTLD6pG70E0z7tlWoRB6ollKMIEA7]"
				(
					IF "&G_Build_Base"!=os.pwd()
						CHDIR &G_Build_Base
					DO reset.cmm
				)
				SEPARATOR
			)		
		)
	)
)

PRINT "Target MENU: Ver 2012/04/07 Copyright (c) 2012 by MDS TECHNOLOGY, Incorporated. All Rights Reserved. "
ENDDO
;===================================================================================================