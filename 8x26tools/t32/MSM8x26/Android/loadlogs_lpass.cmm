;===================================================================================================
;
;  Copyright (C) 2009-2010, MDS Technology CO., LTD. All Rights Reserved.
; INFORMATION IN THIS CMM IS PROVIDED IN CONNECTION WITH MDS TECHNOLOGY INC. 
; MDS TECHNOLOGY INC. HAS ALL OF RIGHTS ALLOWED LEGALLY. 
; ANY INTELLECTUAL PROPERTY RIGHTS GRANTED BY THIS CMM IS NOT ALLOWED TO DISCLOSE, TRANSMIT, 
; REPRODUCTION WITH ELECTRICALLY OR NON-ELECTRICALLY WITHOUT THE PRIOR WRITTEN CONSENT OF 
; MDS TECHNOLOGY INC. 
; ALL KIND OF CONDUCT IS PROHIBITED THAT INFRINGEMENT RIGHT OF MDS TECHNOLOGY INC.
;
;===================================================================================================
;  MDS Technology Co. Contact Point  : http://www.trace32.com, TRACE32@mdstec.com  
;===================================================================================================
;  Revision History:
;  Author                	Date D/M/Y       Number    Description of Changes
;  -------------------------   ------------    ----------  ----------------------------------------
;  Justin, Sung               	Mar-09-12                  ver 0.1
;===================================================================================================
;  Name:
;       loadlogs_lpass.cmm
;  Usage:
;       do loadlogs_lpass.cmm
;===================================================================================================

;===================================================================================================
B::
; Placeholder for any filename to be created
LOCAL &FILENAME &SamSung_USB_EBI1CS0_log &USB_RAMDUMPS

&SamSung_USB_EBI1CS0_log="dram_0x80000000--0xbfffffff.lst"

WINCLEAR
AREA.Reset

AREA
 
MAIN:
	;Load the memory map
	if os.file("&G_MSFolder_Dir/../../../common/tools/cmm/common/msm8960/memorymap.cmm")
		do "&G_MSFolder_Dir/../../../common/tools/cmm/common/msm8960/memorymap.cmm"
	else if os.file("&G_MSFolder_Dir/../../../common/tools/cmm/common/std_memorymap.cmm")
		do "&G_MSFolder_Dir/../../../common/tools/cmm/common/std_memorymap.cmm"
	else
		do std_memorymap.cmm  
		
	if ("&G_Ramdump_Dir"=="")
	(
		PRINT "Select one of the RAM Dumps:"
		DIALOG.FILE *.bin
		ENTRY &FILENAME
		
		if "&FILENAME"==""
			ENDDO
		&G_Ramdump_Dir=OS.FILE.PATH(&FILENAME)
		PRINT "RAM Dump Directory : &G_Ramdump_Dir"
	)
	
LOAD_BUILDCONFIG:
	if os.file("&G_MSFolder_Dir/../../modem_proc/core/products/std_buildconfig.cmm")
	(
		PRINT "Loading Modem Build Configuration: &G_MSFolder_Dir/../../modem_proc/core/products/std_buildconfig.cmm"
		DO &G_MSFolder_Dir/../../modem_proc/core/products/std_buildconfig.cmm 
	)
	else
	(
		PRINT "Modem Build Configuration not found: &G_MSFolder_Dir/../../modem_proc/core/products/std_buildconfig.cmm"
		do std_buildconfig.cmm
	)

CHECK_FOR_RAMDUMPS:
	&FILENAME="&G_Ramdump_Dir/"+"&LPASS_NONHLOS_log"
	if os.file("&FILENAME")
	(
		&USB_RAMDUMPS=0
		GOTO SETUPSIM
	)
	else
	(
		&USB_RAMDUMPS=1
		GOTO SETUPSIM
	)
	
; Set the simulator up for the target
SETUPSIM:
	; Initialize the system for HEXAGONV4L subsystem
	SYSTEM.RESET
   	PRINT "Initializing Q6LPASS Subsystem: HEXAGONV4L"
        SYSTEM.CPU HEXAGONV4L
        SYSTEM.UP
 
	if (&USB_RAMDUMPS==0)
		GOTO T32LOG
	else
		GOTO USBLOG

; Load the logs collected using JTAG	
T32LOG:
	&FILENAME="&G_Ramdump_Dir/"+"&LPASS_NONHLOS_log"
	if OS.FILE("&FILENAME")
	(		
		// Load Q6LPASS memory section
		GOSUB LOADMEM &LPASS_NONHLOS_start_addr &LPASS_NONHLOS_size &LPASS_NONHLOS_log &SMEM_offset
	)
	else
	(
		PRINT "No RAM Dumps found in &G_Ramdump_Dir"
		GOTO EXIT
	)

; Load the logs collected using USB
USBLOG:
	&FILENAME="&G_Ramdump_Dir/"+"&USB_EBI1CS0_log"
	&LOAD_FILE="&G_Ramdump_Dir/"+"load.cmm"
	if OS.FILE("&FILENAME")
	(

		// Load shared memory section
		GOSUB LOADMEM &SMEM_start_addr &SMEM_size &USB_EBI1CS0_log &SMEM_offset
		
		// Load RAM EFS section
		GOSUB LOADMEM 0x8FB00000 0x300000 &USB_EBI1CS0_log 0xFB00000

		// Load Q6LPASS memory section
		GOSUB LOADMEM &LPASS_NONHLOS_start_addr &LPASS_NONHLOS_size &USB_EBI1CS0_log &MODEMSW_offset
	)
	
	&FILENAME="&G_Ramdump_Dir/"+"&SamSung_USB_EBI1CS0_log"
	if os.file("&FILENAME")
	(
		// Load shared memory section
		GOSUB LOADMEM &SMEM_start_addr &SMEM_size &SamSung_USB_EBI1CS0_log &SMEM_offset
		
		// Load RAM EFS section
		GOSUB LOADMEM 0x8FB00000 0x300000 &SamSung_USB_EBI1CS0_log 0xFB00000

		// Load Q6LPASS memory section
		GOSUB LOADMEM &LPASS_NONHLOS_start_addr &LPASS_NONHLOS_size &SamSung_USB_EBI1CS0_log &MODEMSW_offset
	)
	else if os.file(&LOAD_FILE)
	(
	   cd.do &LOAD_FILE
	   cd &G_Build_Base
	)
	else
	(
		PRINT "No RAM Dumps found in &G_Ramdump_Dir"
		GOTO EXIT
	)

;;;; Restore MMU Settings	
;;;RESTOREMMU: 
;;;	; Configure the MMU
;;;	&QUBE_VA=0x89000000
;;;	&QUBE_PA=0x89000000

;;;	SYSTEM.OPTION PC &QUBE_PA
;;;	MMU.MAP.SCAN 
;;;	MMU.CREATE (&QUBE_VA)--(&QUBE_VA+0xffffff) (&QUBE_PA)--(&QUBE_PA+0xffffff)
;;;	STEP


; Load the symbols
LOADSYMS:
	IF OS.FILE("&G_MSFolder_Dir/../../../lpass_proc")
	(
		cd "&G_MSFolder_Dir/../../../lpass_proc"
		do qdsp6/scripts/DSP_connectV4.cmm &LPASS_NONHLOS_start_addr
		cd &G_Build_Base
	)
	else
	(
		do DSP_connectV4.cmm &LPASS_NONHLOS_start_addr
	)
	
; Restore registers 
RESTOREREGS:
	if (&USB_RAMDUMPS==1)
	(
		if (OS.FILE("&G_MSFolder_Dir/../../lpass_proc/qurt\install\8960\scripts\analy_qurt_error.cmm"))
		(
			DO &G_MSFolder_Dir/../../lpass_proc/qurt\install\8960\scripts\analy_qurt_error.cmm
			PRINT %CONTINUE "Complete"
		)
		else
		(
			do analy_qurt_error.cmm
			PRINT %CONTINUE "Complete"
		)

	)
	
	IF OS.DIR("&G_MSFolder_Dir/../../../lpass_proc")
		y.spath.srd += "&G_MSFolder_Dir/../../../lpass_proc"

	cd &G_Build_Base
	do setup_window.cmm
	PRINT "Loading RAM Dump Binaries: Complete."
	GOTO EXIT

; Exit the program
EXIT:
	ENDDO
	
; Function: LOADMEM
; Load a section of memory specified by start address and size
;
; Takes 3 arguments as inputs: Start Address, Size of memory space to load, Input Filename	
LOADMEM:
	ENTRY &1 &2 &3 &4
	LOCAL &START_ADDR
	LOCAL &SIZE
	LOCAL &LOG
	LOCAL &OFFSET
  
	&START_ADDR="&1"
	&SIZE="&2"
	&LOG="&G_Ramdump_Dir/"+"&3"
	&OFFSET="&4"


	DATA.LOAD.BINARY "&LOG" &START_ADDR++&SIZE /LONG /SKIP &4 
	PRINT %CONTINUE " &LOG LOADED."
	RETURN 
;===================================================================================================