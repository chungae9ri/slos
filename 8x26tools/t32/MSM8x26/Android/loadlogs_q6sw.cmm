;===================================================================================================
;
;  Copyright (C) 2009-2010, MDS Technology CO., LTD. All Rights Reserved.
; INFORMATION IN THIS CMM IS PROVIDED IN CONNECTION WITH MDS TECHNOLOGY INC. 
; MDS TECHNOLOGY INC. HAS ALL OF RIGHTS ALLOWED LEGALLY. 
; ANY INTELLECTUAL PROPERTY RIGHTS GRANTED BY THIS CMM IS NOT ALLOWED TO DISCLOSE, TRANSMIT, 
; REPRODUCTION WITH ELECTRICALLY OR NON-ELECTRICALLY WITHOUT THE PRIOR WRITTEN CONSENT OF 
; MDS TECHNOLOGY INC. 
; ALL KIND OF CONDUCT IS PROHIBITED THAT INFRINGEMENT RIGHT OF MDS TECHNOLOGY INC.
;
;===================================================================================================
;  MDS Technology Co. Contact Point  : http://www.trace32.com, TRACE32@mdstec.com  
;===================================================================================================
;  Revision History:
;  Author                	Date D/M/Y       Number    Description of Changes
;  -------------------------   ------------    ----------  ----------------------------------------
;  Justin, Sung               	Jan-09-12                  ver 0.1
;===================================================================================================
;  Name:
;       loadlogs_modem.cmm
;  Usage:
;       do loadlogs_modem.cmm
;===================================================================================================

;===================================================================================================
B::
; Placeholder for any filename to be created
LOCAL &FILENAME &SamSung_USB_EBI1CS0_log &USB_RAMDUMPS

&SamSung_USB_EBI1CS0_log="dram_0x80000000--0xbfffffff.lst"

WINCLEAR
AREA.Reset

AREA

MAIN:
	&LOGTYPE="USB"
	&BUILD="&ARG2"
	&LOGLOCATION="&G_Ramdump_Dir"

	// Load the memory map
	do std_memorymap

	// Setup the environment
	do std_setupenv

	// First, all the sanity checks
	GOSUB CHECKBINARIES
	
	// Binaries look good. Else, we wouldn't be here	
	GOSUB SETUPSIM
	
	// Load the binaries
	GOSUB LOADBIN

	// Load the symbols
	do std_loadsyms_mpss &BUILD

	// Load the "state" at the time of the crash
	GOSUB RESTORESTATE

	// Off you go..
	GOTO EXIT

// Set the simulator for the processor we want
SETUPSIM:
	SYS.CPU HEXAGONV4
	SYS.UP
	
	// Other configuration options
	FRAME.CONFIG.EPILOG OFF

	RETURN

// Checks if the binaries for the system are present in the location
// Loglocation should not be empty and assumes memory map is loaded
CHECKBINARIES:
LOCAL &FILE1 &FILE2 &LOGCLASS


	// This is the best place to determine the type of the log too
	IF ("&LOGTYPE"=="AUTODETECT")
	(
	    &LOGCLASS="&LOGTYPE"
		
		// Check for JTAG logs
		do std_utils FILEXIST EXIT &LOGLOCATION &MPSS_SW_log
		ENTRY &FILE1

	    IF ("&FILE1"=="TRUE")
		(
		     &LOGCLASS="JTAG"
	    )
	
		// Check for USB logs
		do std_utils FILEXIST EXIT &LOGLOCATION &DDR_1_USB_log
		ENTRY &FILE1

		IF ("&FILE1"=="TRUE")
		(
			&LOGCLASS="USB"
		)

		// Repeat the same check for USB files
		// If we even after that, we are stuck with "AUTODETECT" we have a problem
		IF ("&LOGCLASS"=="AUTODETECT")
		(
		    PRINT %ERROR "Neither USB nor JTAG logs present in folder: &LOGLOCATION"
		    GOTO FATALEXIT
		)
		ELSE
		(
		    // Safe to change the logtype
			&LOGTYPE="&LOGCLASS"
			PRINT "Detected &LOGTYPE logs in folder: &LOGLOCATION"
		)
	)

	IF ("&LOGTYPE"=="JTAG")
	(
		
		// Check for JTAG logs
		do std_utils FILEXIST EXIT &LOGLOCATION &MPSS_SW_log
		ENTRY &FILE1

	    IF ("&FILE1"=="FALSE")
		(
			PRINT %ERROR "JTAG logs not present in folder: &LOGLOCATION"
			GOTO FATALEXIT
	    )
	)

	IF ("&LOGTYPE"=="USB")
	(
		
		// Check for USB logs
		do std_utils FILEXIST EXIT &LOGLOCATION &DDR_1_USB_log
		ENTRY &FILE1

	    IF ("&FILE1"=="FALSE")
		(
			PRINT %ERROR "USB logs not present in folder: &LOGLOCATION"
			GOTO FATALEXIT
	    )
	)

	    		
	RETURN


// Function :LOADBIN
// Loads the saved binaries
LOADBIN:
	// Check the type of the log and load it
	IF ("&LOGTYPE"=="JTAG")
	(
		do std_utils LOADBIN &LOGLOCATION &MPSS_SW_log &MPSS_SW_start
	)
	
	IF ("&LOGTYPE"=="USB")
	(
		do std_utils LOADBIN &LOGLOCATION &DDR_1_USB_log &DDR_1_start
	)

	RETURN

// Function: RESTORESTATE
// To load the error information from the saved logs
RESTORESTATE:
	// Restore the registers from file if JTAG logs
	IF ("&LOGTYPE"=="JTAG")
	(
	    THREAD 0
	 	do std_utils EXECUTESCRIPT EXIT &LOGLOCATION/&MPSS_Thread0_regs
		THREAD 1
		do std_utils EXECUTESCRIPT EXIT &LOGLOCATION/&MPSS_Thread1_regs
		THREAD 2
		do std_utils EXECUTESCRIPT EXIT &LOGLOCATION/&MPSS_Thread2_regs
	)

	// Symbols should be loaded prior to this step
	IF ("&LOGTYPE"=="USB")
	(
		IF OS.FILE("&MPSS_SCRIPTSDIR/../debugtools/err/cmm/load_coredump.cmm")
			do std_utils EXECUTESCRIPT EXIT &MPSS_SCRIPTSDIR/../debugtools/err/cmm/load_coredump.cmm
		ELSE
			do std_utils EXECUTESCRIPT EXIT load_coredump.cmm
	)

	// Restore saved TCM
	IF (Y.EXIST(qurt_tcm_dump))
	(
		DATA.COPY V.RANGE(qurt_tcm_dump) A:&MPSS_TCM_start
	)
	
	// Restore TLB state
	IF (Y.EXIST(QURTK_tlb_dump))
	(
		&tlb_idx=0
		// 128 entries in the TLB for QDSP6V5A,H,128_A
		REPEAT 128
		(
 			&val0=V.VALUE(((unsigned int *)&QURTK_tlb_dump)[2*&tlb_idx])
			&val1=V.VALUE(((unsigned int *)&QURTK_tlb_dump)[2*&tlb_idx+1])
			MMU.SET TLB &tlb_idx &val0 &val1
			&tlb_idx=&tlb_idx+1
		)
	)

	// Enable MMU
	MMU.ON
	MMU.TLB.SCAN
	

	RETURN

FATALEXIT:
	END

EXIT:
	ENDDO
;===================================================================================================