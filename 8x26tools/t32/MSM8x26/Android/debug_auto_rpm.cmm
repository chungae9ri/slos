;===================================================================================================
;
;  Copyright (C) 2009-2010, MDS Technology CO., LTD. All Rights Reserved.
; INFORMATION IN THIS CMM IS PROVIDED IN CONNECTION WITH MDS TECHNOLOGY INC. 
; MDS TECHNOLOGY INC. HAS ALL OF RIGHTS ALLOWED LEGALLY. 
; ANY INTELLECTUAL PROPERTY RIGHTS GRANTED BY THIS CMM IS NOT ALLOWED TO DISCLOSE, TRANSMIT, 
; REPRODUCTION WITH ELECTRICALLY OR NON-ELECTRICALLY WITHOUT THE PRIOR WRITTEN CONSENT OF 
; MDS TECHNOLOGY INC. 
; ALL KIND OF CONDUCT IS PROHIBITED THAT INFRINGEMENT RIGHT OF MDS TECHNOLOGY INC.
;
;===================================================================================================
;  MDS Technology Co. Contact Point  : http://www.trace32.com, TRACE32@mdstec.com  
;===================================================================================================
;  Revision History:
;  Author                	Date D/M/Y       Number    Description of Changes
;  -------------------------   ------------    ----------  ----------------------------------------
;  Justin Sung 		 	11-Nov-10		   ver 0.1 
;===================================================================================================
;  Name:
;        debug_auto_rpm.cmm
;  Usage:
;       DO debug_auto_rpm.cmm
;===================================================================================================

;===================================================================================================
B::
ENTRY &mode &isReset
LOCAL &RPM_ELF_FileName &isRPM
LOCAL &DLOAD_COOKIE1_ADDR &DLOAD_COOKIE2_ADDR
GLOBAL &LK_COOKIE_MODE

WinClear
SYStem.Down		; stops debugger target connection
TASK.RESet		; reset Linux awareness
Break.Delete		; remove any left breakpoints
MAP.RESet		; reset debugger¡¯s memory mapping
MMU.RESet		; reset debugger¡¯s MMU
SYStem.RESet		; reset debugger¡¯s system settings 
synch.reset		; reset synch
task.reset		; reset awareness

AREA.Reset
AREA.CREATE DEBUG
AREA.CREATE LOG

PATH + &G_MSFolder_Dir/../../../common/tools/cmm/common
PATH + &G_MSFolder_Dir/../../../common/tools/cmm/rpm

; Add LK source ( Debug_Cookie_Enable)
LOCAL &LK_COOKIE_MODE
&LK_COOKIE_MODE="no"

&G_Reset_Mode="&mode"	; reset mode
;&RPM_ELF_FileName="&G_MSFolder_Dir/..\..\../rpm_proc\core\bsp\rpm\build\RPM_&G_BuildID.elf"
&RPM_ELF_FileName="&G_MSFolder_Dir/..\..\../rpm_proc\core\bsp\rpm\build\RPM_AAAAANAAR.elf"
&isRPM="no"

DO target_sysup.cmm rpm

LOCAL &count
&count=90
ON ERROR GOSUB
(
	&count=&count-1
	IF (&count>0)
		GOTO START
	ELSE
		ENDDO
)
START:
	SYS.U
ON ERROR NOTHING

DO std_memorymap.cmm

// MSM8974 v1 has a hardware bug. The security control block is not reset
// properly. To workaround it, turn on the sleep clock to the block and reset
// the block manually. This should return it to the golden state.
// Load HWIO
do hwio

// Find version of the chipset
do std_platinfo

// Clear the Boot Partition Select Register and Watchdog debug for all revs
do std_utils HWIO_OUT BOOT_PARTITION_SELECT 0x0
do std_utils HWIO_OUT GCC_WDOG_DEBUG 0x0

IF (&CHIPSET_SPIN<4)
(
	do std_utils HWIO_OUT GCC_GCC_IM_SLEEP_CBCR 0x1
	do std_utils HWIO_OUT GCC_SEC_CTRL_BCR 0x1
	do std_utils HWIO_OUT GCC_SEC_CTRL_BCR 0x0
	// We need to go to the end of the RPM boot rom to be able to properly reset the system
	// We CANNOT use std_debug here because it could be a recursive call
	GO 0x2F94A /ONCHIP

	WAIT !RUN()
	// DLOAD cookies in MSGRAM
	&DLOAD_COOKIE1_ADDR=0xFC42B000
	&DLOAD_COOKIE2_ADDR=0xFC42B004

	// Enable RPM Message RAM clock
	do std_utils HWIO_OUTF GCC_APCS_CLOCK_BRANCH_ENA_VOTE MSG_RAM_AHB_CLK_ENA 0x1
	// Enable IMEM AXI clock
	do std_utils HWIO_OUTF GCC_IMEM_AXI_CBCR CLK_ENABLE 0x1
	do std_utils HWIO_OUTF GCC_IMEM_CFG_AHB_CBCR CLK_ENABLE 0x1
)
ELSE
(
	GO 0x2F9C8 /ONCHIP

	WAIT !RUN()

	// DLOAD Cookies in OCIMEM
	&DLOAD_COOKIE1_ADDR=0xFE805000
	&DLOAD_COOKIE2_ADDR=0xFE805004
	 		
	// Enable IMEM clock branches
	do std_utils HWIO_OUTF GCC_IMEM_CFG_AHB_CBCR CLK_ENABLE 0x1
)

// Now clear the cookies
DATA.SET EAHB:&DLOAD_COOKIE1_ADDR %LE %LONG 0x0
DATA.SET EAHB:&DLOAD_COOKIE2_ADDR %LE %LONG 0x0

;-----------------------------------------------------------------------------------------------
IF "&mode"=="emmc_write_menu"||"&mode"=="emmc_erase"||"&mode"=="emmc_write_tz"||"&mode"=="emmc_write_dir"
(
	// Stop just before apps is out of reset
	// Change the reset address to start of some onchip memory
	// We use start of RPM Data RAM here
;	do std_utils HWIO_OUT APCS_START_ADDR 0xFC190000

	WAIT 20ms
;	WHILE (RUN())
;	(
;	)

	// Put an infinite loop
;	D.S A:0x190000 %LONG 0xEAFFFFFE
	GO

	DO start_powerview.cmm rpm_krait
	DO sync.cmm init
	INTERCOM.EXECUTE &intercom_handle DO target_flash_emmc.cmm &mode

	IF !RUN()
		GO
	ENDDO
)
ELSE IF "&mode"=="rpm_debug" 
(
	IF (!Y.EXIST(main))
	(
		IF !OS.FILE(&RPM_ELF_FileName)
		(
			PRINT "Select RPM ELF file in browser: "
			DIALOG.FILE &G_MSFolder_Dir/../../../rpm_proc/build/ms\rpm*.elf
			ENTRY &RPM_ELF_FileName
			
			IF "&RPM_ELF_FileName"==""
			(
				PRINT "Failed to select file. Exiting..."
				END
			)	
		) 
		
		Data.Load.ELF &RPM_ELF_FileName /nocode /noclear /strippart "rpm_proc" /sourcepath &G_MSFolder_Dir/..\..\../rpm_proc
	)
	B.S main /onchip
	GO
)
ELSE IF "&mode"=="rpm_q6sw_debug"
(
	DO start_powerview.cmm rpm_q6sw

	IF (!Y.EXIST(main))
	(
		IF !OS.FILE(&RPM_ELF_FileName)
		(
			PRINT "Select RPM ELF file in browser: "
			DIALOG.FILE &G_MSFolder_Dir/../../../rpm_proc/build/ms\rpm*.elf
			ENTRY &RPM_ELF_FileName
			
			IF "&RPM_ELF_FileName"==""
			(
				PRINT "Failed to select file. Exiting..."
				END
			)	
		) 
		
		Data.Load.ELF &RPM_ELF_FileName /nocode /noclear /strippart "rpm_proc" /sourcepath &G_MSFolder_Dir/..\..\../rpm_proc
	)
	b.s main /onchip
	go 
	wait !run()

	if run()
		break
	D.S EA:0xFE805934 %LONG %LE 0x53444247

	IF "&G_Setting_Reset"=="true"
		&G_Setting_Reset="false"

	IF !RUN()
		GO

	// Enable the CFG bus clock for the reset reg access
	// Now poll until modem is brought out of reset
	&VALUE=0x0
	WHILE (&VALUE==0x0)
	(
		do std_utils HWIO_INF GCC_MSS_CFG_AHB_CBCR CLK_ENABLE
		ENTRY &VALUE
	)

	DO sync.cmm init
	INTERCOM.EXECUTE &intercom_handle DO debug_auto_q6sw.cmm &mode &isReset
)
ELSE IF "&mode"=="rpm_adsp_debug"
(
	DO start_powerview.cmm rpm_adsp

	IF (!Y.EXIST(main))
	(
		IF !OS.FILE(&RPM_ELF_FileName)
		(
			PRINT "Select RPM ELF file in browser: "
			DIALOG.FILE &G_MSFolder_Dir/../../../rpm_proc/build/ms\rpm*.elf
			ENTRY &RPM_ELF_FileName
			
			IF "&RPM_ELF_FileName"==""
			(
				PRINT "Failed to select file. Exiting..."
				END
			)	
		) 
		
		Data.Load.ELF &RPM_ELF_FileName /nocode /noclear /strippart "rpm_proc" /sourcepath &G_MSFolder_Dir/..\..\../rpm_proc
	)
	B.S main /onchip
	GO
	WAIT !RUN()

	IF RUN()
		BREAK
		
	;D.S EA:0xFE80593C %LONG %LE 0x53444247
	D.S EAHB:&ADSP_DEBUG_COOKIE %LONG %LE &DEBUG_COOKIE_VALUE

	go
	;wait 20.s

	;do std_utils HWIO_OUTF LPASS_QDSP6SS_CGC_OVERRIDE CORE_RCLK_EN 0x1
	;do std_utils HWIO_OUTF LPASS_QDSP6SS_CGC_OVERRIDE CORE_CLK_EN 0x1

	DO sync.cmm init
	INTERCOM.EXECUTE &intercom_handle DO debug_auto_adsp.cmm &mode &isReset

	IF "&G_Setting_Reset"=="true"
		&G_Setting_Reset="false"

	IF !RUN()
		GO
)
ELSE 
(
	IF (!Y.EXIST(main))
	(
		IF !OS.FILE(&RPM_ELF_FileName)
		(
			PRINT "Select RPM ELF file in browser: "
			DIALOG.FILE &G_MSFolder_Dir/../../../rpm_proc/build/ms\rpm*.elf
			ENTRY &RPM_ELF_FileName
			
			IF "&RPM_ELF_FileName"==""
			(
				PRINT "Failed to select file. Exiting..."
				END
			)	
		) 
		
		Data.Load.ELF &RPM_ELF_FileName /nocode /noclear /strippart "rpm_proc" /sourcepath &G_MSFolder_Dir/..\..\../rpm_proc
	)
	; for some target no boot
	;B.S main /onchip
	;GO
	;WAIT !RUN()

	IF "&G_Reset_Mode"=="rpm_sbl1_debug"
	(
		DATA.SET EAHB:&SBL1_DEBUG_COOKIE %LONG %LE &DEBUG_COOKIE_VALUE

		; by justin
		;D.S EAHB:&APPSBOOT_DEBUG_COOKIE %LONG &DEBUG_COOKIE_VALUE
		;GO
		;WAIT 1.s
	)
	ELSE "&G_Reset_Mode"=="rpm_lk_debug"
	(
		IF "&LK_COOKIE_MODE"=="yes"
		(
			D.S EAHB:&APPSBOOT_DEBUG_COOKIE %LONG &DEBUG_COOKIE_VALUE
			go
			wait 1500.ms
			break
		)
		ELSE
		(
			DATA.SET EAHB:&SBL1_DEBUG_COOKIE %LONG %LE &DEBUG_COOKIE_VALUE
			;GO
			;wait 1.s
			;wait 10.0ms
			;break
			;DO std_exitfastdebug sbl1
			;wait 1300.ms
		)
		;GO
	)
	ELSE
	(
		IF "&LK_COOKIE_MODE"=="yes"
		(
			D.S EAHB:&APPSBOOT_DEBUG_COOKIE %LONG &DEBUG_COOKIE_VALUE
			GO
			wait 1500.ms
		)
		ELSE
		(
			DATA.SET EAHB:&SBL1_DEBUG_COOKIE %LONG %LE &DEBUG_COOKIE_VALUE
			;GO
			;wait 4.s
			;break
			D.S EAHB:&APPSBOOT_DEBUG_COOKIE %LONG &DEBUG_COOKIE_VALUE
			wait 2000.ms
			DO std_exitfastdebug sbl1
			GO
		)
	)

	DO start_powerview.cmm rpm_krait
	DO sync.cmm init
	INTERCOM.EXECUTE &intercom_handle DO debug_auto_ap.cmm &mode &isReset &G_Setting_Reset &isRPM
	
	IF "&G_Setting_Reset"=="true"
		&G_Setting_Reset="false"

	IF !RUN()
		GO
)

IF "&isReset"=="true"
(
	DO my_rpm_setup_window.cmm
	DO my_rpm_break.cmm
)
ELSE
(
	DO setup_window.cmm
)

PRINT " Well done.. " clock.time()

IF Y.EXIST(set_be_gentle)
	DO rpm_sleep_disable.cmm
ENDDO
;===================================================================================================