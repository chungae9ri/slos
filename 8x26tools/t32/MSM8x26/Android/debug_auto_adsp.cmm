;===================================================================================================
;
;  Copyright (C) 2009-2010, MDS Technology CO., LTD. All Rights Reserved.
; INFORMATION IN THIS CMM IS PROVIDED IN CONNECTION WITH MDS TECHNOLOGY INC. 
; MDS TECHNOLOGY INC. HAS ALL OF RIGHTS ALLOWED LEGALLY. 
; ANY INTELLECTUAL PROPERTY RIGHTS GRANTED BY THIS CMM IS NOT ALLOWED TO DISCLOSE, TRANSMIT, 
; REPRODUCTION WITH ELECTRICALLY OR NON-ELECTRICALLY WITHOUT THE PRIOR WRITTEN CONSENT OF 
; MDS TECHNOLOGY INC. 
; ALL KIND OF CONDUCT IS PROHIBITED THAT INFRINGEMENT RIGHT OF MDS TECHNOLOGY INC.
;
;===================================================================================================
;  MDS Technology Co. Contact Point  : http://www.trace32.com, TRACE32@mdstec.com  
;===================================================================================================
;  Revision History:
;  Author                	Date D/M/Y       Number    Description of Changes
;  -------------------------   ------------    ----------  ----------------------------------------
;  Justin Sung 		 	Oct-14-11		   Ver 0.1
;===================================================================================================
;  Name:
;        debug_auto_q6sw.cmm
;  Usage:
;       do debug_auto_q6sw.cmm
;===================================================================================================

;===================================================================================================
B::
ENTRY &qdsp6_mode &isReset
GLOBAL &G_Q6SW_ELF_FileName

WinClear
SYStem.Down		; stops debugger target connection
TASK.RESet		; reset Linux awareness
Break.Delete		; remove any left breakpoints
MAP.RESet		; reset debugger’s memory mapping
MMU.RESet		; reset debugger’s MMU
SYStem.RESet		; reset debugger’s system settings 
task.reset		; reset awareness

area.reset
area

PATH + &G_MSFolder_Dir/../../../common/tools/cmm/common
PATH + &G_MSFolder_Dir/../../../common/tools/cmm/common/msm8974
PATH + &G_MSFolder_Dir/../../../common/tools/cmm/adsp/msm8974

;do target.cmm q6sw
do target_sysup.cmm adsp

IF ("&qdsp6_mode"=="adsp_debug")||("&qdsp6_mode"=="adsp_attach")
	SYStem.CONFIG SLAVE OFF

;wait 20.s

LOCAL &count
&count=90
ON ERROR GOSUB
(
	&count=&count-1
	if (&count>0)
		GOTO START
	ELSE
		ENDDO
)
START:
	wait 30.ms
	sys.m.a
ON ERROR NOTHING

if run()
	break

do hwio.cmm

DO std_memorymap.cmm


;------------------------------------------------------------------------------
; Reset debugger state
;------------------------------------------------------------------------------
;Move this to end to prevent unhandled stuff exceptions
;do std_setupenv quiet

Break.Delete
Symbol.AsmFrame on
Symbol.CutLine
Symbol.case off

mmu.off
mmu.delete
MAP.RESET

;This will prevent stuff exceptions when the stack isn't fully initialized
;map.denyaccess 0xFFFFFF00++0xFF

;system.option.icflush OFF
system.option.dcfreeze OFF 

break.select.program soft

;Park PC before we attach
&Qube_va=0x89000000
&Qube_pa=0x89000000

;system.option PC &Qube_pa

if "&qdsp6_mode"!="rpm_adsp_attach"
(
	DATA.SET EAHB:&ADSP_DEBUG_COOKIE %LONG %LE 0x00000000
)

;------------------------------------------------------------------------------
; Load symbols and OS awareness
;------------------------------------------------------------------------------

if (!y.exist(start))
(
	&G_Q6SW_ELF_FileName="&G_MSFolder_Dir/../../../adsp_proc/build/ms/M8974AAAAAAAAQ1234.elf"
  
	if !os.file(&G_Q6SW_ELF_FileName)
	(
		print "Select MODEMSW ELF file in browser: "
		dialog.file &G_MSFolder_Dir/../../../adsp_proc/build/ms\*.elf
		entry &G_Q6SW_ELF_FileName
		
		if "&G_Q6SW_ELF_FileName"==""
		(
			print "Failed to select file. Exiting..."
			END
		)	
	) 
	
	print "Loading Modem elf file..."
	data.load.elf &G_Q6SW_ELF_FileName /nocode /noclear /strippart "adsp_proc" /strippart "02.04.02"
;	d.load.elf &G_MSFolder_Dir/../../../adsp_proc/build/ms/M8974AAAAAAAAQ1234_SENSOR_reloc.elf /nocode /noclear
	;d.load.elf &G_MSFolder_Dir/../../../adsp_proc/build/ms/ADSP_PROC_IMG_AAAAAAAAQ.elf /nocode /noclear
	symbol.sourcepath &G_MSFolder_Dir/../../../adsp_proc
	;symbol.sourcepath + &G_MSFolder_Dir/../../../adsp_proc/core/kernel/blast
	
	// ?? ??? ??? ???? ?? path? ?????.
	y.spath.t "/home001/wonjae.choi/msm8974_jb/non_HLOS/adsp_proc/" "U:\msm8974_jb\non_HLOS\adsp_proc\"
)

// Setup MMU
;GOSUB SETUPMMU

; QuRT Awareness
task.config qurt.t32
menu.rp qurt.men

if "&qdsp6_mode"!="rpm_adsp_attach"
(
	b.s main /onchip
	go
	wait !run()
)

;------------------------------------------------------------------------------
; Run over MMU initialization
;------------------------------------------------------------------------------
;TODO - convert pc to nearest symbol name, if it is not near
;cold_boot_only_start, then do not execute this code
if (string.scan(y.name(P:r(pc)),".cold_boot_only_start",0)!=-1)
(
	; MMU is not on yet, use an onchip
	Break.Set main /P /Onchip
	Step
	Go
	print "Waiting main function..."
	wait !run()
	Break.Delete main
)

;------------------------------------------------------------------------------
; Disable power collapse and other features to make debugging easier
;------------------------------------------------------------------------------
;pwr collapse

print ""
print "***********************************************************************"
print "*                   Disabling Q6SW and Q6FW Sleep!                    *"
print "*                                                                     *"
print "*           To enable q6sw sleep run:                                 *"
print "*                  v sleep_allow_low_power_modes=1                    *" 
print "*                                                                     *"
print "*           To enable q6fw sleep run:                                 *"
print "*                  v mcpm_ops.mcpm_saw_fwq6_sleep_allow_chk=1         *" 						
print "*                  v mcpm_ops.mcpm_saw_fw_sleep_enable=1              *"
print "***********************************************************************"
print ""

v sleep_allow_low_power_modes=0x0
;v mcpm_ops.mcpm_saw_fwq6_sleep_allow_chk=0
;v mcpm_ops.mcpm_saw_fw_sleep_enable=0

;by MDS
;&sleep_addr=address.offset(sleep_allow_low_power_modes)
;d.s &sleep_addr %BYTE 0

;wait 1s

; Break krait for prevent sensor timeout by bongkyu.kim
IF "&intercom_handle1"=="localhost:20001"
(
	INTERCOM.EXECUTE &intercom_handle1 break
)

;------------------------------------------------------------------------------
; Set Breakpoints
;------------------------------------------------------------------------------
IF (Y.EXIST(QURTK_handle_error))
(
	BREAK.SET QURTK_handle_error
)
IF (Y.EXIST(QURTK_tlb_crash))
(
	BREAK.SET QURTK_tlb_crash
)
IF (Y.EXIST(QURTK_error))
(
	BREAK.SET QURTK_error
)
IF (Y.EXIST(QURTK_handle_nmi))
(
	BREAK.SET QURTK_handle_nmi
)
IF (Y.EXIST(err_fatal_jettison_core))
(
	BREAK.SET err_fatal_jettison_core
)	

b.s QURTK_fatal_error
b.s QURTK_nonfatal_error
b.s QURTK_handle_error

PRINT "Loading symbols: Complete"

if "&isReset"=="true"
(
	do my_q6sw_setup_window.cmm
	do my_q6sw_break.cmm
)
else
(
	do setup_window.cmm
)

go
	
ENDDO
;===================================================================================================

// Sub-routine to setup the MMU
SETUPMMU:
	LOCAL &MEMMAP_PHY &MEMMAP_VIRT &MEMMAP_SIZE

	// We need to get the start address of the ADSP image from
	// the memory map.
	do std_memorymap

	IF Y.EXIST(start)
	(
		&MEMMAP_VIRT=ADDRESS.OFFSET(start)
		&MEMMAP_PHY=&ADSP_SW_start

		// Now setup the page tables
		IF Y.EXIST(QURTK_pagetables)
		(
			MMU.FORMAT QURT QURTK_pagetables &MEMMAP_VIRT++&ADSP_SW_size &MEMMAP_PHY
			MMU.ON
			;MMU.SCAN ALL
			;MMU.SCAN KernelPageTable
		)
		ELSE
		(
			PRINT %ERROR "Could not locate kernel page tables"
		)
	)

	RETURN
