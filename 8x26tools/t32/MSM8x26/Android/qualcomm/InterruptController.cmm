;============================================================================
;  Name:
;    INTERRUPTCONTROLLER.CMM
;
;  Description:
;    This script lets the user enter the processor platform. By doing this
;    it lets the user route to the specific interrupt controller platform 
;    script.
;
; Copyright (c) 2011 QUALCOMM, Incorporated.  
; All Rights Reserved.
; Qualcomm Confidential and Proprietary
;----------------------------------------------------------------------------
;============================================================================
;
;                        EDIT HISTORY FOR MODULE
;
; when       who     what, where, why
; -------    ---     --------------------------------------------------------
; 10/2/2011  an      Created for querying InterruptController data.
;============================================================================;



;============================================================================
; Set up some defaults for some variables
;============================================================================
GLOBAL &GICDBASE &nIdx &PlatformSet &PlatformNum
GLOBAL &GICCBASE &L2VICBASE &Presult &nPrintRes

;============================================================================
; Get the arguments passed in.
;============================================================================
ENTRY

&Presult=0
AREA.RESet
WINPOS 0. 0. 100% 100%
AREA.Create INTRMENU
AREA.view INTRMENU


on error gosub
(
  print "An Error has Occured"
  enddo (1==0)
)

DISPLAYMENU:
AREA.view INTRMENU
AREA.Select INTRMENU
;============================================================================
; don't proceed without user confirmation
;============================================================================
      
print "      "
print "************************************************************************"
print " "     
print "  T H E     I N T E R R U P T C O N T R O L L E R     S C R I P T     "
print " "      
print "************************************************************************"      

if &Presult!=0
(
print " "
  GOSUB ERRORHNDLRMAIN &PlatformNum
print " "
print "************************************************************************" 
)
else if &Presult==0
(
)
&Presult=0
print " "
print " "
print " "
print "PLEASE CHOOSE FROM THE FOLLOWING OPTIONS TO SET THE INTERRUPT CONTROLLER" 
print "PLATFORM."
print " "
print " "
print "0. Exit the InterruptController script."
print "1. 8660 RPM"
print "2. 8960,8064 RPM"
print "3. 8660 Modem"
print "4. APPS"
print "5. RIVA"
print "6. GSS"
print "7. 8974,9x25,8610,8x25 QDSP6 Modem"
print "8. 8974,9x25,8610,8x25 QDSP6 LPASS"
print "9. Pronto"
print " "
print " "
print "************************************************************************"    
print
print
print
print
&t32_cmm_stopped=1
enter &Platform
&t32_cmm_stopped=0
print
print
&PlatformNum=&Platform.
if &PlatformNum>0x9
(
  &Presult=1
  &PlatformSet=0
  &PlatformNum=0
  GOTO DISPLAYMENU
)
if (&PlatformNum==0)
(
  AREA.CLEAR INTRMENU
  GOTO INTCTLEND
  &Presult=0
  &nPrintRes=0
  &PlatformSet=0
)
if &PlatformNum==1
(
  &Presult=1
  &PlatformSet=1
  AREA.CLEAR INTRMENU
  &GICDBASE=0x40000
  &GICCBASE=0x41000
  do InterruptControllerQGIC.cmm
)
if &PlatformNum==2
(
  &Presult=1
  &PlatformSet=1
  AREA.CLEAR INTRMENU
  &GICDBASE=0x60000
  &GICCBASE=0x61000
  &PlatformSet=1
  do InterruptControllerQGIC.cmm
)
if &PlatformNum==3
(
  &Presult=1
  &PlatformSet=1
  AREA.CLEAR INTRMENU
  &GICDBASE=0x10000000
  &GICCBASE=0x10001000
  &PlatformSet=1
  do InterruptControllerQGIC.cmm
)
if &PlatformNum==4
(
  &Presult=1
  &PlatformSet=1
  AREA.CLEAR INTRMENU
  &GICDBASE=0x2000000
  &GICCBASE=0x2002000
  &PlatformSet=1
  do InterruptControllerQGIC.cmm
)
if &PlatformNum==5
(
  &Presult=1
  &PlatformSet=1
  AREA.CLEAR INTRMENU
  &GICDBASE=0x3201000
  &GICCBASE=0x3200F00
  &PlatformSet=1
  do InterruptControllerQGIC.cmm
)
if &PlatformNum==6
(
  &Presult=1
  &PlatformSet=1
  AREA.CLEAR INTRMENU
  &GICDBASE=0x10008000
  &GICCBASE=0x1000A000
  &PlatformSet=1
  do InterruptControllerQGIC.cmm
)
if &PlatformNum==7
(
  &Presult=1
  &PlatformSet=1
  AREA.CLEAR INTRMENU
  &L2VICBASE=0xFC910000
  &PlatformSet=1
  do InterruptControllerL2VIC.cmm
)
if &PlatformNum==8
(
  &Presult=1
  &PlatformSet=1
  AREA.CLEAR INTRMENU
  &L2VICBASE=0xFE290000
  &PlatformSet=1
  do InterruptControllerL2VIC.cmm
)
if &PlatformNum==9
(
  &Presult=1
  &PlatformSet=1
  AREA.CLEAR INTRMENU
  &GICDBASE=0x10008000
  &GICCBASE=0x1000A000
  &PlatformSet=1
  do InterruptControllerQGIC.cmm
)

INTCTLEND:
AREA.CLEAR INTRMENU
AREA.RESET
WINCLEAR
term.close 
enddo (0==0)

ERRORHNDLRMAIN: 
  ENTRY &MenuEntry
  if &MenuEntry==0
  (
  print "  !! DATA ENTRY ERROR !!"
  print "  INVALID PLATFORM CONFIGURATION ENTERED"
  )
  if &MenuEntry==1
  (
   print " You chose the 8660 QGIC platform for RPM."
  )
  if &MenuEntry==2
  (
   print " You chose the 8960,8064 QGIC platform for RPM."
  )
  if &MenuEntry==3
  (
   print " You chose QGIC platform for 8660 Modem."
  )
  if &MenuEntry==4
  (
   print " You chose QGIC platform for Applications Processor."
  )
  if &MenuEntry==5
  (
   print " You chose QGIC platform for RIVA which is the BT WLAN subsystem."
  )
  if &MenuEntry==6
  (
   print " You chose QGIC platform for GSS Modem."
  )
  if &MenuEntry==7
  (
   print " You chose L2VIC platform for QDSP6 Modem."
  )
  if &MenuEntry==8
  (
   print " You chose L2VIC platform for QDSP6 Modem."
  )
  if &MenuEntry==9
  (
   print " You chose L2VIC platform for QDSP6 LPASS."
  )
  
  
RETURN
