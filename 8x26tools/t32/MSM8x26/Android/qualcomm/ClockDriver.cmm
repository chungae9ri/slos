;=============================================================================
;
; ClockTree.cmm 
;  
; Script to parse out information from the Clock Driver.
;
; ============================================================================
;
; Copyright (c) 2011 QUALCOMM Incorporated.  All Rights Reserved.  
; QUALCOMM Proprietary and Confidential. 
;
; ============================================================================
; $Header: //components/rel/core.mpss/2.0/systemdrivers/clock/scripts/ClockDriver.cmm#1 $
; $DateTime: 2013/01/02 15:29:07 $
; $Author: coresvc $
; ============================================================================

local &idx
local &choice
local &subscript


;-----------------------------------------------------------------------------
; Print welcome
;-----------------------------------------------------------------------------
&subscript=0

ENTRY &subscript

if "&subscript"==""
(
  AREA.RESet
  WINPOS 0. 0. 100% 100%
  AREA.Create CLOCK
  AREA.view CLOCK
)

AREA.Select CLOCK
AREA.Clear CLOCK

print ""
print ""
print "[----------------------------------------------- CLOCK DRIVER TOOL -----------------------------------------------]"
print ""

Help:

print "1: Show enabled clocks"
print "2: Show enabled sources"
print "3: List sleep voters"
print "4: List voltage voters"
print "5: Display clocks as table"
print "6: Display sources as table"
print "x: Exit"
print ""

;-----------------------------------------------------------------------------
; Main Menu
;-----------------------------------------------------------------------------

MainMenu:

print "Enter option (? for help):"
enter &choice
print "&choice"

if "&choice"=="?"
(
  goto Help
)
else if "&choice"=="x"
(
  if "&subscript"==""
  (
    AREA.CLEAR CLOCK
    AREA.RESET
    WINCLEAR
    term.close 
  )
  
  enddo (0==0)
)
else if "&choice"=="1"
(
  gosub DisplayEnabledClocks
)
else if "&choice"=="2"
(
  gosub DisplayEnabledSources
)
else if "&choice"=="3"
(
  gosub DisplaySleepVoters
)
else if "&choice"=="4"
(
  gosub DisplayVoltageVoters
)
else if "&choice"=="5"
(
  gosub DisplayClockTable
)
else if "&choice"=="6"
(
  gosub DisplaySourceTable
)

goto MainMenu


;-----------------------------------------------------------------------------
; DisplayEnabledClocks
;-----------------------------------------------------------------------------

DisplayEnabledClocks:
  print "[--- Enabled Clocks ---]"
  &idx=0.
  &clks=v.value(Clock_DriverCtxt.DrvCtxt.nNumClocks)
  while &idx<&clks
  (
    &suppressible=0
    &ref=v.value(Clock_DriverCtxt.DrvCtxt.aClocks[&idx].nReferenceCount)
    if &ref>0
    (
      ; Check for the SUPPRESSIBLE flag which indicates that this clock
      ; shall not prevent XO shutdown from occurring.
      &flags=v.value(Clock_DriverCtxt.DrvCtxt.aClocks[&idx].nFlags)
      if (&flags&(0x200))==0x200
      (
        &suppressible=1
      )
      
      &domain=v.value(Clock_DriverCtxt.DrvCtxt.aClocks[&idx].pDomain)
      if &domain!=0
      (
        ; Check for the SUPPRESSIBLE flag which indicates that clocks in this domain
        ; shall not prevent XO shutdown from occurring.
        &flags=v.value(Clock_DriverCtxt.DrvCtxt.aClocks[&idx].pDomain->nFlags)
        if (&flags&(0x200))==0x200
        (
          &suppressible=1
        )
      
        &src=v.value(Clock_DriverCtxt.DrvCtxt.aClocks[&idx].pDomain->pSource)
        if &src!=0
        (
          ;var.print "(&idx)  " %string Clock_DriverCtxt.DrvCtxt.aClocks[&idx].szName "  [" Clock_DriverCtxt.DrvCtxt.aClocks[&idx].pDomain->pSource->eSource ", " Clock_DriverCtxt.DrvCtxt.aClocks[&idx].pDomain->eVRegLevel ", Suppressible=" &suppressible "]"
          var.print "(&idx)  " %string Clock_DriverCtxt.DrvCtxt.aClocks[&idx].szName "  [" Clock_DriverCtxt.DrvCtxt.aClocks[&idx].pDomain->pSource->pBSPConfig->eSource ", " Clock_DriverCtxt.DrvCtxt.aClocks[&idx].pDomain->eVRegLevel ", Suppressible=" &suppressible "]"
        )
        else
        (
          ; Check for the "XO_VOTE" flag which indicates that this clock
          ; always votes for LPXO even if it has no source.
          &flags=v.value(Clock_DriverCtxt.DrvCtxt.aClocks[&idx].nFlags)
          if (&flags&(0x2000))==0x2000
          (
            var.print "(&idx)  " %string Clock_DriverCtxt.DrvCtxt.aClocks[&idx].szName "  [HAL_CLK_SOURCE_LPXO, " Clock_DriverCtxt.DrvCtxt.aClocks[&idx].pDomain->eVRegLevel ", Suppressible=" &suppressible "]"
          )
          else
          (
            var.print "(&idx)  " %string Clock_DriverCtxt.DrvCtxt.aClocks[&idx].szName "  [" Clock_DriverCtxt.DrvCtxt.aClocks[&idx].pDomain->eVRegLevel ", Suppressible=" &suppressible "]"
          )
        )
      )
      else
      (
        var.print "(&idx)  " %string Clock_DriverCtxt.DrvCtxt.aClocks[&idx].szName "  [No Domain, Suppressible=" &suppressible "]"
      )
    )
    &idx=&idx+1.
  )
  print ""
  return


;-----------------------------------------------------------------------------
; DisplayEnabledSources
;-----------------------------------------------------------------------------

DisplayEnabledSources:
  print "[--- Enabled Sources ---]"
  &idx=0.
  &srcs=v.value(Clock_DriverCtxt.DrvCtxt.nNumSources)
  while &idx<&srcs
  (
    &ref=v.value(Clock_DriverCtxt.DrvCtxt.aSources[&idx].nReferenceCount)
    &refsupp=v.value(Clock_DriverCtxt.DrvCtxt.aSources[&idx].nReferenceCountSuppressible)
    if &ref>0||&refsupp>0
    (
      ;var.print "(&idx)  " Clock_DriverCtxt.DrvCtxt.aSources[&idx].eSource "  [RefCount=" %decimal Clock_DriverCtxt.DrvCtxt.aSources[&idx].nReferenceCount+Clock_DriverCtxt.DrvCtxt.aSources[&idx].nReferenceCountSuppressible " (Suppressible=" Clock_DriverCtxt.DrvCtxt.aSources[&idx].nReferenceCountSuppressible ")]" 
      var.print "(&idx)  " Clock_DriverCtxt.DrvCtxt.aSources[&idx].pBSPConfig->eSource "  [RefCount=" %decimal Clock_DriverCtxt.DrvCtxt.aSources[&idx].nReferenceCount+Clock_DriverCtxt.DrvCtxt.aSources[&idx].nReferenceCountSuppressible " (Suppressible=" Clock_DriverCtxt.DrvCtxt.aSources[&idx].nReferenceCountSuppressible ")]" 
    )
    &idx=&idx+1.
  )
  print ""
  return


;-----------------------------------------------------------------------------
; DisplaySleepVoters
;-----------------------------------------------------------------------------

DisplaySleepVoters:
  print "[--- Sleep Voters ---]"
  &idx=0.
  &clks=v.value(Clock_DriverCtxt.DrvCtxt.nNumClocks)
  while &idx<&clks
  (
    &voter=0
    &ref=v.value(Clock_DriverCtxt.DrvCtxt.aClocks[&idx].nReferenceCount)
    if &ref>0
    (
      ; Check for the "XO_VOTE" flag which indicates that this clock
      ; always votes for LPXO even if it has no source.
      &flags=v.value(Clock_DriverCtxt.DrvCtxt.aClocks[&idx].nFlags)
      if (&flags&(0x2000))==0x2000
      (
        &voter=1
      )
      else
      (
        &domain=v.value(Clock_DriverCtxt.DrvCtxt.aClocks[&idx].pDomain)
        if &domain!=0
        (
          &cflags=v.value(Clock_DriverCtxt.DrvCtxt.aClocks[&idx].nFlags)
          &dflags=v.value(Clock_DriverCtxt.DrvCtxt.aClocks[&idx].pDomain->nFlags)
          &src=v.value(Clock_DriverCtxt.DrvCtxt.aClocks[&idx].pDomain->pSource)
          ;if (&src!=0)&&((&dflags)&(0x200)==0)
          ;if (&dflags)&(0x200)==0
          if (&src!=0)&&((&dflags&(0x200))==0)&&((&cflags&(0x200))==0)
          (
            &voter=1
          )
        )
      )
    )

    if &voter==1
    (
      var.print "(&idx)  " %string Clock_DriverCtxt.DrvCtxt.aClocks[&idx].szName
    )
    &idx=&idx+1.
  )
  print ""
  return


;-----------------------------------------------------------------------------
; DisplayVoltageVoters
;-----------------------------------------------------------------------------

DisplayVoltageVoters:
  print "[--- Voltage Voters ---]"
  print "HIGH:"
  &idx=0.
  &clks=v.value(Clock_DriverCtxt.DrvCtxt.nNumClocks)
  while &idx<&clks
  (
    &ref=v.value(Clock_DriverCtxt.DrvCtxt.aClocks[&idx].nReferenceCount)
    if &ref>0
    (
      &domain=v.value(Clock_DriverCtxt.DrvCtxt.aClocks[&idx].pDomain)
      if &domain!=0
      (
        &vreg=v.value(Clock_DriverCtxt.DrvCtxt.aClocks[&idx].pDomain->eVRegLevel)
        if &vreg==2
        (
          var.print "(&idx)  " %string Clock_DriverCtxt.DrvCtxt.aClocks[&idx].szName
        )
      )
    )
    &idx=&idx+1.
  )

  print "NOMINAL:"
  &idx=0.
  &clks=v.value(Clock_DriverCtxt.DrvCtxt.nNumClocks)
  while &idx<&clks
  (
    &ref=v.value(Clock_DriverCtxt.DrvCtxt.aClocks[&idx].nReferenceCount)
    if &ref>0
    (
      &domain=v.value(Clock_DriverCtxt.DrvCtxt.aClocks[&idx].pDomain)
      if &domain!=0
      (
        &vreg=v.value(Clock_DriverCtxt.DrvCtxt.aClocks[&idx].pDomain->eVRegLevel)
        if &vreg==1
        (
          var.print "(&idx)  " %string Clock_DriverCtxt.DrvCtxt.aClocks[&idx].szName
        )
      )
    )
    &idx=&idx+1.
  )
  print ""
  return


;-----------------------------------------------------------------------------
; DisplayClockTable
;-----------------------------------------------------------------------------

DisplayClockTable:
  &clks=v.value(Clock_DriverCtxt.DrvCtxt.nNumClocks)-1
  var.tab %string Clock_DriverCtxt.DrvCtxt.aClocks[0..&clks]
  return


;-----------------------------------------------------------------------------
; DisplaySourceTable
;-----------------------------------------------------------------------------

DisplaySourceTable:
  &srcs=v.value(Clock_DriverCtxt.DrvCtxt.nNumSources)-1
  var.tab Clock_DriverCtxt.DrvCtxt.aSources[0..&srcs]
  return


