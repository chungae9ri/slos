//============================================================================
//  Name:                                                                     
//    std_extensions.cmm 
//
//  Description:                                                              
//    None 
//                                                                            
// Copyright (c) 2013 by QUALCOMM, Incorporated.  All Rights Reserved.        
//============================================================================
//                                                                            
// *** AUTO GENERATED FILE - DO NOT EDIT                                      
//                                                                            
// GENERATED: Wed Feb 13 16:37:54 2013 
//============================================================================

if os.file("&MPSS_SCRIPTSDIR/../kernel/qurt/install/modemv5/debugger/T32/qurt_model.t32")
	task.config ../kernel/qurt/install/modemv5/debugger/T32/qurt_model.t32
else
	task.config qurt.t32

if os.file("&MPSS_SCRIPTSDIR../kernel/qurt/install/modemv5/debugger/T32/qurt_model.men")
	menu.reprogram ../kernel/qurt/install/modemv5/debugger/T32/qurt_model.men
else
	menu.reprogram qurt.men

ENDDO