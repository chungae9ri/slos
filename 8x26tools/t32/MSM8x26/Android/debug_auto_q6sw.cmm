;===================================================================================================
;
;  Copyright (C) 2009-2010, MDS Technology CO., LTD. All Rights Reserved.
; INFORMATION IN THIS CMM IS PROVIDED IN CONNECTION WITH MDS TECHNOLOGY INC. 
; MDS TECHNOLOGY INC. HAS ALL OF RIGHTS ALLOWED LEGALLY. 
; ANY INTELLECTUAL PROPERTY RIGHTS GRANTED BY THIS CMM IS NOT ALLOWED TO DISCLOSE, TRANSMIT, 
; REPRODUCTION WITH ELECTRICALLY OR NON-ELECTRICALLY WITHOUT THE PRIOR WRITTEN CONSENT OF 
; MDS TECHNOLOGY INC. 
; ALL KIND OF CONDUCT IS PROHIBITED THAT INFRINGEMENT RIGHT OF MDS TECHNOLOGY INC.
;
;===================================================================================================
;  MDS Technology Co. Contact Point  : http://www.trace32.com, TRACE32@mdstec.com  
;===================================================================================================
;  Revision History:
;  Author                	Date D/M/Y       Number    Description of Changes
;  -------------------------   ------------    ----------  ----------------------------------------
;  Justin Sung 		 	Oct-14-11		   Ver 0.1
;===================================================================================================
;  Name:
;        debug_auto_q6sw.cmm
;  Usage:
;       do debug_auto_q6sw.cmm
;===================================================================================================

;===================================================================================================
B::
ENTRY &qdsp6_mode &isReset
GLOBAL &G_Q6SW_ELF_FileName

WinClear
SYStem.Down		; stops debugger target connection
TASK.RESet		; reset Linux awareness
Break.Delete		; remove any left breakpoints
MAP.RESet		; reset debugger¡¯s memory mapping
MMU.RESet		; reset debugger¡¯s MMU
SYStem.RESet		; reset debugger¡¯s system settings 
task.reset		; reset awareness

area.reset
area

PATH + &G_MSFolder_Dir/../../../common/tools/cmm/common
PATH + &G_MSFolder_Dir/../../../common/tools/cmm/mpss

;do target.cmm q6sw
do target_sysup.cmm q6sw

IF ("&qdsp6_mode"=="q6sw_debug")||("&qdsp6_mode"=="q6sw_attach")
	SYStem.CONFIG SLAVE OFF

wait 8.s

LOCAL &count
&count=90
ON ERROR GOSUB
(
	&count=&count-1
	if (&count>0)
		GOTO START
	ELSE
		ENDDO
)
START:
	wait 30.ms
	sys.m.a
ON ERROR NOTHING

if run()
	break

;------------------------------------------------------------------------------
; Reset debugger state
;------------------------------------------------------------------------------
;Move this to end to prevent unhandled stuff exceptions
;do std_setupenv quiet

;Break.Delete
Symbol.AsmFrame on
Symbol.CutLine
Symbol.case off

mmu.off
mmu.delete
MAP.RESET

;This will prevent stuff exceptions when the stack isn't fully initialized
;map.denyaccess 0xFFFFFF00++0xFF

;system.option.icflush OFF
;system.option.dcfreeze OFF 

break.select.program soft

;Park PC before we attach
&Qube_va=0x89000000
&Qube_pa=0x89000000

;system.option PC &Qube_pa

;------------------------------------------------------------------------------
; Load symbols and OS awareness
;------------------------------------------------------------------------------

if (!y.exist(start))
(
	&G_Q6SW_ELF_FileName="&G_MSFolder_Dir/../../../modem_proc/build/ms/M8960AAAAAANAZQ1005.elf"
  
	if !os.file(&G_Q6SW_ELF_FileName)
	(
		print "Select MODEMSW ELF file in browser: "
		dialog.file &G_MSFolder_Dir/../../../modem_proc/build/ms\*.elf
		entry &G_Q6SW_ELF_FileName
		
		if "&G_Q6SW_ELF_FileName"==""
		(
			print "Failed to select file. Exiting..."
			END
		)	
	) 
	
	print "Loading Modem elf file..."
	data.load.elf &G_Q6SW_ELF_FileName /nocode /noclear /strippart "modem_proc" /strippart "02.04.02"
	symbol.sourcepath &G_MSFolder_Dir/../../../modem_proc
	;symbol.sourcepath + &G_MSFolder_Dir/../../../modem_proc/core/kernel/blast
)

; QuRT Awareness
task.config qurt.t32
menu.rp qurt.men

;b.s main /onchip
;b.s rcinit_task /onchip
;if !run()
; go

;wait !run()
;b.d rcinit_task

;------------------------------------------------------------------------------
; Run over MMU initialization
;------------------------------------------------------------------------------
;TODO - convert pc to nearest symbol name, if it is not near
;cold_boot_only_start, then do not execute this code
;if (string.scan(y.name(P:r(pc)),".cold_boot_only_start",0)!=-1)
;(
	; MMU is not on yet, use an onchip
;	Break.Set rcinit_task /P /Onchip
;	Step
;	Go
;	print "Waiting main function..."
;	wait !run()
;	Break.Delete rcinit_task
;)

;------------------------------------------------------------------------------
; Disable power collapse and other features to make debugging easier
;------------------------------------------------------------------------------
;pwr collapse

print ""
print "***********************************************************************"
print "*                   Disabling Q6SW and Q6FW Sleep!                    *"
print "*                                                                     *"
print "*           To enable q6sw sleep run:                                 *"
print "*                  v sleep_allow_low_power_modes=1                    *" 
print "*                                                                     *"
print "*           To enable q6fw sleep run:                                 *"
print "*                  v mcpm_ops.mcpm_saw_fwq6_sleep_allow_chk=1         *" 						
print "*                  v mcpm_ops.mcpm_saw_fw_sleep_enable=1              *"
print "***********************************************************************"
print ""

v sleep_allow_low_power_modes=0x0
;v mcpm_ops.mcpm_saw_fwq6_sleep_allow_chk=0
;v mcpm_ops.mcpm_saw_fw_sleep_enable=0

;by MDS
;&sleep_addr=address.offset(sleep_allow_low_power_modes)
;d.s &sleep_addr %BYTE 0

;wait 1s

;------------------------------------------------------------------------------
; Set Breakpoints
;------------------------------------------------------------------------------
;IF (Y.EXIST(tmc_task))
;	B.S tmc_task /P

;IF (Y.EXIST(err_Fatal0))
;	B.S err_Fatal0 /P

;IF (Y.EXIST(err_Fatal1))
;	B.S err_Fatal1 /P

;IF (Y.EXIST(err_Fatal2))
;	B.S   err_Fatal2 /P

;IF (Y.EXIST(err_Fatal3))
;	B.S   err_Fatal3 /P

;B.S err_fatal_handler /P
;B.S err_fatal_jettison_core /P

IF (Y.EXIST(QURTK_handle_error))
(
	BREAK.SET QURTK_handle_error
)
IF (Y.EXIST(QURTK_tlb_crash))
(
	BREAK.SET QURTK_tlb_crash
)
IF (Y.EXIST(QURTK_error))
(
	BREAK.SET QURTK_error
)
IF (Y.EXIST(QURTK_handle_nmi))
(
	BREAK.SET QURTK_handle_nmi
)
IF (Y.EXIST(err_fatal_jettison_core))
(
	BREAK.SET err_fatal_jettison_core
)	

PRINT "Loading symbols: Complete"

INTERCOM.EXECUTE &intercom_handle BREAK
INTERCOM.EXECUTE &intercom_handle DO std_exitfastdebug mpss
INTERCOM.EXECUTE &intercom_handle GO
go main /onchip
if "&isReset"=="true"
(
	do my_q6sw_setup_window.cmm
	do my_q6sw_break.cmm
)
else
(
	do setup_window.cmm
)
	
ENDDO
;===================================================================================================