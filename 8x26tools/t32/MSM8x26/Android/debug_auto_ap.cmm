;===================================================================================================
;
;  Copyright (C) 2009-2010, MDS Technology CO., LTD. All Rights Reserved.
; INFORMATION IN THIS CMM IS PROVIDED IN CONNECTION WITH MDS TECHNOLOGY INC. 
; MDS TECHNOLOGY INC. HAS ALL OF RIGHTS ALLOWED LEGALLY. 
; ANY INTELLECTUAL PROPERTY RIGHTS GRANTED BY THIS CMM IS NOT ALLOWED TO DISCLOSE, TRANSMIT, 
; REPRODUCTION WITH ELECTRICALLY OR NON-ELECTRICALLY WITHOUT THE PRIOR WRITTEN CONSENT OF 
; MDS TECHNOLOGY INC. 
; ALL KIND OF CONDUCT IS PROHIBITED THAT INFRINGEMENT RIGHT OF MDS TECHNOLOGY INC.
;
;===================================================================================================
;  MDS Technology Co. Contact Point  : http://www.trace32.com, TRACE32@mdstec.com  
;===================================================================================================
;  Revision History:
;  Author                	Date D/M/Y       Number    Description of Changes
;  -------------------------   ------------    ----------  ----------------------------------------
;  Justin Sung 		 	Oct-18-11		   v0.1
;===================================================================================================
;  Name:
;        debug_auto_ap.cmm
;  Usage:
;       DO debug_auto_ap.cmm
;===================================================================================================

;===================================================================================================
B::

WinClear
SYStem.Down		; stops debugger target connection
TASK.RESet		; reset Linux awareness
Break.Delete		; remove any left breakpoints
MAP.RESet		; reset debugger¡¯s memory mapping
MMU.RESet		; reset debugger¡¯s MMU
task.reset		; reset awareness

ENTRY &ap_mode &isReset &G_Setting_Reset &isRPM

AREA.Reset
;AREA
AREA.CREATE DEBUG
AREA.CREATE LOG

DO target.cmm krait

DO target_sysup.cmm krait

SYS.M.A

IF RUN()
	BREAK
	
DO std_memorymap.cmm	
	
INTERCOM.EXECUTE &intercom_handle BREAK
INTERCOM.EXECUTE &intercom_handle DO std_exitfastdebug sbl1
INTERCOM.EXECUTE &intercom_handle GO
	
IF ("&ap_mode"=="rpm_sbl1_debug")||("&ap_mode"=="rpm_lk_debug")
(
	Y.RESET
	SYStem.OPTION MMUSPACES OFF

	IF "&ap_mode"=="rpm_sbl1_debug"
	(
		IF OS.FILE(&G_MSFolder_Dir/..\..\core\bsp\bootloaders\sbl1\build\&G_BuildID\SBL1_&G_BuildID_A.elf)
			DODECRYPT "mdstechnology" loadsym_btl.emm &G_MSFolder_Dir/..\..\core\bsp\bootloaders\sbl1\build\&G_BuildID\SBL1_&G_BuildID_A.elf
		ELSE
			DODECRYPT "mdstechnology" loadsym_btl.emm &G_MSFolder_Dir/..\..\core\bsp\bootloaders\sbl1\build\&G_BuildID\sbl1_&G_BuildID_A.elf
				
	)
	ELSE IF "&ap_mode"=="rpm_lk_debug"
	(
		DODECRYPT "mdstechnology" loadsym_btl.emm &G_Boot_ELF_File
		;D.S EAHB:&APPSBOOT_DEBUG_COOKIE %LONG 0
		;b.d 
		;b.s aboot_init /o
		GO
		WAIT !RUN()
		B.D
	)

	BREAK.SELect PROGRAM Onchip
	BREAK.SELect READ Onchip
	BREAK.SELect WRITE Onchip
)
ELSE IF "&ap_mode"=="rpm_kernel_debug"||"&ap_mode"=="rpm_kernelsmp_debug"||"&ap_mode"=="rpm_kernelsmp2_debug"||"&ap_mode"=="rpm_krait_q6sw_debug"||"&ap_mode"=="rpm_krait_dsps_debug"||"&ap_mode"=="rpm_krait_adsp_debug"
(	
	D.S EAHB:&APPSBOOT_DEBUG_COOKIE %LONG 0

	IF "&ap_mode"=="rpm_krait_q6sw_debug"
	(
		INTERCOM.EXECUTE &intercom_handle BREAK
		INTERCOM.EXECUTE &intercom_handle D.S EAHB:&MPSS_DEBUG_COOKIE %LONG %LE &DEBUG_COOKIE_VALUE  
		INTERCOM.EXECUTE &intercom_handle GO
	)
	ELSE IF "&ap_mode"=="rpm_krait_adsp_debug"
	(
		INTERCOM.EXECUTE &intercom_handle BREAK
		INTERCOM.EXECUTE &intercom_handle D.S EAHB:&ADSP_DEBUG_COOKIE %LONG %LE &DEBUG_COOKIE_VALUE 
		INTERCOM.EXECUTE &intercom_handle GO
	)

	IF "&ap_mode"=="rpm_kernel_debug"
		DO linux_common.cmm KERNEL_LOAD kernel_debug
	ELSE IF "&ap_mode"=="rpm_kernelsmp2_debug"||"&ap_mode"=="rpm_krait_adsp_debug"
		DO linux_common.cmm KERNEL_LOAD kernel_smp2_debug
	ELSE
		DO linux_common.cmm KERNEL_LOAD kernel_smp_debug
	
	IF "&ap_mode"=="rpm_krait_q6sw_debug"
	(							
		DO start_powerview.cmm rpm_krait_q6sw
		DO sync3.cmm init
		
		INTERCOM.EXECUTE &intercom_handle1 CD &G_Build_Base
		INTERCOM.EXECUTE &intercom_handle1 DO debug_auto_q6sw.cmm up &isReset
		GO
	)
	ELSE IF "&ap_mode"=="rpm_krait_adsp_debug"
	(
		DO start_powerview.cmm rpm_krait_adsp
		;DO sync3.cmm init
		DO sync3.cmm yes
		
		INTERCOM.EXECUTE &intercom_handle1 CD &G_Build_Base
		INTERCOM.EXECUTE &intercom_handle1 DO debug_auto_adsp.cmm up &isReset
		GO
	)

	MENU.RP hwioreg.men
)
ELSE
(
	PRINT "please check ap_mode."
)

IF "&isReset"=="true"
(
	DO my_ap_setup_window.cmm
	DO my_ap_break.cmm
)
ELSE
(
	DO setup_window.cmm
)

ENDDO
;=================================================================================================