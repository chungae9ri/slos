;===================================================================================================
;
;  Copyright (C) 2009-2010, MDS Technology CO., LTD. All Rights Reserved.
; INFORMATION IN THIS CMM IS PROVIDED IN CONNECTION WITH MDS TECHNOLOGY INC. 
; MDS TECHNOLOGY INC. HAS ALL OF RIGHTS ALLOWED LEGALLY. 
; ANY INTELLECTUAL PROPERTY RIGHTS GRANTED BY THIS CMM IS NOT ALLOWED TO DISCLOSE, TRANSMIT, 
; REPRODUCTION WITH ELECTRICALLY OR NON-ELECTRICALLY WITHOUT THE PRIOR WRITTEN CONSENT OF 
; MDS TECHNOLOGY INC. 
; ALL KIND OF CONDUCT IS PROHIBITED THAT INFRINGEMENT RIGHT OF MDS TECHNOLOGY INC.
;
;===================================================================================================
;  MDS Technology Co. Contact Point  : http://www.trace32.com, TRACE32@mdstec.com  
;===================================================================================================
;  Revision History:
;  Author                	Date D/M/Y       Number    Description of Changes
;  -------------------------   ------------    ----------  ----------------------------------------
;  Justin, Sung               	10-Jan-11                  ver 0.1
;===================================================================================================
;  Name:
;        target_flash_emmc.cmm
;  Usage:
;       do target_flash_emmc.cmm
;===================================================================================================

;===================================================================================================
B::

entry &emmc_write_mode

winclear

cd &G_Build_Base

dodecrypt "mdstechnology" global.emm

do target_sysup.cmm krait

sys.m.a

if run()
	break

;do std_platinfo
;IF (&CHIPSET_SPIN<4)
;(
;	R.S PC 0xFC010000
;	b.s 0xFC0181FC /onchip
; 	;do std_debug_boot appspbl lpm_disable 0xFC0181FC
;)
;IF (&CHIPSET_SPIN>=4)
(
	R.S PC 0xFC010000
	b.s 0xFC017E5C /onchip
	;do std_debug_boot appspbl lpm_disable 0xFC017E5C
)
		

go
;wait !run()
b.d

cd &G_MSFolder_Dir\..\..\core\storage\tools\jsdcc


if "&emmc_write_mode"=="emmc_write_menu"
(
	do mjsdload.cmm
)
else if "&emmc_write_mode"=="emmc_erase"
(
	do mjsdload ERASE
)
else if "&emmc_write_mode"=="emmc_write_tz"
(
	;erase all
	do mjsdload ERASE

	;Flash partition table
	do mjsdload LOAD searchpaths=../../../../../common/build xml=rawprogram0.xml files=gpt_main0.bin,gpt_backup0.bin
	
	;Apply the disk patches
	do mjsdload PATCH searchpaths=../../../../../common/build xml=patch0.xml
	

	;Flash SBL1 binary
	do mjsdload LOAD searchpaths=../../../../../boot_images/build/ms/bin/8x26,../../../../../common/build xml=rawprogram0.xml files=sbl1.mbn

	;Flash RPM binary
	do mjsdload LOAD searchpaths=../../../../../rpm_proc/build/ms/bin/AAAAANAAR,../../../../../common/build xml=rawprogram0.xml files=rpm.mbn

	;Do a check on the HLOS bootloader 
	if OS.FILE(&G_Symbol_Samba_Root/out/target/product/msm8226/emmc_appsboot.mbn)
	(
		;Flash HLOS bootloader(LK) image
		do mjsdload LOAD searchpaths=&G_Symbol_Samba_Root/out/target/product/msm8226,../../../../../common/build xml=rawprogram0.xml files=emmc_appsboot.mbn	
		PRINT " Found CRM version of HLOS Bootloader"
	)
	else if OS.FILE(&G_Symbol_Samba_Root/emmc_appsboot.mbn)
	(
		;Flash HLOS bootloader(LK) image
		do mjsdload LOAD searchpaths=&G_Symbol_Samba_Root,../../../../../common/build xml=rawprogram0.xml files=emmc_appsboot.mbn	
		PRINT " Found engineering version of HLOS Bootloader"
	)
	else if OS.FILE(&G_Symbol_Dir\..\emmc_appsboot.mbn)
	(
		;Flash HLOS bootloader(LK) image
		do mjsdload LOAD searchpaths=&G_Symbol_Dir\..,../../../../../common/build xml=rawprogram0.xml files=emmc_appsboot.mbn	
		PRINT " Found engineering version of HLOS Bootloader"
	)
	else
	(
		PRINT " NOT Found HLOS Bootloader"
	)

	;Flash TZ binary
	if os.dir("../../../../../trustzone_images/build/ms/bin")
		do mjsdload LOAD searchpaths=../../../../../trustzone_images/build/ms/bin/FARAANBA,../../../../../common/build xml=rawprogram0.xml files=tz.mbn
	else
		do mjsdload LOAD searchpaths=../../../../../boot_images/build/ms/bin/&G_BuildID,../../../../../common/build xml=rawprogram0.xml files=tz.mbn
)
else if "&emmc_write_mode"=="emmc_write_dir"
(
	local &image_dir
	print "Please select directory for images"
	dialog.dir *
	entry &image_dir

	if "&image_dir"!=""
	(
		do mjsdload ERASE
		do mjsdload LOAD searchpaths=&image_dir xml=rawprogram0.xml files=gpt_main0.bin,gpt_backup0.bin
		do mjsdload PATCH searchpaths=&image_dir xml=patch0.xml
		do mjsdload LOAD searchpaths=&image_dir xml=rawprogram0.xml files=sbl1.mbn,rpm.mbn,emmc_appsboot.mbn,tz.mbn
	)
	else
	(
		print "failed to select director"
	)
)
else
(
	print "no emmc mode..."
)
ENDDO
;===================================================================================================