//============================================================================
//  Name:                                                                     
//    std_loadsyms_mpss.cmm 
//
//  Description:                                                              
//    Script to load MPSS symbols
//                                                                            
// Copyright (c) 2012 - 2014 by Qualcomm Technologies, Incorporated.  All Rights Reserved.        
//
//
//
//
//                      EDIT HISTORY FOR FILE
//  This section contains comments describing changes made to the module.
//  Notice that changes are listed in reverse chronological order.
//
// when       who     		what, where, why
// --------   ---     		---------------------------------------------------------
// 09/10/2012 AJCheriyan	Added call to setup breakpoints while loading symbols
// 08/21/2012 AJCheriyan	Refactored things a bit to override meta build options for simulator
// 07/10/2012 AJCheriyan    Created for B-family 
//

// ARG0 - Build from which symbols have to loaded
//
ENTRY &ARG0

LOCAL &MPSSBUILD
&MPSSBUILD="&ARG0"

MAIN:
	// If a build is not provided, we assume the meta build has provided everything and use that
	// information. 
	// Load the elf file first. 
	IF ("&MPSSBUILD"=="")
	(
		D.LOAD.ELF "&MPSS_BUILDROOT/modem_proc/build/ms/*.elf"  EAHB: /nocode /strippart "modem_proc" /sourcepath "&MPSS_BUILDROOT/modem_proc"

	    // Load anything else from the build
	    // Load the relative path info for the build
    	do std_utils EXECUTESCRIPT EXIT &MPSS_BUILDROOT/modem_proc/core/products/scripts/std_toolsconfig.cmm
		
		// Program the menus for general debugging
		do std_utils EXECUTESCRIPT EXIT &MPSS_BUILDROOT/modem_proc/core/products/scripts/std_scripts.men
		
		// Load the extensions for the system
    	do std_utils EXECUTESCRIPT EXIT &MPSS_BUILDROOT/modem_proc/core/products/scripts/std_extensions.cmm

	)
	ELSE
	(
		D.LOAD.ELF "&MPSSBUILD/modem_proc/build/ms/*.elf"  EAHB: /nocode /strippart "modem_proc" /sourcepath "&MPSSBUILD/modem_proc"

		// Load the relative path info for the build
	    do std_utils EXECUTESCRIPT EXIT &MPSSBUILD/modem_proc/core/products/scripts/std_toolsconfig.cmm
		
		// Program the menus for general debugging
		do std_utils EXECUTESCRIPT EXIT &MPSSBUILD/modem_proc/core/products/scripts/std_scripts.men
		
		// Load the extensions for the system
	    do std_utils EXECUTESCRIPT EXIT &MPSSBUILD/modem_proc/core/products/scripts/std_extensions.cmm
	)

	// Setup MMU
	GOSUB SETUPMMU
	
	// Setup breakpoints
	GOSUB SETUPBREAKPOINTS 

	// Done
	GOTO EXIT


// Sub-routine to setup the MMU
SETUPMMU:
	LOCAL &MEMMAP_PHY &MEMMAP_VIRT &MEMMAP_SIZE

	// We need to get the start address of the ADSP image from
	// the memory map.
	do std_memorymap

	IF Y.EXIST(start)
	(
		&MEMMAP_VIRT=ADDRESS.OFFSET(start)
		&MEMMAP_PHY=&MPSS_SW_start

		// Now setup the page tables
		IF Y.EXIST(QURTK_pagetables)
		(
                   
                    TRANSlation.OFF
                    TRANSlation.RESet
		    MMU.FORMAT QURT QURTK_pagetables &MEMMAP_VIRT++&MPSS_SW_size &MEMMAP_PHY
                    TRANSlation.TableWalk.ON
                    TRANSlation.on

		)
		ELSE
		(
			PRINT %ERROR "Could not locate kernel page tables"
		)
	)

	RETURN
	
SETUPBREAKPOINTS:
	IF (Y.EXIST(QURTK_handle_error))
	(
		BREAK.SET QURTK_handle_error
	)
	IF (Y.EXIST(QURTK_tlb_crash))
	(
		BREAK.SET QURTK_tlb_crash
	)
	IF (Y.EXIST(QURTK_error))
	(
		BREAK.SET QURTK_error
	)
	IF (Y.EXIST(QURTK_handle_nmi))
	(
		BREAK.SET QURTK_handle_nmi
	)
	IF (Y.EXIST(err_fatal_jettison_core))
	(
		BREAK.SET err_fatal_jettison_core
	)	

	RETURN


FATALEXIT:
    END

EXIT:
    ENDDO



