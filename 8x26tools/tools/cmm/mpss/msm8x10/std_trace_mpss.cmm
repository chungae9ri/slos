//============================================================================
//  Name:                                                                     
//    std_trace_mpss.cmm 
//
//  Description:                                                              
//    Trace setup script for MPSS
//                                                                            
// Copyright (c) 2012 - 2014 by Qualcomm Technologies, Incorporated.  All Rights Reserved.        
//
//
//
//
//                      EDIT HISTORY FOR FILE
//  This section contains comments describing changes made to the module.
//  Notice that changes are listed in reverse chronological order.
//
// when       who     		what, where, why
// --------   ---     		---------------------------------------------------------
// 09/28/2012 jbilling           Created for B-family.

// Following arguments are supported. 
// ARG0 - Processor to debug. 
// ARG1 - Tracing Type . Currently supports ETM/TPIU
// ARGn - n > 1 - Any other arguments to be passed to the script 
ENTRY &ARG0 &ARG1 &ARG2 &ARG3 &ARG4 &ARG5

MAIN:

	IF (("&ARG1"=="TPIU")||("&ARG1"=="tpiu")||("&ARG1"=="SDCARD")||("&ARG1"=="SDcard")||("&ARG1"=="sdcard"))
	(

		SYSTEM.CONFIG.FUNNEL1.BASE DAP:0x80021000
		SYSTEM.CONFIG.FUNNEL2.BASE DAP:0x80022000
		SYSTEM.CONFIG.FUNNEL3.BASE DAP:0x80023000
		SYSTEM.CONFIG.ETF.BASE DAP:0x80025000
		SYSTEM.CONFIG.TPIU.BASE DAP:0x80020000

		SYSTEM.CONFIG.FUNNEL1.ATBSource ETM 1
		SYSTEM.CONFIG.FUNNEL3.ATBSource FUNNEL1 0 
		SYSTEM.CONFIG.ETF.ATBSource FUNNEL3
		SYSTEM.CONFIG.TPIU.ATBSource ETF

		//Reset ETM
		ETM.RESET
		
		//set portsize.         
		IF (("&ARG2"=="4bit")||("&ARG3"=="4bit"))
		(
			ETM.PORTSIZE 4.
			area
			print " "
			print "Portsize of 4 only enabled for April2013 version of T32 and later. Please ensure your version matches "

		)
		ELSE IF (("&ARG2"=="8bit")||("&ARG3"=="8bit")) 
		(
			ETM.PORTSIZE 8.
			print "Configurtion Portsize to 8"
		)
		ELSE IF (("&ARG2"=="16bit")||("&ARG3"=="16bit"))
		(
			ETM.PORTSIZE 16.
			print "Configurtion Portsize to 16"
		)
		ELSE                       
		(
			ETM.PORTSIZE 8.
			print "Configurtion Portsize to 8"
		)
        
        
		IF (("&ARG2"=="CYCLEACCURATE")||("&ARG2"=="cycleaccurate")||("&ARG3"=="cycleaccurate")||("&ARG3"=="cycleaccurate"))
		(
			etm.cycleaccurate on
		)
        
		etm.traceid 10.
		etm.portmode bypass
		ETM.STALL OFF
		ETM.ON
		ETM.CLEAR
				
		TRACE.METHOD ANALYZER
		TRACE.CLOCK 10.MHz
		trace.init 
		trace.list
		TRACE.AUTOFOCUS
	)	
	ELSE (("&ARG1"=="ETB")||("&ARG1"=="etb"))
	(
		SYSTEM.CONFIG MEMORYACCESSPORT 0.
		SYSTEM.CONFIG DEBUGACCESSPORT  1.
		SYSTEM.CONFIG JTAGACCESSPORT   2.
		SYSTEM.CONFIG COREJTAGPORT     0.

		SYSTEM.CONFIG.FUNNEL1.BASE DAP:0x80021000
		SYSTEM.CONFIG.FUNNEL2.BASE DAP:0x80022000
		SYSTEM.CONFIG.FUNNEL3.BASE DAP:0x80023000
		SYSTEM.CONFIG.ETB.BASE DAP:0x80025000
		SYSTEM.CONFIG.TPIU.BASE DAP:0x80020000

		SYSTEM.CONFIG.FUNNEL1.ATBSource ETM 1
		SYSTEM.CONFIG.FUNNEL3.ATBSource FUNNEL1 0 
		SYSTEM.CONFIG.ETB.ATBSource FUNNEL3

		etm.reset
		etm.on
		etm.clear
		TRACE.METHOD ONCHIP
		trace.init 
		trace.list

	)

	


	GOTO EXIT


FATALEXIT:
	END

EXIT:
	ENDDO

