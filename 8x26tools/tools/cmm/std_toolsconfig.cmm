//============================================================================
//  Name:                                                                     
//    std_toolsconfig.cmm 
//
//  Description:                                                              
//    Configures the path of the tools / scripts for a particular debug session
//                                                                            
// Copyright (c) 2012 - 2014 by Qualcomm Technologies, Incorporated.  All Rights Reserved.        
//
//
//
//
//                      EDIT HISTORY FOR FILE
//  This section contains comments describing changes made to the module.
//  Notice that changes are listed in reverse chronological order.
//
// when       who     		what, where, why
// --------   ---     		---------------------------------------------------------
// 12/10/2012 AJCheriyan    Added support for multiple chipsets 	
// 07/10/2012 AJCheriyan    Created for B-family. 

// Supports 2 arguments
// ARG0 - Name of the Chipset for which path has to be setup
// ARG1 - Name of the Subsys for which path has to be setup
ENTRY &ARG0 &ARG1

// Create a global variable for every "subsystem" script folder
// Top level meta scripts
GLOBAL &METASCRIPTSDIR
// Common Scripts
GLOBAL &COMMON_METASCRIPTSDIR
// Generated Scripts
GLOBAL &GEN_METASCRIPTSDIR
// Sub-system level scripts
GLOBAL &MPSS_METASCRIPTSDIR
GLOBAL &RPM_METASCRIPTSDIR
GLOBAL &APPS_METASCRIPTSDIR
GLOBAL &ADSP_METASCRIPTSDIR
GLOBAL &WCNSS_METASCRIPTSDIR
GLOBAL &VSS_METASCRIPTSDIR

&METASCRIPTSDIR=OS.PPD()
&GEN_METASCRIPTSDIR="&METASCRIPTSDIR/gen"
&MPSS_METASCRIPTSDIR="&METASCRIPTSDIR/mpss/&ARG0"
&COMMON_METASCRIPTSDIR="&METASCRIPTSDIR/common"
&COMMON_CHIPSET_METASCRIPTSDIR="&METASCRIPTSDIR/common/&ARG0"
&APPS_METASCRIPTSDIR="&METASCRIPTSDIR/apps/&ARG0"
&RPM_METASCRIPTSDIR="&METASCRIPTSDIR/rpm/&ARG0"
&ADSP_METASCRIPTSDIR="&METASCRIPTSDIR/adsp/&ARG0"
&WCNSS_METASCRIPTSDIR="&METASCRIPTSDIR/wcnss/&ARG0"
&VSS_METASCRIPTSDIR="&METASCRIPTSDIR/vss/&ARG0"

// Set the path up to include the top level, SS specific scripts and apps specific script
PATH &METASCRIPTSDIR &COMMON_METASCRIPTSDIR &COMMON_CHIPSET_METASCRIPTSDIR &GEN_METASCRIPTSDIR &METASCRIPTSDIR/&ARG1/&ARG0 &APPS_METASCRIPTSDIR &APPS_METASCRIPTSDIR/&HLOS

// Set RPM to have full system knowledge 
IF (("&ARG1"=="RPM")||("&ARG1"=="rpm"))
(
	PATH + &MPSS_METASCRIPTSDIR &ADSP_METASCRIPTSDIR &WCNSS_METASCRIPTSDIR &VSS_METASCRIPTSDIR
)

ENDDO
