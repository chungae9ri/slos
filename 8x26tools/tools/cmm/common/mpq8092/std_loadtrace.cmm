//============================================================================
//  Name:                                                                     
//    std_loadtrace.cmm 
//
//  Description:                                                              
//    Common script to load trace ( ETB ) data
//                                                                            
// Copyright (c) 2012 - 2014 by Qualcomm Technologies, Incorporated.  All Rights Reserved.        
//
//
//
//
//                      EDIT HISTORY FOR FILE
//  This section contains comments describing changes made to the module.
//  Notice that changes are listed in reverse chronological order.
//
// when       who     		what, where, why
// --------   ---     		---------------------------------------------------------
// 10/15/2012 AJCheriyan    Created for B-family 

// Support the following arguments.
// ARG0 - Chipset
// ARG1 - Type of the trace ( ETB currently supported)
// ARG2 - Processor for which trace has been collected (one of the many sub-systems)

ENTRY &ARGO &ARG1 &ARG2

LOCAL &CHIPSET &TRACE &SUBSYS

&CHIPSET=STRING.UPPER("&ARG0")
&TRACE=STRING.UPPER("&ARG1")
&SUBSYS=STRING.UPPER("&ARG2")

SETUPSIM:
IF ("&TRACE"=="ETB")
(
	IF ("&SUBSYS"=="APPS")
	(
	 	SYSTEM.CPU KRAIT
		SYSTEM.CONFIG CORENUMBER 4.
		CORE.NUM 4.

                               
		SYSTEM.CONFIG COREBASE DAP:0x80030000 
		SYSTEM.CONFIG.CTI.BASE DAP:0x80002000
		SYSTEM.CONFIG.CTI.CONFIG CORTEXV1
		SYSTEM.CONFIG.ETM.BASE DAP:0x8003C000
		SYSTEM.CONFIG.STM1.BASE DAP:0x80021000
		SYSTEM.CONFIG.STM1.TYPE ARM
		SYSTEM.CONFIG.STM1.MODE STPV2
		SYSTEM.CONFIG.FUNNEL1.BASE DAP:0x80045000
		SYSTEM.CONFIG.FUNNEL1.ATBSOURCE ETM
		SYSTEM.CONFIG.FUNNEL2.BASE DAP:0x80019000
		SYSTEM.CONFIG.FUNNEL3.BASE DAP:0x8001A000
		SYSTEM.CONFIG.FUNNEL3.ATBSOURCE FUNNEL1 5 STM1 7
		SYSTEM.CONFIG.FUNNEL4.BASE DAP:0x8001B000
		SYSTEM.CONFIG.FUNNEL4.ATBSOURCE FUNNEL2 0 FUNNEL3 1
		SYSTEM.CONFIG.ETB.BASE DAP:0x80007000
		SYSTEM.CONFIG.ETB.ATBSOURCE FUNNEL4

		SYSTEM.UP

		ETM.ON
		ETM.CONTEXTID OFF
		ETM.CYCLEACCURATE OFF
	
		ETM.TIMESTAMPS OFF
		ETM.PORTMODE WRAPPED
		ETM.SMARTTRACE OFF
		
		// Load the ELF file
		D.LOAD.ELF *.*
		// Enable Flowtrace
		LA.MODE FLOWTRACE ON
		// Import ETB dump
		LA.IMPORT.ETB *.bin

		LA.LIST ALL TP TPC


	)
)




