//   Title: std_platinfo

//   License: License
//   Copyright 2012 Qualcomm Technologies Inc

//   Description:
//   This script collects chip / PMIC version and related platform info

//   Input: None

//   Output: None

//   Usage: do std_platinfo

//   Team: CoreBSP Products 8974

//   Target: MSM8974

//   Author: Author
//   $Author: coresvc $

//   Location: Perforce Revision
//   $Header: 
//
//   Edits : 		Edits
//   AJC   :    Make it stick.Add 8092          : 11/22/2013
//   AJC   :    Rewritten using SOC_HW_VERSION  : 07/22/2013
//   AJC   :    Added support for Pro			: 06/14/2013 
//   AJC   : 	Created for B-family			: 01/10/2013
//

GLOBAL &CHIPSET_NAME &CHIPSET_ID &CHIPSET_REVISION &CHIPSET_SPIN
GLOBAL &CHIPSET_FAMILY

MAIN:
LOCAL &READVAL1 &READVAL2 &CHIPSET_MAJORSPIN &CHIPSET_MINORSPIN


	// We don't want to run this multiple times. So make it stick.
	IF ("&CHIPSET_REVISION"=="")
	(
		// Can't use std_utils macro here because that requires HWIO.
		// JTAG_ID should not change across spins, we will have a problem here if that happens 
		&READVAL1=DATA.LONG(E&ACCESS:0xFC4BE0E0)
		&READVAL2=DATA.LONG(E&ACCESS:0xFD4A8000)


		// This is the assignment for MSM8974
		// The last nibble of the chipset id indicates the variant of the chip. So ignoring the last
		// nibble
		// Default values
		&CHIPSET_REVISION="Unknown"

		&CHIPSET_FAMILY=(&READVAL2&0xF0000000)>>28.
		&CHIPSET_ID=(&READVAL2&0x0FFF0000)>>16.
		&CHIPSET_SPIN=(&READVAL1&0xF0000000)>>28.
		&CHIPSET_MAJORSPIN=FORMAT.UDECIMAL(1, ((&READVAL2&0x0000FF00)>>8.))
		&CHIPSET_MINORSPIN=FORMAT.UDECIMAL(1, ((&READVAL2&0x000000FF)))

		// Tier 1
		IF (&CHIPSET_FAMILY==0)
		(
			// Now check for the chipset
			IF (&CHIPSET_ID==0x0)
			(
				&CHIPSET_NAME="MSM8974"
			)
			IF (&CHIPSET_ID==0x2)
			(
				&CHIPSET_NAME="MSM8626"
			)
			IF (&CHIPSET_ID==0x3)
			(
				&CHIPSET_NAME="APQ8084"
			)
			IF (&CHIPSET_ID==0x4)
			(
				&CHIPSET_NAME="MSM8926"
			)
			IF (&CHIPSET_ID==0x5)
			(
				&CHIPSET_NAME="MSM8962"
			)
			IF (&CHIPSET_ID==0x6)
			(
				&CHIPSET_NAME="MPQ8092"
			)
			IF (&CHIPSET_ID==0x8)
			(
				&CHIPSET_NAME="MSM8974Pro"
			)
		)

		// Tier 2
		IF (&CHIPSET_FAMILY==1)
		(
			IF (&CHIPSET_ID==0x0)
			(
				&CHIPSET_NAME="MSM8612"
			)
		)

		// Assign the complete name based on the spin number
		&CHIPSET_REVISION="v"+"&CHIPSET_MAJORSPIN"+".&CHIPSET_MINORSPIN"
	)
	
	GOTO EXIT

//	Function: Exit
//	Return with return values	
EXIT:
	ENDDO 

//	Function: Fatalexit
//	Return without return values	
FATALEXIT:
	END



