//============================================================================
//  Name:                                                                     
//    std_reset.cmm 
//
//  Description:                                                              
//		Top level reset script
//                                                                            
// Copyright (c) 2012 - 2014 by Qualcomm Technologies, Incorporated.  All Rights Reserved.        
//
//
//
//
//                      EDIT HISTORY FOR FILE
//  This section contains comments describing changes made to the module.
//  Notice that changes are listed in reverse chronological order.
//
// when       who     		what, where, why
// --------   ---     		---------------------------------------------------------------------
// 06/16/2013 AJCheriyan    Added check for Chipset family as well
// 02/11/2013 AJCheriyan	Pulled in DLOAD cookie clearing logic from HLOS reset scripts
// 02/08/2013 AJCheriyan	Added change to clear boot partition select / watchdog enable registers
// 10/10/2012 AJCheriyan	Added change to go to end of RPM boot loader to turn on IMEM clocks
// 08/13/2012 AJCheriyan	Manually reset the security block to workaround V1 HW bug
// 07/19/2012 AJCheriyan    Created for B-family (8974)
//

LOCAL &DLOAD_COOKIE1_ADDR &DLOAD_COOKIE2_ADDR

MAIN:
	// Check for any active sessions
	do std_intercom_init CHECKSESSION 5 RPM APPS0 MPSS ADSP WCNSS
	
	// "Reset" all T32 sessions except RPM
	IF (("&APPS0_ALIVE"!="0.")&&("&APPS0_ALIVE"!=""))
	(
		INTERCOM.EXECUTE &APPS0_PORT SYS.D
	)
	IF (("&APPS1_ALIVE"!="0.")&&("&APPS1_ALIVE"!=""))
	(
		INTERCOM.EXECUTE &APPS1_PORT SYS.D
	)
	IF (("&APPS2_ALIVE"!="0.")&&("&APPS2_ALIVE"!=""))
	(
		INTERCOM.EXECUTE &APPS2_PORT SYS.D
	)
	IF (("&APPS3_ALIVE"!="0.")&&("&APPS3_ALIVE"!=""))
	(
		INTERCOM.EXECUTE &APPS3_PORT SYS.D
	)
	IF (("&MPSS_ALIVE"!="0.")&&("&MPSS_ALIVE"!=""))
	(
		INTERCOM.EXECUTE &MPSS_PORT SYS.D
	)
	IF (("&ADSP_ALIVE"!="0.")&&("&ADSP_ALIVE"!=""))
	(
		INTERCOM.EXECUTE &ADSP_PORT SYS.D
	)
	IF (("&WCNSS_ALIVE"!="0.")&&("&WCNSS_ALIVE"!=""))
	(
		INTERCOM.EXECUTE &WCNSS_PORT SYS.D
	)

	// Reset RPM last
	IF ((("&RPM_ALIVE"!="0.")&&("&RPM_ALIVE"!=""))||("&LOCALHOST"=="&RPM_PORT"))
	(
		INTERCOM.EXECUTE &RPM_PORT SYS.U
		// MSM8974 v1 has a hardware bug. The security control block is not reset
		// properly. To workaround it, turn on the sleep clock to the block and reset
		// the block manually. This should return it to the golden state.
		// Load HWIO
		do hwio

		// Find version of the chipset
		do std_platinfo

		// Clear the Boot Partition Select Register and Watchdog debug for all revs
		do std_utils HWIO_OUT BOOT_PARTITION_SELECT 0x0
		do std_utils HWIO_OUT GCC_WDOG_DEBUG 0x0

		IF ((&CHIPSET_SPIN<4)&&("&CHIPSET_NAME"=="MSM8974"))
		(
			do std_utils HWIO_OUT GCC_GCC_IM_SLEEP_CBCR 0x1
			do std_utils HWIO_OUT GCC_SEC_CTRL_BCR 0x1
			do std_utils HWIO_OUT GCC_SEC_CTRL_BCR 0x0
			// We need to go to the end of the RPM boot rom to be able to properly reset the system
			// We CANNOT use std_debug here because it could be a recursive call
			GO 0x2F8CC /ONCHIP

			WAIT !RUN()

			// DLOAD cookies in MSGRAM
			&DLOAD_COOKIE1_ADDR=0xFC42B000
			&DLOAD_COOKIE2_ADDR=0xFC42B004

			// Enable RPM Message RAM clock
			do std_utils HWIO_OUTF GCC_APCS_CLOCK_BRANCH_ENA_VOTE MSG_RAM_AHB_CLK_ENA 0x1
			// Enable IMEM AXI clock
			do std_utils HWIO_OUTF GCC_IMEM_AXI_CBCR CLK_ENABLE 0x1
			do std_utils HWIO_OUTF GCC_IMEM_CFG_AHB_CBCR CLK_ENABLE 0x1
		)
		ELSE
		(
			GO 0x2F9C8 /ONCHIP

			WAIT !RUN()

			// DLOAD Cookies in OCIMEM
			&DLOAD_COOKIE1_ADDR=0xFE805000
			&DLOAD_COOKIE2_ADDR=0xFE805004
	 		
			// Enable IMEM clock branches
	 		do std_utils HWIO_OUTF GCC_IMEM_CFG_AHB_CBCR CLK_ENABLE 0x1
		)
		// Disable PMIC watchdog
		do std_utils EXECUTESCRIPT EXIT	&RPM_BUILDROOT/rpm_proc/core/systemdrivers/pmic/scripts/PMICWdogctrl.cmm 0
		
		// Now clear the cookies
		DATA.SET E&ACCESS:&DLOAD_COOKIE1_ADDR %LE %LONG 0x0
		DATA.SET E&ACCESS:&DLOAD_COOKIE2_ADDR %LE %LONG 0x0
		
		// Call the HLOS specific reset script
		&HLOSCRIPT=STR.LWR("&HLOS")+"/std_reset_"+STR.LWR("&HLOS")
		do &HLOSCRIPT

	)
	
	GOTO EXIT



FATALEXIT:
	END

EXIT:
	ENDDO



