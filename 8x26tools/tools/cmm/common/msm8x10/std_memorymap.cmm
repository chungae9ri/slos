//   Title: std_memorymap

//   License: License
//   Copyright 2012 Qualcomm Technologies Inc

//   Description: This script setup the memory map for the target

//   Input: None

//   Output: None

//   Usage: do std_memorymap

//   Team: CoreBSP Products 8974

//   Target: MSM8974

//   Author: Author
//   $Author: coresvc $

//   Location: Perforce Revision
//   $Header: 
//
//   Edits : 		Edits
//   AJC   :    Removed the change needed for Aragorn   : 05/16/2013
//   AJC   :	Relocatable image support		: 02/20/2013
//   AJC   : 	Updated DDR addresses			: 04/02/2013
//   AJC   : 	Correct RPM addresses			: 01/10/2013
//   AJC   : 	Added more debug cookies		: 10/19/2012
//   AJC   :	Added debug cookies to map		: 10/10/2012
//   AJC   :	Corrected addresses				: 08/03/2012
//   AJC   : 	First version for MSM8974		: 05/03/2012
//	 AJC   :	Re-written for B-family			: 05/03/2012

GLOBAL &ADSP_EFS_start
GLOBAL &ADSP_EFS_end
GLOBAL &ADSP_EFS_size
GLOBAL &ADSP_EFS_log
&ADSP_EFS_start=0XDC60000
&ADSP_EFS_end=0XDC7FFFF
&ADSP_EFS_size=0X20000
&ADSP_EFS_log="ADSP_EFS_log.bin"

// ADSP SW Image - 25 MB
GLOBAL &ADSP_SW_start
GLOBAL &ADSP_SW_end
GLOBAL &ADSP_SW_size
GLOBAL &ADSP_SW_log
&ADSP_SW_start=0XBF00000
&ADSP_SW_end=0XD1FFFFF
&ADSP_SW_size=0X12FFFFF
&ADSP_SW_log="ADSP_SW_log.bin"


// RPM Code RAM - 128 KB
GLOBAL &CODERAM_start
GLOBAL &CODERAM_RPM_start
GLOBAL &CODERAM_end
GLOBAL &CODERAM_size
GLOBAL &CODERAM_log
GLOBAL &CODERAM_USB_log
&CODERAM_start=0xFC100000
&CODERAM_RPM_start=0x100000
&CODERAM_end=0XFC11FFFF
&CODERAM_size=0X20000
&CODERAM_log="CODERAM_log.bin"
&CODERAM_USB_log="CODERAM.bin"

// RPM Data RAM - 64 kB 
GLOBAL &DATARAM_start
GLOBAL &DATARAM_RPM_start
GLOBAL &DATARAM_end
GLOBAL &DATARAM_size
GLOBAL &DATARAM_log
GLOBAL &DATARAM_USB_log
&DATARAM_start=0xFC190000
&DATARAM_RPM_start=0x190000
&DATARAM_end=0xFC19FFFF
&DATARAM_size=0X10000
&DATARAM_log="DATARAM_log.bin"
&DATARAM_USB_log="DATARAM.bin"

// RPM Message RAM - 16KB
GLOBAL &MSGRAM_start
GLOBAL &MSGRAM_end
GLOBAL &MSGRAM_size
GLOBAL &MSGRAM_log
GLOBAL &MSGRAM_USB_log
&MSGRAM_start=0xFC428000
&MSGRAM_end=0xFC42FFFF
&MSGRAM_size=0x4000
&MSGRAM_log="MSGRAM_log.bin"
&MSGRAM_USB_log="MSGRAM.bin"


// Debug Image - 12 kB
GLOBAL &DBI_start
GLOBAL &DBI_end
GLOBAL &DBI_size
GLOBAL &DBI_log
&DBI_start=0XFE800000
&DBI_end=0XFE802FFF
&DBI_size=0X3000
&DBI_log="DBI_log.bin"


GLOBAL &HLOS_1_start
GLOBAL &HLOS_1_end
GLOBAL &HLOS_1_size
GLOBAL &HLOS_1_log
&HLOS_1_start=0
&HLOS_1_end=0X7AFFFFF
&HLOS_1_size=0X7B00000
&HLOS_1_log="HLOS_1_log.bin"


GLOBAL &HLOS_2_start
GLOBAL &HLOS_2_end
GLOBAL &HLOS_2_size
GLOBAL &HLOS_2_log
&HLOS_2_start=0XDF00000
&HLOS_2_end=0XFFFFFFF
&HLOS_2_size=0X2100000
&HLOS_2_log="HLOS_2_log.bin"


GLOBAL &HLOS_3_start
GLOBAL &HLOS_3_end
GLOBAL &HLOS_3_size
GLOBAL &HLOS_3_log
&HLOS_3_start=0X10000000
&HLOS_3_end=0X1FFFFFFF
&HLOS_3_size=0X10000000
&HLOS_3_log="HLOS_3_log.bin"

GLOBAL &MBA_Meta_start
GLOBAL &MBA_Meta_end
GLOBAL &MBA_Meta_size
GLOBAL &MBA_Meta_log
&MBA_Meta_start=0XD1FC000
&MBA_Meta_end=0XD1FFFFF
&MBA_Meta_size=0X4000
&MBA_Meta_log="MBA_Meta_log.bin"


GLOBAL &MBA_SW_start
GLOBAL &MBA_SW_end
GLOBAL &MBA_SW_size
GLOBAL &MBA_SW_log
&MBA_SW_start=0X0BE00000
&MBA_SW_end=0X0BEFFFFF
&MBA_SW_size=0X100000
&MBA_SW_log="MBA_SW_log.bin"


GLOBAL &MPSS_EFS_start
GLOBAL &MPSS_EFS_end
GLOBAL &MPSS_EFS_size
GLOBAL &MPSS_EFS_log
&MPSS_EFS_start=0X0DC80000
&MPSS_EFS_end=0X0DDFFFFF
&MPSS_EFS_size=0X180000
&MPSS_EFS_log="MPSS_EFS_log.bin"


// MPSS Image - 63 MB
GLOBAL &MPSS_SW_start
GLOBAL &MPSS_SW_end
GLOBAL &MPSS_SW_size
GLOBAL &MPSS_SW_log
&MPSS_SW_start=0X8000000
&MPSS_SW_end=0X0BEFFFFF
&MPSS_SW_size=0X3F00000
&MPSS_SW_log="MPSS_SW_log.bin"

GLOBAL &MPSS_TCM_start
&MPSS_TCM_start=0xFCC00000

// QDSS Image - 16 MB
GLOBAL &QDSS_SW_start
GLOBAL &QDSS_SW_end
GLOBAL &QDSS_SW_size
GLOBAL &QDSS_SW_log
&QDSS_SW_start=0X10000000
&QDSS_SW_end=0X10FFFFFF
&QDSS_SW_size=0x1000000
&QDSS_SW_log="QDSS_SW_log.bin"


GLOBAL &SMEM_start
GLOBAL &SMEM_end
GLOBAL &SMEM_size
GLOBAL &SMEM_log
&SMEM_start=0XD900000
&SMEM_end=0XDAFFFFF
&SMEM_size=0X200000
&SMEM_log="SMEM_log.bin"


GLOBAL &TZ_SW_start
GLOBAL &TZ_SW_end
GLOBAL &TZ_SW_size
GLOBAL &TZ_SW_log
&TZ_SW_start=0XDB00000
&TZ_SW_end=0XDC5FFFF
&TZ_SW_size=0X160000
&TZ_SW_log="TZ_SW_log.bin"

// VSS Image - 5 MB
GLOBAL &VSS_SW_start
GLOBAL &VSS_SW_end
GLOBAL &VSS_SW_size
GLOBAL &VSS_SW_log
&VSS_SW_start=0XF500000
&VSS_SW_end=0XF9FFFFF
&VSS_SW_size=0X500000
&VSS_SW_log="Venus_SW_log.bin"


// WCNSS Image - 7 MB
GLOBAL &WCNSS_SW_start
GLOBAL &WCNSS_SW_end
GLOBAL &WCNSS_SW_size
GLOBAL &WCNSS_SW_log
&WCNSS_SW_start=0XD200000
&WCNSS_SW_end=0XD8FFFFF
&WCNSS_SW_size=0X700000
&WCNSS_SW_log="WCNSS_SW_log.bin"

// WCNSS uBSP Image - Part of the 7MB 
// main image when loaded. Runs out of CMEM
GLOBAL &WCNSS_CMEM_start
GLOBAL &WCNSS_CMEM_end
GLOBAL &WCNSS_CMEM_size
GLOBAL &WCNSS_CMEM_log
&WCNSS_CMEM_start=0xFB280000
&WCNSS_CMEM_end=0xFB29E000
&WCNSS_CMEM_size=0x1E000
&WCNSS_CMEM_log="WCNSS_CMEM_log.bin"


// DDR memory - combined space used by all images
GLOBAL &DDR_1_start
GLOBAL &DDR_1_end
GLOBAL &DDR_1_size
GLOBAL &DDR_1_log
GLOBAL &DDR_1_USB_log
&DDR_1_start=0x0
&DDR_1_end=0xFFFFFFF
&DDR_1_size=0x10000000
&DDR_1_log="DDRCS0.BIN"
&DDR_1_USB_log="DDRCS0.BIN"

GLOBAL &DDR_2_start
GLOBAL &DDR_2_end
GLOBAL &DDR_2_size
GLOBAL &DDR_2_log
GLOBAL &DDR_2_USB_log
&DDR_2_start=0x10000000
&DDR_2_end=0x1FFFFFFF
&DDR_2_size=0x10000000
&DDR_2_log="DDRCS1.BIN"
&DDR_2_USB_log="DDRCS1.BIN"

// This region is in the Shared IMEM block
// These are the cookies used to debug any image
// Allocation varies from target to target
GLOBAL &DEBUG_REGION_START
GLOBAL &DEBUG_REGION_END
GLOBAL &DEBUG_REGION_SIZE
GLOBAL &DEBUG_COOKIE_VALUE
GLOBAL &SBL1_DEBUG_COOKIE
GLOBAL &MBA_DEBUG_COOKIE
GLOBAL &MPSS_DEBUG_COOKIE
GLOBAL &ADSP_DEBUG_COOKIE
GLOBAL &WCNSS_DEBUG_COOKIE
GLOBAL &APPSBOOT_DEBUG_COOKIE
&DEBUG_COOKIE_VALUE=0x53444247
&DEBUG_REGION_START=0xFE805934
&DEBUG_REGION_END=0xFE80594C
&DEBUG_REGION_SIZE=0x18
&SBL1_DEBUG_COOKIE=0xFE805944
&MBA_DEBUG_COOKIE=0xFE805938
&MPSS_DEBUG_COOKIE=0xFE805934
&ADSP_DEBUG_COOKIE=0xFE80593C
&WCNSS_DEBUG_COOKIE=0xFE805940
&APPSBOOT_DEBUG_COOKIE=0xFE805948

// OCIMEM section
GLOBAL &OCIMEM_start
GLOBAL &OCIMEM_end
GLOBAL &OCIMEM_size
GLOBAL &OCIMEM_log
GLOBAL &OCIMEM_USB_log
&OCIMEM_start=0xFE800000
&OCIMEM_end=0xFE803FFFF
&OCIMEM_size=0x40000
&OCIMEM_log="OCIMEM.bin"
&OCIMEM_USB_log="OCIMEM.bin"

// Shared IMEM section
GLOBAL &SHARED_IMEM_start
GLOBAL &SHARED_IMEM_end
GLOBAL &SHARED_IMEM_size
GLOBAL &SHARED_IMEM_log
GLOBAL &SHARED_IMEM_USB_log
&SHARED_IMEM_start=0xFE805000
&SHARED_IMEM_end=&SHARED_IMEM_start+0xFFF
&SHARED_IMEM_size=0x1000
&SHARED_IMEM_log="SHARED_IMEM.bin"



// Relocatable Image support
GLOBAL &RELOCATION_DATA_start
GLOBAL &RELOCATION_DATA_end
GLOBAL &RELOCATION_DATA_size
&RELOCATION_DATA_start=&SHARED_IMEM_start+0x94C
&RELOCATION_DATA_end=&RELOCATION_DATA_start+0xC7
&RELOCATION_DATA_size=0xC8
// Each entry in the table is in the following format
// 8 bytes - image name
// 8 bytes - image start address
// 4 bytes - image size

GLOBAL &WCNSS_regs
GLOBAL &WCNSS_mmu
&WCNSS_regs="WCNSS_regs.cmm"
&WCNSS_mmu="WCNSS_mmu.cmm"

GLOBAL &RPM_regs
GLOBAL &RPM_mmu
&RPM_regs="RPM_regs.cmm"
&RPM_mmu="RPM_regs.cmm"

GLOBAL &MPSS_Thread0_regs
&MPSS_Thread0_regs="MPSS_Thread0_regs.cmm"
GLOBAL &MPSS_Thread1_regs
&MPSS_Thread1_regs="MPSS_Thread1_regs.cmm"
GLOBAL &MPSS_Thread2_regs
&MPSS_Thread2_regs="MPSS_Thread2_regs.cmm"

GLOBAL &ADSP_Thread0_regs
&ADSP_Thread0_regs="ADSP_Thread0_regs.cmm"
GLOBAL &ADSP_Thread1_regs
&ADSP_Thread1_regs="ADSP_Thread1_regs.cmm"
GLOBAL &ADSP_Thread2_regs
&ADSP_Thread2_regs="ADSP_Thread2_regs.cmm"

GLOBAL &KPSS_Core0_regs
GLOBAL &KPSS_Core0_mmu
&KPSS_Core0_regs="KPSS_Core0_regs.cmm"
&KPSS_Core0_mmu="KPSS_Core0_mmu.cmm"

GLOBAL &KPSS_Core1_regs
GLOBAL &KPSS_Core1_mmu
&KPSS_Core1_regs="KPSS_Core1_regs.cmm"
&KPSS_Core1_mmu="KPSS_Core1_mmu.cmm"

GLOBAL &KPSS_Core2_regs
GLOBAL &KPSS_Core2_mmu
&KPSS_Core2_regs="KPSS_Core2_regs.cmm"
&KPSS_Core2_mmu="KPSS_Core2_mmu.cmm"

GLOBAL &KPSS_Core3_regs
GLOBAL &KPSS_Core3_mmu
&KPSS_Core3_regs="KPSS_Core3_regs.cmm"
&KPSS_Core3_mmu="KPSS_Core3_mmu.cmm"





MAIN:
	// Change any defaults
	IF (!SIMULATOR())
	(
		// Get relocated image info again
		GOSUB PARSE_IMAGE_RELOCATION
	)
	ELSE
	(
		// Do both together on simulator
		GOSUB RELOC_SIMEM_N_PARSE_IMAGE_RELOC
	)


	GOTO EXIT

EXIT:
	ENDDO



// Function to parse relocated image data that is 
// saved in internal memory
// This function will be run once only unless a new 
// session has started
PARSE_IMAGE_RELOCATION:
	LOCAL &HEAD &TAIL &IMG_NAME &IMG_START &IMG_SIZE

	&HEAD=&RELOCATION_DATA_start
	&TAIL=&RELOCATION_DATA_end

	WHILE (&HEAD<=&TAIL)
	(
		// Null terminate the string
		DATA.SET EA:&HEAD+0x4 %LONG DATA.LONG(EA:&HEAD+0x4)&0xFFFFFF
	 	&IMG_NAME=DATA.STRING(EA:&HEAD)
		&IMG_START=DATA.LONG(EA:&HEAD+0xC)<<32.|DATA.LONG(EA:&HEAD+0x8)
		&IMG_SIZE=DATA.LONG(EA:&HEAD+0x10)

		// We have 5 images supported. No error if an image is not present
		IF ("&IMG_NAME"=="adsp")
		(
			&ADSP_SW_start=&IMG_START
			&ADSP_SW_size=&IMG_SIZE
			&ADSP_SW_end=&IMG_START+&IMG_SIZE-1
		)

		IF ("&IMG_NAME"=="modem")
		(
			&MPSS_SW_start=&IMG_START
			&MPSS_SW_size=&IMG_SIZE
			&MPSS_SW_end=&IMG_START+&IMG_SIZE-1
		)

		IF ("&IMG_NAME"=="wcnss")
		(
			&WCNSS_SW_start=&IMG_START
			&WCNSS_SW_size=&IMG_SIZE
			&WCNSS_SW_end=&IMG_START+&IMG_SIZE-1
		)

		// Move to the next entry
		&HEAD=&HEAD+0x14
	)

	RETURN


// Function to parse relocated image data that is 
// saved in internal memory and identify shared IMEM location
// This function will be run once only unless a new debug
// session has started	
RELOC_SIMEM_N_PARSE_IMAGE_RELOC:
	LOCAL &HEAD &TAIL &IMG_NAME &IMG_START &IMG_SIZE 
	LOCAL &RELOCATED &COUNT

	// Init locals
	&RELOCATED=0
	&COUNT=0

	// Start with default location for shared IMEM
	WHILE ((&RELOCATED==0)&&(&COUNT<1))
	(
		&HEAD=&RELOCATION_DATA_start
		&TAIL=&RELOCATION_DATA_end
		WHILE (&HEAD<=&TAIL)
		(
			// Null terminate the string
			DATA.SET EA:&HEAD+0x4 %LONG DATA.LONG(EA:&HEAD+0x4)&0xFFFFFF
		 	&IMG_NAME=DATA.STRING(EA:&HEAD)
			&IMG_START=DATA.LONG(EA:&HEAD+0xC)<<32.|DATA.LONG(EA:&HEAD+0x8)
			&IMG_SIZE=DATA.LONG(EA:&HEAD+0x10)

			// We have 5 images supported. No error if an image is not present
			IF ("&IMG_NAME"=="adsp")
			(
				&ADSP_SW_start=&IMG_START
				&ADSP_SW_size=&IMG_SIZE
				&ADSP_SW_end=&IMG_START+&IMG_SIZE-1
				&RELOCATED=1
			)

			IF ("&IMG_NAME"=="modem")
			(
				&MPSS_SW_start=&IMG_START
				&MPSS_SW_size=&IMG_SIZE
				&MPSS_SW_end=&IMG_START+&IMG_SIZE-1
				&RELOCATED=1
			)

			IF ("&IMG_NAME"=="wcnss")
			(
				&WCNSS_SW_start=&IMG_START
				&WCNSS_SW_size=&IMG_SIZE
				&WCNSS_SW_end=&IMG_START+&IMG_SIZE-1
				&RELOCATED=1
			)

			// Move to the next entry
			&HEAD=&HEAD+0x14
		)

		// Increment count
		&COUNT=&COUNT+1

	)

	// If we reach this point without finding relocated data, it means 911 time !
	IF (&RELOCATED==0)
	(
		PRINT "Relocated data not found at : &RELOCATION_DATA_start"
	)
	ELSE
	(
		PRINT "Relocated data found at : &RELOCATION_DATA_start"
	)

	RETURN


	

