//============================================================================
//  Name:                                                                     
//    std_trace_rpm.cmm 
//
//  Description:                                                              
//    Trace setup script for RPM
//                                                                            
// Copyright (c) 2012 - 2014 by Qualcomm Technologies, Incorporated.  All Rights Reserved.        
//
//
//
//
//                      EDIT HISTORY FOR FILE
//  This section contains comments describing changes made to the module.
//  Notice that changes are listed in reverse chronological order.
//
// when       who     		what, where, why
// --------   ---     		---------------------------------------------------------
// 07/10/2012 AJCheriyan    Created for B-family.

// Following arguments are supported. 
// ARG0 - Processor to debug. 
// ARG1 - Tracing Type . Currently supports TPIU, ETB, SDcard
// ARG2 - Trace width - supports 4, 8, 16 bit wide
// ARGn - n > 1 - Any other arguments to be passed to the script 
ENTRY &ARG0 &ARG1 &ARG2 &ARG3 &ARG4 &ARG5



MAIN:

    do std_utils CHECKARGS FATALEXIT &ARG1 TPIU tpiu SDCARD SDcard sdcard ETB etb SAVEETB saveetb
    
	IF (("&ARG1"=="TPIU")||("&ARG1"=="tpiu")||("&ARG1"=="SDCARD")||("&ARG1"=="SDcard")||("&ARG1"=="sdcard"))
	(
        SYStem.CONFIG COREBASE E:0xE000E000
        SYStem.CONFIG ITMBASE E:0xE0000000
        SYStem.CONFIG DWTBASE E:0xE0001000
        SYStem.CONFIG ETMBASE E:0xE0041000


        ;SYStem.CONFIG.ETM.BASE DAP:0x80060000
        SYStem.CONFIG.FUNNEL1.BASE DAP:0x80021000
        SYStem.CONFIG.FUNNEL2.BASE DAP:0x80022000
        SYStem.CONFIG.FUNNEL3.BASE DAP:0x80023000
        SYStem.CONFIG.ETF.BASE DAP:0x80025000

        SYStem.CONFIG.FUNNEL1.ATBSOURCE ETM 0
        SYStem.CONFIG.FUNNEL3.ATBSOURCE FUNNEL1 0
        SYStem.CONFIG.ETF.ATBSOURCE FUNNEL3

        SYStem.CONFIG.TPIU1.BASE DAP:0x80020000
        SYStem.CONFIG.TPIU1.ATBSOURCE ETF


		// Reset ETM
		ETM.RESET
        
        IF ("&ARG2"=="4bit")       
        (
            ETM.PORTSIZE 4.
            print "Configuring Portsize to 4. THis setting is compliant with Lauterbach SDCC2 Port adapter"
        )
        ELSE IF ("&ARG2"=="8bit")  
        (
            ETM.PORTSIZE 8.
            print "Configurtion Portsize to 8"
        )
        ELSE IF ("&ARG2"=="16bit") 
        (
            ETM.PORTSIZE 16.
            print "Configurtion Portsize to 16"
        )
        ELSE                       
        (
            ETM.PORTSIZE 8.
            print "Configurtion Portsize to 8"
        )
        
		ETM.TRACEID 4.
		ETM.PORTMODE CONTINUOUS
		ETM.ON
		ETM.STALL OFF
        ETM.ON
        ETM.CLEAR
        TRACE.METHOD ANALYZER
		TRACE.CLOCK 10MHz
		TRACE.INIT
		TRACE.LIST
		TRACE.AUTOFOCUS
		
        IF(("&ARG3"=="CYCLACCURATE")||("&ARG3"=="cycleaccurate"))
        (
            etm.cycleaccurate on
        )
	)
	ELSE IF(("&ARG1"=="ETB")||("&ARG1"=="etb"))
	(
		SYStem.CONFIG COREBASE E:0xE000E000
        SYStem.CONFIG ITMBASE E:0xE0000000
        SYStem.CONFIG DWTBASE E:0xE0001000
        SYStem.CONFIG ETMBASE E:0xE0041000


        ;SYStem.CONFIG.ETM.BASE DAP:0x80060000
        SYStem.CONFIG.FUNNEL1.BASE DAP:0x80021000
        SYStem.CONFIG.FUNNEL2.BASE DAP:0x80022000
        SYStem.CONFIG.FUNNEL3.BASE DAP:0x80023000
        SYStem.CONFIG.ETB.BASE DAP:0x80025000

        SYStem.CONFIG.FUNNEL1.ATBSOURCE ETM 0
        SYStem.CONFIG.FUNNEL3.ATBSOURCE FUNNEL1 0
        SYStem.CONFIG.ETB.ATBSOURCE FUNNEL3

        etm.reset
        etm.portsize 16.
        ;etm.traceid 4.
        ;etm.portmode continuous
        ;etm.timestamps ON
        etm.stall OFF
        etm.on
        etm.clear
        trace.method ONCHIP
        trace.clock 10.MHz
        trace.init 
        trace.list

	)
	ELSE
	(
		GOTO FATALEXIT
	)



	GOTO EXIT


FATALEXIT:
	END

EXIT:
	ENDDO

