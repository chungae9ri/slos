//============================================================================
//  Name:                                                                     
//    std_trace_rpm.cmm 
//
//  Description:                                                              
//    Trace setup script for RPM
//                                                                            
// Copyright (c) 2012 - 2014 by Qualcomm Technologies, Incorporated.  All Rights Reserved.        
//
//
//
//
//                      EDIT HISTORY FOR FILE
//  This section contains comments describing changes made to the module.
//  Notice that changes are listed in reverse chronological order.
//
// when       who     		what, where, why
// --------   ---     		---------------------------------------------------------
// 07/10/2012 AJCheriyan    Created for B-family.

// Following arguments are supported. 
// ARG0 - Processor to debug. 
// ARG1 - Tracing Type . Currently supports TPIU, ETB, SDcard
// ARG2 - Trace width - supports 4, 8, 16 bit wide
// ARGn - n > 1 - Any other arguments to be passed to the script 
ENTRY &ARG0 &ARG1 &ARG2 &ARG3 &ARG4 &ARG5



MAIN:

    do std_utils CHECKARGS FATALEXIT &ARG1 TPIU tpiu SDCARD SDcard sdcard ETB etb SAVEETB saveetb
    
	IF (("&ARG1"=="TPIU")||("&ARG1"=="tpiu")||("&ARG1"=="SDCARD")||("&ARG1"=="SDcard")||("&ARG1"=="sdcard"))
	(
		SYSTEM.CONFIG COREBASE         E:0xE000E000
		SYSTEM.CONFIG DWTBASE          E:0xE0001000
		SYSTEM.CONFIG ETMBASE          E:0xE0041000

		SYSTEM.CONFIG.STMBASE			DAP:0x80021000
	   	SYSTEM.CONFIG.STM1.TYPE			ARM
		SYSTEM.CONFIG.STM1.MODE			STPV2
		SYSTEM.CONFIG.FUNNEL1.BASE		DAP:0x80019000
		SYSTEM.CONFIG.FUNNEL1.ATBSOURCE	ETM
		SYSTEM.CONFIG.FUNNEL2.BASE		DAP:0x8001A000
		SYSTEM.CONFIG.FUNNEL2.ATBSOURCE	STM1 7
		SYSTEM.CONFIG.FUNNEL3.BASE		DAP:0x8001B000
		SYSTEM.CONFIG.FUNNEL3.ATBSOURCE	FUNNEL1 0 FUNNEL2 1
		SYSTEM.CONFIG.ETB1.BASE			DAP:0x80007000
		SYStem.CONFIG.ETB1.ATBSOURCE	FUNNEL3 
		SYSTEM.CONFIG.ETF1.BASE			DAP:0x80007000
		SYSTEM.CONFIG.ETF1.ATBSOURCE	FUNNEL3
		SYSTEM.CONFIG.CTI.BASE			DAP:0x8005C000
		SYSTEM.CONFIG.CTI.CONFIG		CORTEXV1
		SYSTEM.CONFIG.TPIU.BASE			DAP:0x80018000
		SYSTEM.CONFIG.TPIU.ATBSOURCE	ETF1


		// Reset ETM
		ETM.RESET
        
        IF ("&ARG2"=="4bit")       
        (
            ETM.PORTSIZE 4.
            print "Configuring Portsize to 4. THis setting is compliant with Lauterbach SDCC2 Port adapter"
        )
        ELSE IF ("&ARG2"=="8bit")  
        (
            ETM.PORTSIZE 8.
            print "Configurtion Portsize to 8"
        )
        ELSE IF ("&ARG2"=="16bit") 
        (
            ETM.PORTSIZE 16.
            print "Configurtion Portsize to 16"
        )
        ELSE                       
        (
            ETM.PORTSIZE 8.
            print "Configurtion Portsize to 8"
        )
        
		ETM.TRACEID 4.
		ETM.PORTMODE CONTINUOUS
		ETM.ON
		ETM.STALL OFF
		TRACE.INIT
		TRACE.LIST
		TRACE.METHOD ANALYZER
		TRACE.TH 1.25
		
		TRACE.CLOCK 1MHz
		TRACE.TESTFOCUS
		TRACE.OFF
	)
	ELSE IF(("&ARG1"=="ETB")||("&ARG1"=="etb"))
	(
		SYStem.CONFIG COREBASE E:0xE000E000
		SYStem.CONFIG ITMBASE E:0xE0000000
		SYStem.CONFIG DWTBASE E:0xE0001000
		SYStem.CONFIG ETMBASE E:0xE0041000
		SYStem.CONFIG.STM1.BASE DAP:0x80021000
		SYStem.CONFIG.STM1.TYPE ARM
		SYStem.CONFIG.STM1.MODE STPV2
		SYStem.CONFIG.FUNNEL1.BASE DAP:0x80019000
		SYStem.CONFIG.FUNNEL1.ATBSOURCE ETM
		SYStem.CONFIG.FUNNEL2.BASE DAP:0x8001A000
		SYStem.CONFIG.FUNNEL2.ATBSOURCE STM1 7
		SYStem.CONFIG.FUNNEL3.BASE DAP:0x8001B000
		SYStem.CONFIG.FUNNEL3.ATBSOURCE FUNNEL1 0 FUNNEL2 1
		SYStem.CONFIG.ETB.BASE DAP:0x80007000
		SYStem.CONFIG.ETB.ATBSOURCE FUNNEL3
		SYStem.CONFIG.TPIU.BASE DAP:0x80018000


		etm.reset
		etm.traceid 4.
		etm.timestamps ON
		etm.stall OFF
		etm.on
		etm.clear
		trace.method OnChip
		trace.clock 1MHz
		trace.init 
		trace.list

	)
	ELSE
	(
		GOTO FATALEXIT
	)



	GOTO EXIT


FATALEXIT:
	END

EXIT:
	ENDDO

