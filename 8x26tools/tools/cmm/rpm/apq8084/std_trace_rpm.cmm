//============================================================================
//  Name:                                                                     
//    std_trace_rpm.cmm 
//
//  Description:                                                              
//    Trace setup script for RPM
//                                                                            
// Copyright (c) 2012 - 2014 by Qualcomm Technologies, Incorporated.  All Rights Reserved.        
//
//
//
//
//                      EDIT HISTORY FOR FILE
//  This section contains comments describing changes made to the module.
//  Notice that changes are listed in reverse chronological order.
//
// when       who     		what, where, why
// --------   ---     		---------------------------------------------------------
// 07/10/2012 AJCheriyan    Created for B-family.

// Following arguments are supported. 
// ARG0 - Processor to debug. 
// ARG1 - Tracing Type . Currently supports TPIU, ETB, SDcard
// ARG2 - Trace width - supports 4, 8, 16 bit wide
// ARGn - n > 1 - Any other arguments to be passed to the script 
ENTRY &ARG0 &ARG1 &ARG2 &ARG3 &ARG4 &ARG5



MAIN:

    do std_utils CHECKARGS FATALEXIT &ARG1 TPIU tpiu SDCARD SDcard sdcard ETB etb SAVEETB saveetb
    
	IF (("&ARG1"=="TPIU")||("&ARG1"=="tpiu")||("&ARG1"=="SDCARD")||("&ARG1"=="SDcard")||("&ARG1"=="sdcard"))
	(
	        SYStem.CONFIG COREBASE         E:(RPM_DGB_COREBASE) ;0xE000E000
	        SYStem.CONFIG ITMBASE          E:(RPM_ITM_BASE) ;0xE0000000
	        SYStem.CONFIG DWTBASE          E:(RPM_DWT_BASE) ;0xE0010000
	        SYStem.CONFIG ETMBASE          E:(RPM_ETM_BASE) ;0xE0041000


		ON ERROR GOTO print_wrongt32version
		SYStem.CONFIG.FUNNEL1.BASE DAP:(0x80000000+QDSS_IN_FUN0_BASE_OFFSET)
		SYStem.CONFIG.FUNNEL1.ATBSOURCE ETM 0
		SYStem.CONFIG.FUNNEL2.BASE DAP:(0x80000000+QDSS_MERG_FUN_BASE_OFFSET)
		SYStem.CONFIG.FUNNEL2.ATBSOURCE FUNNEL1 0
		SYStem.CONFIG.ETF.BASE DAP:(0x80000000+QDSS_ETB_ETF_BASE_OFFSET)
		SYStem.CONFIG.ETF.ATBSOURCE FUNNEL2
		SYStem.CONFIG.TPIU.BASE DAP:(0x80000000+QDSS_TPIU_BASE_OFFSET)
		SYStem.CONFIG.TPIU.ATBSOURCE ETF1
		ON ERROR

		// Reset ETM
		ETM.RESET
        
        IF (("&ARG2"=="4bit")||("&ARG3"=="4bit")||("&ARG1"=="SDCARD")||("&ARG1"=="SDcard")||("&ARG1"=="sdcard"))
        (
            ETM.PORTSIZE 4.
            print "Configuring Portsize to 4. THis setting is compliant with Lauterbach SDCC2 Port adapter"
        )
        ELSE IF (("&ARG2"=="8bit")||("&ARG3"=="8bit")) 
        (
            ETM.PORTSIZE 8.
            print "Configurtion Portsize to 8"
        )
        ELSE IF (("&ARG2"=="16bit")||("&ARG3"=="16bit"))
        (
            ETM.PORTSIZE 16.
            print "Configurtion Portsize to 16"
        )
        ELSE                       
        (
            ETM.PORTSIZE 8.
            print "Configurtion Portsize to 8"
        )
        etm.portmode continuous
        
        IF (("&ARG2"=="CYCLEACCURATE")||("&ARG2"=="cycleaccurate")||("&ARG3"=="cycleaccurate")||("&ARG3"=="cycleaccurate"))
        (
            etm.cycleaccurate on
	)
	
		ETM.PORTMODE CONTINUOUS
		ETM.TRACEID 2.
		etm.timestamps OFF
		etm.stall OFF
		etm.on
		etm.clear

		TRACE.METHOD ANALYZER
		trace.clock 10.MHz
		trace.init 
        
		ON ERROR GOSUB autofocusErrorHandler
		trace.AutoFocus
		ON ERROR        
        
		trace.list
		
	)
	ELSE IF(("&ARG1"=="ETB")||("&ARG1"=="etb"))
	(
		ON ERROR GOTO print_wrongt32version
		SYStem.CONFIG ETMBASE E:RPM_ETM_BASE

		SYStem.CONFIG.FUNNEL1.BASE DAP:(0x80000000+QDSS_IN_FUN0_BASE_OFFSET)
		SYStem.CONFIG.FUNNEL1.ATBSOURCE ETM 0
		SYStem.CONFIG.FUNNEL2.BASE DAP:(0x80000000+QDSS_MERG_FUN_BASE_OFFSET)
		SYStem.CONFIG.FUNNEL2.ATBSOURCE FUNNEL1 0 
		
		SYStem.CONFIG.ETB.BASE DAP:(0x80000000+QDSS_ETB_ETF_BASE_OFFSET)
		SYStem.CONFIG.ETB.ATBSOURCE FUNNEL2
		ON ERROR
		
		etm.reset
		etm.traceid 2.
		etm.timestamps OFF
		etm.stall OFF
		etm.on
		etm.clear
		trace.method OnChip
		trace.clock 10.MHz
		trace.init 
		trace.list

	)
	ELSE
	(
		GOTO FATALEXIT
	)



	GOTO EXIT


FATALEXIT:
	END

EXIT:
	ENDDO


autofocusErrorHandler:
	area
	print %error " Autofocus Error indicate that Trace signal lines likely have some physical path problem."
	print %error " Make sure that TPIU cable is plugged in to port B, that Rotary switch is on 2, "
	print %error " And that TPIU rework has been done for your CDP"
	print %error " -> 0Ohm resistors on R3236, R3239, R3238, R3241, R3240, R3237"
	print %error " You should try fixing that problem first before proceeding further"
    goto FATALEXIT
    
print_wrongt32version:
	area
	print %error "Syntax error detected. Please update your Trace32 version to latest, "
	print %error "which can be found here: \\tex\qdsp6_sw_release\TRACE32\Run\latest"
	print %error " "
	print %error "exiting..."
	goto FATALEXIT
