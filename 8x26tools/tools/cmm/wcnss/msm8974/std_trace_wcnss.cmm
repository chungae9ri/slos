//============================================================================
//  Name:                                                                     
//    std_trace_wcnss.cmm 
//
//  Description:                                                              
//    Trace setup script for WCNSS
//                                                                            
// Copyright (c) 2012 - 2014 by Qualcomm Technologies, Incorporated.  All Rights Reserved.        
//
//
//
//
//                      EDIT HISTORY FOR FILE
//  This section contains comments describing changes made to the module.
//  Notice that changes are listed in reverse chronological order.
//
// when       who     		what, where, why
// --------   ---     		---------------------------------------------------------
// 09/28/2012 jbilling           Created for B-family.

// Following arguments are supported. 
// ARG0 - Processor to debug. 
// ARG1 - Tracing Type . Currently supports TPIU, ETB
// ARGn - n > 1 - Any other arguments to be passed to the script 
ENTRY &ARG0 &ARG1 &ARG2 &ARG3 &ARG4 &ARG5

MAIN:

    do std_utils CHECKARGS FATALEXIT &ARG1 TPIU tpiu ETB etb SDCARD SDcard sdcard SAVEETB saveetb

	IF (("&ARG1"=="tpiu")||("&ARG1"=="TPIU")||("&ARG1"=="SDCARD")||("&ARG1"=="SDcard")||("&ARG1"=="sdcard"))
	(



		SYStem.CONFIG.ETM.BASE DAP:0x8004C000
		SYStem.CONFIG.STM1.BASE DAP:0x80021000
		SYStem.CONFIG.STM1.TYPE ARM
		SYStem.CONFIG.STM1.MODE STPV2
		SYStem.CONFIG.FUNNEL1.BASE DAP:0x80019000
		SYStem.CONFIG.FUNNEL2.BASE DAP:0x8001A000
		SYStem.CONFIG.FUNNEL2.ATBSOURCE ETM 2 STM1 7
		SYStem.CONFIG.FUNNEL3.BASE DAP:0x8001B000
		SYStem.CONFIG.FUNNEL3.ATBSOURCE FUNNEL1 0 FUNNEL2 1
		SYStem.CONFIG.ETF1.BASE DAP:0x80007000
		SYStem.CONFIG.ETF1.ATBSOURCE FUNNEL3
		SYStem.CONFIG.TPIU.BASE DAP:0x80018000
		SYStem.CONFIG.TPIU.ATBSOURCE ETF1


		etm.reset
        
		IF ("&ARG2"=="4bit")       
        (
            ETM.PORTSIZE 4.
            print "Configuring Portsize to 4. THis setting is compliant with Lauterbach SDCC2 Port adapter"
        )
        ELSE IF ("&ARG2"=="8bit")  
        (
            ETM.PORTSIZE 8.
            print "Configurtion Portsize to 8"
        )
        ELSE IF ("&ARG2"=="16bit") 
        (
            ETM.PORTSIZE 16.
            print "Configurtion Portsize to 16"
        )
        ELSE                       
        (
            ETM.PORTSIZE 8.
            print "Configurtion Portsize to 8"
        )
        
		etm.traceid 8.
		etm.portmode continuous
		;etm.timestamps ON
		ETM.ON
		ETM.CLEAR
		etm.stall OFF
		trace.init 
		trace.list
		
				
		TRACE.METHOD ANALYZER
		TRACE.CLOCK 10.MHz
		TRACE.AUTOFOCUS
	)
	ELSE IF (("&ARG1"=="ETB")||("&ARG1"=="etb"))
	(
		SYStem.CONFIG.ETM.BASE DAP:0x8004C000
		SYStem.CONFIG.STM1.BASE DAP:0x80021000
		SYStem.CONFIG.STM1.TYPE ARM
		SYStem.CONFIG.STM1.MODE STPV2
		SYStem.CONFIG.FUNNEL1.BASE DAP:0x80019000
		SYStem.CONFIG.FUNNEL2.BASE DAP:0x8001A000
		SYStem.CONFIG.FUNNEL2.ATBSOURCE ETM 2 STM1 7
		SYStem.CONFIG.FUNNEL3.BASE DAP:0x8001B000
		SYStem.CONFIG.FUNNEL3.ATBSOURCE FUNNEL1 0 FUNNEL2 1
		SYStem.CONFIG.ETB.BASE DAP:0x80007000
		SYStem.CONFIG.ETB.ATBSOURCE FUNNEL3


		etm.reset
		etm.traceid 8.
		;etm.timestamps ON
		etm.stall OFF
		etm.on
		etm.clear
		trace.method OnChip
		trace.clock 1MHz
		trace.init 
		trace.list


	)
	ElSE
	(
		GOTO FATALEXIT
	)




	GOTO EXIT


FATALEXIT:
	END

EXIT:
	ENDDO

