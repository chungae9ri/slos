//============================================================================
//  Name:                                                                     
//    std_trace_wcnss.cmm 
//
//  Description:                                                              
//    Trace setup script for WCNSS
//                                                                            
// Copyright (c) 2012 - 2014 by Qualcomm Technologies, Incorporated.  All Rights Reserved.        
//
//
//
//
//                      EDIT HISTORY FOR FILE
//  This section contains comments describing changes made to the module.
//  Notice that changes are listed in reverse chronological order.
//
// when       who     		what, where, why
// --------   ---     		---------------------------------------------------------
// 09/28/2012 jbilling           Created for B-family.

// Following arguments are supported. 
// ARG0 - Processor to debug. 
// ARG1 - Tracing Type . Currently supports TPIU, ETB
// ARGn - n > 1 - Any other arguments to be passed to the script 
ENTRY &ARG0 &ARG1 &ARG2 &ARG3 &ARG4 &ARG5

MAIN:

	do std_utils CHECKARGS FATALEXIT &ARG1 TPIU tpiu ETB etb SDCARD SDcard sdcard SAVEETB saveetb

	IF (("&ARG1"=="tpiu")||("&ARG1"=="TPIU")||("&ARG1"=="SDCARD")||("&ARG1"=="SDcard")||("&ARG1"=="sdcard"))
	(

		SYSTEM.CONFIG.ETM.BASE DAP:0x80034000
		SYSTEM.CONFIG.STM1.BASE DAP:0x80002100
		SYSTEM.CONFIG.STM1.TYPE ARM
		SYSTEM.CONFIG.STM1.MODE STPV2
		SYSTEM.CONFIG.FUNNEL1.BASE DAP:0x80021000
		SYSTEM.CONFIG.FUNNEL2.BASE DAP:0x80022000
		SYSTEM.CONFIG.FUNNEL3.BASE DAP:0x80023000
		SYSTEM.CONFIG.ETB.BASE DAP:0x80025000
		SYSTEM.CONFIG.ETF.BASE DAP:0x80025000
		SYSTEM.CONFIG.TPIU.BASE DAP:0x80020000


		SYSTEM.CONFIG.FUNNEL2.ATBSOURCE ETM 0
		SYSTEM.CONFIG.FUNNEL3.ATBSOURCE STM1 7
		SYSTEM.CONFIG.FUNNEL3.ATBSOURCE FUNNEL1 0 FUNNEL2 1

		SYSTEM.CONFIG.ETF.ATBSOURCE FUNNEL3
		SYSTEM.CONFIG.TPIU.ATBSOURCE ETF

		//Reset ETM
		ETM.RESET
		
		//set portsize.         
		IF (("&ARG2"=="4bit")||("&ARG3"=="4bit"))
		(
			ETM.PORTSIZE 4.
			print "Configuring Portsize to 4. THis setting is compliant with Lauterbach SDCC2 Port adapter"
	        )
		ELSE IF (("&ARG2"=="8bit")||("&ARG3"=="8bit")) 
		(
			ETM.PORTSIZE 8.
			print "Configurtion Portsize to 8"
		)
		ELSE IF (("&ARG2"=="16bit")||("&ARG3"=="16bit"))
		(
			ETM.PORTSIZE 16.
			print "Configurtion Portsize to 16"
		)
		ELSE                       
		(
			ETM.PORTSIZE 8.
			print "Configurtion Portsize to 8"
		)
        
        
		IF (("&ARG2"=="CYCLEACCURATE")||("&ARG2"=="cycleaccurate")||("&ARG3"=="cycleaccurate")||("&ARG3"=="cycleaccurate"))
		(
			etm.cycleaccurate on
		)
        
		etm.traceid 4.
		etm.portmode continuous
		ETM.STALL OFF
		ETM.ON
		ETM.CLEAR
				
		TRACE.METHOD ANALYZER
		TRACE.CLOCK 10.MHz
		trace.init 
		trace.list
		TRACE.AUTOFOCUS
	)
	ELSE IF (("&ARG1"=="ETB")||("&ARG1"=="etb"))
	(
		SYSTEM.CONFIG MEMORYACCESSPORT 0.
		SYSTEM.CONFIG DEBUGACCESSPORT  1.
		SYSTEM.CONFIG JTAGACCESSPORT   2.
        
		SYSTEM.CONFIG.FUNNEL1.BASE DAP:0x80021000
		SYSTEM.CONFIG.FUNNEL2.BASE DAP:0x80022000
		SYSTEM.CONFIG.FUNNEL3.BASE DAP:0x80023000
		SYSTEM.CONFIG.ETB.BASE DAP:0x80025000
		SYSTEM.CONFIG.ETB.BASE DAP:0x80025000
		SYSTEM.CONFIG.ETM.BASE DAP:0x80034000
		SYSTEM.CONFIG.TPIU.BASE DAP:0x80020000
		SYSTEM.CONFIG.STM1.BASE DAP:0x80002100
		SYSTEM.CONFIG.STM1.TYPE ARM
		SYSTEM.CONFIG.STM1.MODE STPV2
		SYSTEM.CONFIG.FUNNEL2.ATBSOURCE ETM 0
		SYSTEM.CONFIG.FUNNEL1.ATBSOURCE STM1 7
		SYSTEM.CONFIG.FUNNEL3.ATBSOURCE FUNNEL1 0 FUNNEL2 1
		SYSTEM.CONFIG.ETB.ATBSOURCE FUNNEL3


		etm.reset
		etm.traceid 8.
		etm.stall OFF
		etm.on
		etm.clear
		TRACE.METHOD ONCHIP
		trace.clock 10MHz
		trace.init 
		trace.list

	)
	ElSE
	(
		GOTO FATALEXIT
	)




	GOTO EXIT


FATALEXIT:
	END

EXIT:
	ENDDO

