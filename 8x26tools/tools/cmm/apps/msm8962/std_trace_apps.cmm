//============================================================================
//  Name:                                                                     
//    std_trace_apps.cmm 
//
//  Description:                                                              
//    Trace setup script for Krait0
//                                                                            
// Copyright (c) 2012 - 2014 by Qualcomm Technologies, Incorporated.  All Rights Reserved.        
//
//
//
//
//                      EDIT HISTORY FOR FILE
//  This section contains comments describing changes made to the module.
//  Notice that changes are listed in reverse chronological order.
//
// when       who     		what, where, why
// --------   ---     		---------------------------------------------------------
// 09/28/2012 jbilling           Created for B-family.

// Following arguments are supported. 
// ARG0 - "APPS" 
// ARG1 - Tracing Type . Currently supports TPIU, ETB
// ARG2 - which Krait (0-3) to debug
// ARGn - n > 1 - Any other arguments to be passed to the script 
ENTRY &ARG0 &ARG1 &ARG2 &ARG3 &ARG4 &ARG5



MAIN:

    print "Checking that app core number (0,1,2,3) was specified"
    do std_utils CHECKARGS FATALEXIT &ARG2 0 1 2 3
    
	print "If using CDP, make sure that rotary switch is set to 1 or 2, and that dipswitch S3 1 and 8 are off"


	IF (("&ARG1"=="TPIU")||("&ARG1"=="tpiu")||("&ARG1"=="SDCARD")||("&ARG1"=="SDcard")||("&ARG1"=="sdcard"))
	(
		
        SYStem.CONFIG.ETM.BASE DAP:0x8004C000
        SYStem.CONFIG.ETB.BASE DAP:0x80025000
				
        SYStem.CONFIG.FUNNEL1.BASE DAP:0x80055000
        SYStem.CONFIG.FUNNEL2.BASE DAP:0x80021000
        SYStem.CONFIG.FUNNEL3.BASE DAP:0x80022000
        SYStem.CONFIG.FUNNEL4.BASE DAP:0x80023000						
		
		SYStem.CONFIG.FUNNEL1.ATBSOURCE ETM 0 ETM 1 ETM 2 ETM 3

        SYStem.CONFIG.FUNNEL3.ATBSOURCE FUNNEL1 6
        SYStem.CONFIG.FUNNEL4.ATBSOURCE FUNNEL2 0 FUNNEL3 1
        SYStem.CONFIG.ETB.ATBSOURCE FUNNEL4

        ;SYStem.CONFIG MEMORYACCESSPORT 0.
        ;SYStem.CONFIG DEBUGACCESSPORT  1.

		// Reset ETM
		ETM.RESET

        etm.TRACEID 4.

        
        //set portsize. should be 4 for sdcard
		IF ("&ARG3"=="4bit")       
        (
            ETM.PORTSIZE 4.
            print "Configuring Portsize to 4. THis setting is compliant with Lauterbach SDCC2 Port adapter"
        )
        ELSE IF ("&ARG3"=="8bit")  
        (
            ETM.PORTSIZE 8.
            print "Configurtion Portsize to 8"
        )
        ELSE IF ("&ARG3"=="16bit") 
        (
            ETM.PORTSIZE 16.
            print "Configurtion Portsize to 16"
        )
        ELSE                       
        (
            ETM.PORTSIZE 8.
            print "Configurtion Portsize to 8"
        )
			
		
		etm.timestamps ON
		etm.stall OFF
		etm.on
		etm.clear
		trace.method ANALYZER
		trace.clock 10.MHz
		trace.init
        trace.list
		trace.autofocus        

    )
	ELSE IF (("&ARG1"=="ETB")||("&ARG1"=="etb"))
	(
        SYStem.CONFIG.ETM.BASE DAP:0x8004C000
        SYStem.CONFIG.ETB.BASE DAP:0x80025000

        SYStem.CONFIG.FUNNEL1.BASE DAP:0x80055000
        SYStem.CONFIG.FUNNEL2.BASE DAP:0x80021000
        SYStem.CONFIG.FUNNEL3.BASE DAP:0x80022000
        SYStem.CONFIG.FUNNEL4.BASE DAP:0x80023000
         
        ;[hp] '0' represents Krait 0.
        SYStem.CONFIG.FUNNEL1.ATBSOURCE ETM 0 ETM 1 ETM 2 ETM 3

        SYStem.CONFIG.FUNNEL3.ATBSOURCE FUNNEL1 6
        SYStem.CONFIG.FUNNEL4.ATBSOURCE FUNNEL2 0 FUNNEL3 1
        SYStem.CONFIG.ETB.ATBSOURCE FUNNEL4

        ;SYStem.CONFIG MEMORYACCESSPORT 0.
        ;SYStem.CONFIG DEBUGACCESSPORT  1.

        etm.reset
        etm.traceid 4.
        etm.timestamps ON
        etm.stall OFF
        etm.on
        etm.clear
        trace.method OnChip
        trace.clock 1MHz
        trace.init 
        trace.list

        print "DONE"
		
		

	)
	ELSE
	(
		GOTO FATALEXIT
	)	



	GOTO EXIT


FATALEXIT:
	END

EXIT:
	ENDDO

