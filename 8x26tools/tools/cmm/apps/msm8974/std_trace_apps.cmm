//============================================================================
//  Name:                                                                     
//    std_trace_apps.cmm 
//
//  Description:                                                              
//    Trace setup script for Krait0
//                                                                            
// Copyright (c) 2012 - 2014 by Qualcomm Technologies, Incorporated.  All Rights Reserved.        
//
//
//
//
//                      EDIT HISTORY FOR FILE
//  This section contains comments describing changes made to the module.
//  Notice that changes are listed in reverse chronological order.
//
// when       who     		what, where, why
// --------   ---     		---------------------------------------------------------
// 09/28/2012 jbilling           Created for B-family.

// Following arguments are supported. 
// ARG0 - "APPS" 
// ARG1 - Tracing Type . Currently supports TPIU, ETB
// ARG2 - which Krait (0-3) to debug
// ARGn - n > 1 - Any other arguments to be passed to the script 
ENTRY &ARG0 &ARG1 &ARG2 &ARG3 &ARG4 &ARG5



MAIN:

    print "Checking that app core number (0,1,2,3) was specified"
    do std_utils CHECKARGS FATALEXIT &ARG2 0 1 2 3
    
	print "If using CDP, make sure that rotary switch is set to 1 or 2, and that dipswitch S3 1 and 8 are off"


	IF (("&ARG1"=="TPIU")||("&ARG1"=="tpiu")||("&ARG1"=="SDCARD")||("&ARG1"=="SDcard")||("&ARG1"=="sdcard"))
	(
		//SYSTEM.CONFIG COREBASE         E:0xE000E000
		//SYSTEM.CONFIG DWTBASE          E:0xE0001000
		//SYSTEM.CONFIG ETMBASE          E:0xE0041000

		if (("&ARG2"=="krait0")||("&ARG2"=="KRAIT0")||("&ARG2"=="0")||("&ARG2"=="Krait0")) 
		(
			SYStem.CONFIG.ETM.BASE DAP:0x8003C000
//			SYSTEM.CONFIG ETMBASE 0x8003C000
		)
		if (("&ARG2"=="krait1")||("&ARG2"=="KRAIT1")||("&ARG2"=="1")||("&ARG2"=="Krait1"))
		(
			SYStem.CONFIG.ETM.BASE DAP:0x8003D000		
//			SYSTEM.CONFIG ETMBASE 0x8003D000
		)
		if (("&ARG2"=="krait2")||("&ARG2"=="KRAIT2")||("&ARG2"=="2")||("&ARG2"=="Krait2"))
		(
			SYStem.CONFIG.ETM.BASE DAP:0x8003E000
//			SYSTEM.CONFIG ETMBASE 0x8003E000
		)
		if (("&ARG2"=="krait3")||("&ARG2"=="KRAIT3")||("&ARG2"=="3")||("&ARG2"=="Krait3"))
		(
			SYStem.CONFIG.ETM.BASE DAP:0x8003F000
//			SYSTEM.CONFIG ETMBASE 0x8003F000
		)			
				
		SYStem.CONFIG.STM1.BASE 		DAP:0x80021000
	    SYSTEM.CONFIG.STM1.TYPE			ARM
		SYSTEM.CONFIG.STM1.MODE			STPV2
		SYStem.CONFIG.FUNNEL1.BASE 		DAP:0x80045000
				
		if (("&ARG2"=="krait0")||("&ARG2"=="KRAIT0")||("&ARG2"=="0")||("&ARG2"=="Krait0")) 
		(
			SYSTEM.CONFIG.FUNNEL1.ATBSOURCE	 ETM
		)
		if (("&ARG2"=="krait1")||("&ARG2"=="KRAIT1")||("&ARG2"=="1")||("&ARG2"=="Krait1"))
		(
			SYSTEM.CONFIG.FUNNEL1.ATBSOURCE	 ETM 1
		)
		if (("&ARG2"=="krait2")||("&ARG2"=="KRAIT2")||("&ARG2"=="2")||("&ARG2"=="Krait2"))
		(
			SYSTEM.CONFIG.FUNNEL1.ATBSOURCE	 ETM 2
		)
		if (("&ARG2"=="krait3")||("&ARG2"=="KRAIT3")||("&ARG2"=="3")||("&ARG2"=="Krait3"))
		(
			SYSTEM.CONFIG.FUNNEL1.ATBSOURCE	 ETM 3
		)			
		
		
		SYStem.CONFIG.FUNNEL2.BASE DAP:0x80019000
		SYStem.CONFIG.FUNNEL3.BASE DAP:0x8001A000
		SYStem.CONFIG.FUNNEL3.ATBSOURCE FUNNEL1 5 STM1 7
		SYStem.CONFIG.FUNNEL4.BASE DAP:0x8001B000
		SYStem.CONFIG.FUNNEL4.ATBSOURCE FUNNEL2 0 FUNNEL3 1
		SYStem.CONFIG.ETF1.BASE DAP:0x80007000
		SYStem.CONFIG.ETF1.ATBSOURCE FUNNEL4
		SYStem.CONFIG.TPIU.BASE DAP:0x80018000
		SYStem.CONFIG.TPIU.ATBSOURCE ETF1




		// Reset ETM
		ETM.RESET
        
        //set portsize. should be 4 for sdcard
		IF ("&ARG3"=="4bit")       
        (
            ETM.PORTSIZE 4.
            print "Configuring Portsize to 4. THis setting is compliant with Lauterbach SDCC2 Port adapter"
        )
        ELSE IF ("&ARG3"=="8bit")  
        (
            ETM.PORTSIZE 8.
            print "Configurtion Portsize to 8"
        )
        ELSE IF ("&ARG3"=="16bit") 
        (
            ETM.PORTSIZE 16.
            print "Configurtion Portsize to 16"
        )
        ELSE                       
        (
            ETM.PORTSIZE 8.
            print "Configurtion Portsize to 8"
        )
		
        //set traceID to correct krait processor
		if (("&ARG2"=="krait0")||("&ARG2"=="KRAIT0")||("&ARG2"=="0")||("&ARG2"=="Krait0")) 
		(
			ETM.TRACEID 4
		)
		if (("&ARG2"=="krait1")||("&ARG2"=="KRAIT1")||("&ARG2"=="1")||("&ARG2"=="Krait1"))
		(
			ETM.TRACEID 5
		)
		if (("&ARG2"=="krait2")||("&ARG2"=="KRAIT2")||("&ARG2"=="2")||("&ARG2"=="Krait2"))
		(
			ETM.TRACEID 6
		)
		if (("&ARG2"=="krait3")||("&ARG2"=="KRAIT3")||("&ARG2"=="3")||("&ARG2"=="Krait3"))
		(
			ETM.TRACEID 7
		)		
		
		

        
		etm.portmode continuous
		etm.timestamps ON
		etm.stall OFF
		etm.on
		etm.clear
		trace.method ANALYZER
		trace.clock 10.MHz
		trace.list
		trace.autofocus        

    )
	ELSE IF (("&ARG1"=="ETB")||("&ARG1"=="etb"))
	(
		SYStem.CONFIG COREBASE DAP:0x80030000 
		SYStem.CONFIG.CTI.BASE DAP:0x80002000
		SYStem.CONFIG.CTI.CONFIG CORTEXV1
		SYStem.CONFIG.ETM.BASE DAP:0x8003C000
		SYStem.CONFIG.STM1.BASE DAP:0x80021000
		SYStem.CONFIG.STM1.TYPE ARM
		SYStem.CONFIG.STM1.MODE STPV2
		SYStem.CONFIG.FUNNEL1.BASE DAP:0x80045000
		SYStem.CONFIG.FUNNEL1.ATBSOURCE ETM
		SYStem.CONFIG.FUNNEL2.BASE DAP:0x80019000
		SYStem.CONFIG.FUNNEL3.BASE DAP:0x8001A000
		SYStem.CONFIG.FUNNEL3.ATBSOURCE FUNNEL1 5 STM1 7
		SYStem.CONFIG.FUNNEL4.BASE DAP:0x8001B000
		SYStem.CONFIG.FUNNEL4.ATBSOURCE FUNNEL2 0 FUNNEL3 1
		SYStem.CONFIG.ETB.BASE DAP:0x80007000
		SYStem.CONFIG.ETB.ATBSOURCE FUNNEL4

		SYStem.CONFIG MEMORYACCESSPORT 0.
		SYStem.CONFIG DEBUGACCESSPORT  1.

		etm.reset
		etm.traceid 4.
		etm.timestamps ON
		etm.stall OFF
		etm.on
		etm.clear
		trace.method OnChip
		trace.clock 1MHz
		trace.init 
		trace.list
		
		

	)
	ELSE
	(
		GOTO FATALEXIT
	)	



	GOTO EXIT


FATALEXIT:
	END

EXIT:
	ENDDO

