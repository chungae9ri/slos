//============================================================================
//  Name:                                                                     
//    std_loadbuild_wa.cmm 
//
//  Description:                                                              
//    WA Specific Build loading script
//                                                                            
// Copyright (c) 2012 - 2014 by Qualcomm Technologies, Incorporated.  All Rights Reserved.        
//
//
//
//
//                      EDIT HISTORY FOR FILE
//  This section contains comments describing changes made to the module.
//  Notice that changes are listed in reverse chronological order.
//
// when       who     		what, where, why
// --------   ---     		---------------------------------------------------------
// 10/02/2013 AJCheriyan    Ported over 8084 changes
// 03/01/2013 AJCheriyan	Fixed bug in xml for tzapps
// 02/21/2013 AJCheriyan	Changed SDI binary name
// 01/15/2013 AJCheriyan	Added TZApps loading
// 10/21/2012 VJunnuth		Ported from 8974 WCB load script
// 08/13/2012 AJCheriyan	Ported from 8974 LA, Added FAT16 binary
// 08/08/2012 AJCheriyan	Fixed issue with paths for mjsdload
// 07/19/2012 AJCheriyan    Created for B-family 

// ARG0 - Load option - Supported : ERASEONLY, LOADCOMMON, LOADFULL
ENTRY &ARG0

LOCAL &CWD &SEARCHPATHS

MAIN:
	// We have checked for all the intercom sessions at this point and we don't need any error
	// Save the argument
	&LOAD_OPTION="&ARG0"

	// Switch to the tools directory
	&CWD=OS.PWD()

	// Check for the boot option
	do hwio 
	do std_utils HWIO_INF BOOT_CONFIG FAST_BOOT
	ENTRY &STORAGE_OPTION
	
	&PROGRAMMER="boot_images/core/storage/tools/jsdcc/mjsdload"
	&XML_LOCATION="&METASCRIPTSDIR/../../build"
	&MAX_PARTITIONS=5

	// Erase all
	IF (("&ARG0"=="ERASE")||("&ARG0"=="ERASEONLY")||("&ARG0"=="LOADFULL"))
	(
		&SEARCHPATHS="&XML_LOCATION"
		// Erase the chip
		CD.DO &BOOT_BUILDROOT/&PROGRAMMER LOAD searchpaths=&SEARCHPATHS xml=wipe_rawprogram_PHY1.xml files=zeros_1sector.bin,zeros_33sectors.bin
		CD.DO &BOOT_BUILDROOT/&PROGRAMMER LOAD searchpaths=&SEARCHPATHS xml=wipe_rawprogram_PHY4.xml files=zeros_1sector.bin,zeros_33sectors.bin
		CD.DO &BOOT_BUILDROOT/&PROGRAMMER ERASE
	)

	// Load common images
	IF (("&ARG0"=="LOADCOMMON")||("&ARG0"=="LOADFULL"))
	(
		// Check for all the common images 

		// Check for the presence of all the binaries
		// Not needed because meta-build should have populated all this information
		// SBL, TZ, RPM, APPSBL, SDI
		do std_utils FILEXIST FATALEXIT &BOOT_BUILDROOT/&BOOT_BINARY
		do std_utils FILEXIST FATALEXIT &RPM_BUILDROOT/&RPM_BINARY
		do std_utils FILEXIST FATALEXIT &APPS_BUILDROOT/&APPSBOOT_BINARY
		do std_utils FILEXIST FATALEXIT &TZ_BUILDROOT/&TZ_BINARY
		do std_utils FILEXIST FATALEXIT &SDI_BUILDROOT/&SDI_BINARY
		do std_utils FILEXIST FATALEXIT &WINSECAPP_BUILDROOT/&WINSECAPP_BINARY
		do std_utils FILEXIST FATALEXIT &APPS_BUILDROOT/&APPSCONFIG_BINARY
		do std_utils FILEXIST FATALEXIT &APPS_BUILDROOT/&TZAPPS_BINARY
		
		// Now flash them all one by one 
		// Flash the partition table
		&SEARCHPATHS="&XML_LOCATION"
		CD.DO &BOOT_BUILDROOT/&PROGRAMMER LOAD searchpaths=&SEARCHPATHS xml=rawprogram1.xml files=gpt_main1.bin,gpt_backup1.bin
		CD.DO &BOOT_BUILDROOT/&PROGRAMMER LOAD searchpaths=&SEARCHPATHS xml=rawprogram4.xml files=gpt_main4.bin,gpt_backup4.bin

		
	
		// Flash sbl1, tz and rpm
		// SBL
		&SEARCHPATHS="&XML_LOCATION,"+OS.FILE.PATH(&BOOT_BUILDROOT/&BOOT_BINARY)
		CD.DO &BOOT_BUILDROOT/&PROGRAMMER LOAD searchpaths=&SEARCHPATHS xml=rawprogram1.xml files=sbl1.mbn
		// TZ
		&SEARCHPATHS="&XML_LOCATION,"+OS.FILE.PATH(&TZ_BUILDROOT/&TZ_BINARY)
		CD.DO &BOOT_BUILDROOT/&PROGRAMMER LOAD searchpaths=&SEARCHPATHS xml=rawprogram4.xml files=tz.mbn
		// RPM
		&SEARCHPATHS="&XML_LOCATION,"+OS.FILE.PATH(&RPM_BUILDROOT/&RPM_BINARY)
		CD.DO &BOOT_BUILDROOT/&PROGRAMMER LOAD searchpaths=&SEARCHPATHS xml=rawprogram4.xml files=rpm.mbn
		// SDI
		&SEARCHPATHS="&XML_LOCATION,"+OS.FILE.PATH(&SDI_BUILDROOT/&SDI_BINARY)
		CD.DO &BOOT_BUILDROOT/&PROGRAMMER LOAD searchpaths=&SEARCHPATHS xml=rawprogram4.xml files=sdi.mbn
		// Apps Bootloader
		&SEARCHPATHS="&XML_LOCATION,"+OS.FILE.PATH(&APPS_BUILDROOT/&APPSBOOT_BINARY)
		CD.DO &BOOT_BUILDROOT/&PROGRAMMER LOAD searchpaths=&SEARCHPATHS xml=rawprogram4.xml files=uefi.mbn
		// Apps Configuration Info / ACPI binary
		&SEARCHPATHS="&XML_LOCATION,"+OS.FILE.PATH(&APPS_BUILDROOT/&APPSCONFIG_BINARY)
		CD.DO &BOOT_BUILDROOT/&PROGRAMMER LOAD searchpaths=&SEARCHPATHS xml=rawprogram4.xml files=fat16.bin
		// Winsecapp
		&SEARCHPATHS="&XML_LOCATION,"+OS.FILE.PATH(&WINSECAPP_BUILDROOT/&WINSECAPP_BINARY)
		CD.DO &BOOT_BUILDROOT/&PROGRAMMER LOAD searchpaths=&SEARCHPATHS xml=rawprogram4.xml files=winsecapp.mbn
		// TZ Apps
		&SEARCHPATHS="&XML_LOCATION,"+OS.FILE.PATH(&APPS_BUILDROOT/&TZAPPS_BINARY)
		CD.DO &BOOT_BUILDROOT/&PROGRAMMER LOAD searchpaths=&SEARCHPATHS xml=rawprogram4.xml files=tzapps.bin
		
		
		// Apply the disk patches
		&SEARCHPATHS="&XML_LOCATION"
		CD.DO &BOOT_BUILDROOT/&PROGRAMMER PATCH searchpaths=&SEARCHPATHS xml=patch1.xml
		// Apply the disk patches
		&SEARCHPATHS="&XML_LOCATION"
		CD.DO &BOOT_BUILDROOT/&PROGRAMMER PATCH searchpaths=&SEARCHPATHS xml=patch4.xml

	)
   	
	
	// Load HLOS images
	IF ("&LOAD_OPTION"=="LOADFULL")
	(
    	// Set active boot partition to BOOT1
	    CD.DO &BOOT_BUILDROOT/&PROGRAMMER 9 activeboot=1

	)

	// Return to the old directory
	CD &CWD

	GOTO EXIT


FATALEXIT:
	END

EXIT:
	ENDDO

