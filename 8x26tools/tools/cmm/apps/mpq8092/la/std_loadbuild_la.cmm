//============================================================================
//  Name:                                                                     
//    std_loadbuild_la.cmm 
//
//  Description:                                                              
//    LA Specific Build loading script
//                                                                            
// Copyright (c) 2013 - 2014 by Qualcomm Technologies, Incorporated.  All Rights Reserved.        
//
//
//
//
//                      EDIT HISTORY FOR FILE
//  This section contains comments describing changes made to the module.
//  Notice that changes are listed in reverse chronological order.
//
// when       who     		what, where, why
// --------   ---     		---------------------------------------------------------
// 12/05/2013 AJCheriyan    Removed the storage option passing to top level
// 11/05/2013 AJCheriyan    Added changes to pass storage type to loading script
// 10/02/2013 AJCheriyan    New set of changes for UFS loading
// 10/01/2012 AJCheriyan	Removed SDI image loading for good (needs boot support)
// 09/13/2012 AJCheriyan	Added SDI image loading (add partition.xml changes)
// 09/07/2012 AJCheriyan	Removed SDI image loading (revert partition.xml changes )
// 09/02/2012 AJCheriyan	Added SDI image loading
// 08/08/2012 AJCheriyan	Fixed issue with paths for mjsdload
// 07/19/2012 AJCheriyan    Created for B-family 

// ARG0 - Load option - Supported : ERASEONLY, LOADCOMMON, LOADFULL
ENTRY &ARG0

LOCAL &CWD &SEARCHPATHS &STORAGE_OPTION &STORAGE_TYPE &PROGRAMMER &PARTITION
LOCAL &XML &MAX_PARTITIONS &XML_LOCATION

MAIN:
	// We have checked for all the intercom sessions at this point and we don't need any error
	// Save the argument
	&LOAD_OPTION="&ARG0"

	// Switch to the tools directory
	&CWD=OS.PWD()

	// Check for the boot option
	do hwio 
	do std_utils HWIO_INF BOOT_CONFIG FAST_BOOT
	ENTRY &STORAGE_OPTION
	
	IF (&STORAGE_OPTION==0x4)
	(
		&PROGRAMMER="boot_images/core/storage/tools/jtagprogrammer/ufs/src/jtagprogrammer"
		&XML_LOCATION="&METASCRIPTSDIR/../../build"
		&STORAGE_TYPE="ufs"
        &MAX_PARTITIONS=6
	)
	ELSE
	(
		&PROGRAMMER="boot_images/core/storage/tools/jsdcc/mjsdload"
		&XML_LOCATION="&METASCRIPTSDIR/../../build"
        &STORAGE_TYPE="emmc"
		&MAX_PARTITIONS=1
	)

	// Erase only
	IF (("&ARG0"=="ERASEONLY")||("&ARG0"=="LOADCOMMON")||("&ARG0"=="LOADFULL"))
	(
		// Only erase for eMMC and not for UFS
	    IF (&STORAGE_OPTION!=0x4)
        (
		    // Only erase the chip and exit
	        CD.DO &BOOT_BUILDROOT/&PROGRAMMER ERASE
		)
	)

	// Load common images
	IF (("&ARG0"=="LOADCOMMON")||("&ARG0"=="LOADFULL"))
	(
		// Check for all the common images 

		// Check for the presence of all the binaries
		// Not needed because meta-build should have populated all this information
		// SBL, TZ, RPM, APPSBL, SDI
		do std_utils FILEXIST FATALEXIT &BOOT_BUILDROOT/&BOOT_BINARY
		do std_utils FILEXIST FATALEXIT &RPM_BUILDROOT/&RPM_BINARY
		do std_utils FILEXIST FATALEXIT &APPS_BUILDROOT/&APPSBOOT_BINARY
		do std_utils FILEXIST FATALEXIT &TZ_BUILDROOT/&TZ_BINARY

		// Now flash them all one by one 
		// Flash the partition table
		&SEARCHPATHS="&XML_LOCATION"
		&PARTITION=0
		WHILE (&PARTITION<&MAX_PARTITIONS)
		(
            &XML="rawprogram"+FORMAT.DECIMAL(1, &PARTITION)+".xml"
            &FILES="gpt_main"+FORMAT.DECIMAL(1, &PARTITION)+".bin,"+"gpt_backup"+FORMAT.DECIMAL(1,&PARTITION)+".bin"
            CD.DO &BOOT_BUILDROOT/&PROGRAMMER LOAD searchpaths=&SEARCHPATHS xml=&XML files=&FILES
            &PARTITION=&PARTITION+1
	    )

	
		// Flash sbl1, tz and rpm
		&SEARCHPATHS="&XML_LOCATION,"+OS.FILE.PATH(&BOOT_BUILDROOT/&BOOT_BINARY)+","+OS.FILE.PATH(&TZ_BUILDROOT/&TZ_BINARY)+","+OS.FILE.PATH(&RPM_BUILDROOT/&RPM_BINARY)
		&PARTITION=0
		WHILE (&PARTITION<&MAX_PARTITIONS)
		(
            &XML="rawprogram"+FORMAT.DECIMAL(1, &PARTITION)+".xml"
            CD.DO &BOOT_BUILDROOT/&PROGRAMMER LOAD searchpaths=&SEARCHPATHS xml=&XML files=sbl1.mbn,tz.mbn,rpm.mbn
            &PARTITION=&PARTITION+1
		)

		// Apply the disk patches
		&SEARCHPATHS="&XML_LOCATION"
		&PARTITION=0
		WHILE (&PARTITION<&MAX_PARTITIONS)
		(
            &XML="patch"+FORMAT.DECIMAL(1, &PARTITION)+".xml"
            CD.DO &BOOT_BUILDROOT/&PROGRAMMER PATCH searchpaths=&SEARCHPATHS xml=&XML
            &PARTITION=&PARTITION+1
		)

	)
	// Load HLOS images
	IF ("&LOAD_OPTION"=="LOADFULL")
	(
		// Apps Bootloader
		&SEARCHPATHS="&XML_LOCATION,"+OS.FILE.PATH(&APPS_BUILDROOT/&APPSBOOT_BINARY)
		&PARTITION=0
		WHILE (&PARTITION<&MAX_PARTITIONS)
		(
			&XML="rawprogram"+FORMAT.DECIMAL(1, &PARTITION)+".xml"
			CD.DO &BOOT_BUILDROOT/&PROGRAMMER LOAD searchpaths=&SEARCHPATHS xml=&XML files=emmc_appsboot.mbn
			&PARTITION=&PARTITION+1
		)

		// Change the active partition. This is needed only if the user flashes an HLOS that needs
		// a different partition
		// Set the active boot partition based on the type of the device
        IF (&STORAGE_OPTION!=0x4)
        (
		    CD.DO &BOOT_BUILDROOT/&PROGRAMMER 9 activeboot=0
		)
		ELSE
		(
		    CD.DO &BOOT_BUILDROOT/&PROGRAMMER 9 activeboot=1
	    )
		

   		// Call the script to fastboot the remaining images
		OS.COMMAND cmd /k python &METASCRIPTSDIR/../../build/fastboot_all.py --ap=&APPS_BUILDROOT --pf=&PRODUCT_FLAVOR		
	)

	// Return to the old directory
	CD &CWD

	GOTO EXIT


FATALEXIT:
	END

EXIT:
	ENDDO



	
	
	

		

