//============================================================================
//  Name:                                                                     
//    DAP_APPS.cmm
//
//  Description:                                                              
//    Setup script for the Apps Processor
//                                                                            
// Copyright (c) 2012 - 2014 by Qualcomm Technologies, Incorporated.  All Rights Reserved.        
//
//
//
//
//                      EDIT HISTORY FOR FILE
//  This section contains comments describing changes made to the module.
//  Notice that changes are listed in reverse chronological order.
//
// when       who     		what, where, why
// --------   ---     		---------------------------------------------------------
// 11/21/2013 AJCheriyan    Update for Luxor
// 04/25/2013 AJCheriyan    Updated Gandalf settings
// 04/13/2013 AJCheriyan	Support for QDSS Gen 2
// 04/02/2013 AJCheriyan	Added SWDP support
// 02/11/2013 AJCheriyan	Added 8x26 support
// 01/31/2013 AJCheriyan	Added support for Cortex A7
// 08/26/2012 AJCheriyan	Dropped JTAG clock down to 20 MHz
// 08/25/2012 AJCheriyan	Boosted JTAG clock speed
// 07/10/2012 AJCheriyan    Created for B-family
//

// The script accepts two input arguments
// ARG0 - Chipset name
// ARG1 - Core number
// Ideal case, the argument 'ARG0' would not have to be used
// as the parameters for a sub-system should be the same
// across the entire family of chipsets

ENTRY &ARG0 &ARG1 &ARG2

MAIN:

	IF (("&ARG0"=="MSM8974")||("&ARG0"=="msm8974"))
	(
		SYSTEM.CPU KRAIT
		SYSTEM.CONFIG SLAVE ON
 
		SYSTEM.JTAGCLOCK 15.0MHZ
		SYSTEM.CONFIG.MULTITAP NONE
		SYSTEM.CONFIG.MEMORYACCESSPORT 0.
		SYSTEM.CONFIG.DEBUGACCESSPORT 1.
		SYSTEM.CONFIG.JTAGACCESSPORT 2.
		SYSTEM.OPTION ENRESET OFF
		SYSTEM.OPTION CFLUSH OFF
		SYSTEM.CONFIG.DAPIRPOST 16.
		SYSTEM.CONFIG.DAPDRPOST 2.
		SYSTEM.CONFIG.DAPIRPRE 0.
		SYSTEM.CONFIG.DAPDRPRE 0.
		SYSTEM.MEMACCESS DAP
		SYSTEM.CONFIG CTICONFIG			   NONE
		SYSTEM.CONFIG.FUNNELBASE	0X80045000	
	    SYSTEM.CONFIG.ETBBASE		0x80007000
		SYSTEM.CONFIG.FUNNEL2BASE	0x80022000
		SYSTEM.CONFIG.ETBFUNNELBASE	0x8001B000
		SYSTEM.CONFIG.ETMETBFUNNELPORT	1.

		// Core Specific Setup	
		IF ("&ARG1"=="0")
		(
			SYSTEM.CONFIG COREBASE         0X80030000 
			SYSTEM.CONFIG ETMBASE          0X8003C000 
			SYSTEM.CONFIG ETMFUNNELPORT    0.
			SYSTEM.CONFIG.CTIBASE		   0X80041000
		)
		IF ("&ARG1"=="1")
		(

			SYSTEM.CONFIG COREBASE         0X80032000 
			SYSTEM.CONFIG ETMBASE          0X8003D000 
			SYSTEM.CONFIG ETMFUNNELPORT    1.
			SYSTEM.CONFIG.CTIBASE		   0X80042000
		)
		IF ("&ARG1"=="2")
		(

			SYSTEM.CONFIG COREBASE         0X80034000 
			SYSTEM.CONFIG ETMBASE          0X8003E000 
			SYSTEM.CONFIG ETMFUNNELPORT    2.
			SYSTEM.CONFIG.CTIBASE		   0X80043000
		)
		IF ("&ARG1"=="3")
		(

			SYSTEM.CONFIG COREBASE         0X80036000 
			SYSTEM.CONFIG ETMBASE          0X8003F000 
			SYSTEM.CONFIG ETMFUNNELPORT    3.
			SYSTEM.CONFIG.CTIBASE		   0X80044000
		)

		IF ("&ARG1"=="mp")
		(
			SYSTEM.CONFIG CORENUMBER	   4
			THREAD.ASSIGN 				   1. 2. 3. 4.
			SYSTEM.CONFIG COREBASE         0X80030000 0x80032000 0x80034000 0x80036000
			SYSTEM.CONFIG ETMBASE          0X8003C000 0x8003D000 0x8003E000 0x8003F000 
			SYSTEM.CONFIG ETMFUNNELPORT    0. 1. 2. 3.
			SYSTEM.CONFIG.CTIBASE		   0X80041000 0x80042000 0x80043000 0x80044000
		)


		TRONCHIP.SET FIQ OFF 
        TRONCHIP.SET IRQ OFF
	    TRONCHIP.SET DABORT OFF 
        TRONCHIP.SET PABORT OFF  
        TRONCHIP.SET UNDEF OFF
        TRONCHIP.SET SWI OFF 
        TRONCHIP.SET RESET OFF
		// Turn off ETM 
		ETM.OFF 
		
	)

	IF (("&ARG0"=="MSM8X26")||("&ARG0"=="msm8x26"))
	(
		SYSTEM.CPU CORTEXA7
		SYSTEM.CONFIG SLAVE ON
 
		SYSTEM.JTAGCLOCK 15.0MHZ
		SYSTEM.CONFIG.MULTITAP NONE
		SYSTEM.CONFIG.MEMORYACCESSPORT 0.
		SYSTEM.CONFIG.DEBUGACCESSPORT 1.
		SYSTEM.CONFIG.JTAGACCESSPORT 2.
		SYSTEM.CONFIG.DAPIRPOST 16.
		SYSTEM.CONFIG.DAPDRPOST 2.
		SYSTEM.CONFIG.DAPIRPRE 0.
		SYSTEM.CONFIG.DAPDRPRE 0.
		SYSTEM.OPTION ENRESET OFF
		SYSTEM.OPTION CFLUSH OFF
		SYSTEM.CONFIG CTICONFIG			   CORTEXV1
		SYSTEM.CONFIG.FUNNELBASE	0X80045000	
	    SYSTEM.CONFIG.ETBBASE		0x80007000
		SYSTEM.CONFIG.FUNNEL2BASE	0x80022000
		SYSTEM.CONFIG.ETBFUNNELBASE	0x8001B000
		SYSTEM.CONFIG.ETMETBFUNNELPORT	1.

		// Core Specific Setup	
		IF ("&ARG1"=="0")
		(
			SYSTEM.CONFIG COREBASE         0X80030000 
			SYSTEM.CONFIG ETMBASE          0X8003C000 
			SYSTEM.CONFIG ETMFUNNELPORT    0.
			SYSTEM.CONFIG.CTIBASE		   0X80041000
		)
		IF ("&ARG1"=="1")
		(

			SYSTEM.CONFIG COREBASE         0X80032000 
			SYSTEM.CONFIG ETMBASE          0X8003D000
			SYSTEM.CONFIG ETMFUNNELPORT    1.
			SYSTEM.CONFIG.CTIBASE		   0X80042000
		)
		IF ("&ARG1"=="2")
		(

			SYSTEM.CONFIG COREBASE         0X80034000 
			SYSTEM.CONFIG ETMBASE          0X8003E000 
			SYSTEM.CONFIG ETMFUNNELPORT    2.
			SYSTEM.CONFIG.CTIBASE		   0X80043000
		)
		IF ("&ARG1"=="3")
		(

			SYSTEM.CONFIG COREBASE         0X80036000 
			SYSTEM.CONFIG ETMBASE          0X8003F000 
			SYSTEM.CONFIG ETMFUNNELPORT    3.
			SYSTEM.CONFIG.CTIBASE		   0X80044000
		)
		IF ("&ARG1"=="mp")
		(
			SYSTEM.CPU CORTEXA7MPCORE
			SYSTEM.CONFIG CORENUMBER	   4
			THREAD.ASSIGN 				   1. 2. 3. 4.
			SYSTEM.CONFIG COREBASE         0X80030000 0X80032000 0X80034000 0X80036000
			SYSTEM.CONFIG ETMBASE          0X8003C000 0x8003D000 0x8003E000 0X8003F000 
			SYSTEM.CONFIG ETMFUNNELPORT    0. 1. 2. 3.
			SYSTEM.CONFIG.CTIBASE		   0X80041000 0X80042000 0X80043000 0X80044000
		)


		SYSTEM.MEMACCESS DAP
		TRONCHIP.SET FIQ OFF 
        TRONCHIP.SET IRQ OFF
	    TRONCHIP.SET DABORT OFF 
        TRONCHIP.SET PABORT OFF  
        TRONCHIP.SET UNDEF OFF
        TRONCHIP.SET SWI OFF 
        TRONCHIP.SET RESET OFF
		// Turn off ETM 
		ETM.OFF 
		
	)

	IF (("&ARG0"=="MSM8X10")||("&ARG0"=="msm8x10"))
	(
		SYSTEM.CPU CORTEXA7
		SYSTEM.CONFIG SLAVE ON
 
		SYSTEM.JTAGCLOCK 10.0MHZ
		SYSTEM.CONFIG.MULTITAP NONE
		SYSTEM.CONFIG.MEMORYACCESSPORT 0.
		SYSTEM.CONFIG.AXIACCESSPORT 0.
		SYSTEM.CONFIG.DEBUGACCESSPORT 1.
		SYSTEM.CONFIG.JTAGACCESSPORT 2.
		SYSTEM.CONFIG.DAPIRPOST 16.
		SYSTEM.CONFIG.DAPDRPOST 2.
		SYSTEM.CONFIG.DAPIRPRE 0.
		SYSTEM.CONFIG.DAPDRPRE 0.
		SYSTEM.OPTION ENRESET OFF
		SYSTEM.OPTION CFLUSH OFF
		SYSTEM.CONFIG CTICONFIG			   CORTEXV1
		SYSTEM.CONFIG.FUNNELBASE	0X80055000	
	    SYSTEM.CONFIG.ETBBASE		0x80025000
		SYSTEM.CONFIG.FUNNEL2BASE	0x80026000
		SYSTEM.CONFIG.ETBFUNNELBASE	0x80023000
		SYSTEM.CONFIG.ETMETBFUNNELPORT	1.

		// Core Specific Setup	
		IF ("&ARG1"=="0")
		(
			SYSTEM.CONFIG COREBASE         0X80040000 
			SYSTEM.CONFIG ETMBASE          0X8004C000 
			SYSTEM.CONFIG ETMFUNNELPORT    0.
			SYSTEM.CONFIG.CTIBASE		   0X80051000
		)
		IF ("&ARG1"=="1")
		(

			SYSTEM.CONFIG COREBASE         0X80042000 
			SYSTEM.CONFIG ETMBASE          0X8004D000
			SYSTEM.CONFIG ETMFUNNELPORT    1.
			SYSTEM.CONFIG.CTIBASE		   0X80052000
		)
		IF ("&ARG1"=="2")
		(

			SYSTEM.CONFIG COREBASE         0X80044000 
			SYSTEM.CONFIG ETMBASE          0X8004E000 
			SYSTEM.CONFIG ETMFUNNELPORT    2.
			SYSTEM.CONFIG.CTIBASE		   0X80053000
		)
		IF ("&ARG1"=="3")
		(

			SYSTEM.CONFIG COREBASE         0X80046000 
			SYSTEM.CONFIG ETMBASE          0X8004F000 
			SYSTEM.CONFIG ETMFUNNELPORT    3.
			SYSTEM.CONFIG.CTIBASE		   0X80054000
		)
		IF ("&ARG1"=="mp2")
		(
			SYSTEM.CPU CORTEXA7MPCORE
			SYSTEM.CONFIG CORENUMBER	   2
			THREAD.ASSIGN 				   1. 2.
			SYSTEM.CONFIG COREBASE         0X80040000 0X80042000
			SYSTEM.CONFIG ETMBASE          0X8004C000 0x8004D000
			SYSTEM.CONFIG ETMFUNNELPORT    0. 1.
			SYSTEM.CONFIG.CTIBASE		   0X80051000 0X80052000
		)
		IF ("&ARG1"=="mp4")
		(
			SYSTEM.CPU CORTEXA7MPCORE
			SYSTEM.CONFIG CORENUMBER	   4
			THREAD.ASSIGN 				   1. 2. 3. 4.
			SYSTEM.CONFIG COREBASE         0X80040000 0X80042000 0X80044000 0X80046000
			SYSTEM.CONFIG ETMBASE          0X8004C000 0x8004D000 0x8004E000 0X8004F000 
			SYSTEM.CONFIG ETMFUNNELPORT    0. 1. 2. 3.
			SYSTEM.CONFIG.CTIBASE		   0X80051000 0X80052000 0X80053000 0X80054000
		)


		SYSTEM.MEMACCESS DAP
		TRONCHIP.SET FIQ OFF 
        TRONCHIP.SET IRQ OFF
	    TRONCHIP.SET DABORT OFF 
        TRONCHIP.SET PABORT OFF  
        TRONCHIP.SET UNDEF OFF
        TRONCHIP.SET SWI OFF 
        TRONCHIP.SET RESET OFF
		// Turn off ETM 
		ETM.OFF 
		
	)

	IF (("&ARG0"=="APQ8084")||("&ARG0"=="apq8084")||("&ARG0"=="MSM8962")||("&ARG0"=="msm8962")||("&ARG0"=="MPQ8092")||("&ARG0"=="mpq8092"))
	(
		SYSTEM.CPU KRAIT
		SYSTEM.CONFIG SLAVE ON
 
		SYSTEM.JTAGCLOCK 10.0MHZ
		SYSTEM.CONFIG.MULTITAP NONE
		SYSTEM.CONFIG.MEMORYACCESSPORT 0.
		SYSTEM.CONFIG.AXIACCESSPORT 0.
		SYSTEM.CONFIG.DEBUGACCESSPORT 1.
		SYSTEM.CONFIG.JTAGACCESSPORT 2.
		SYSTEM.CONFIG.DAPIRPOST 16.
		SYSTEM.CONFIG.DAPDRPOST 2.
		SYSTEM.CONFIG.DAPIRPRE 0.
		SYSTEM.CONFIG.DAPDRPRE 0.
		SYSTEM.OPTION ENRESET OFF
		SYSTEM.OPTION CFLUSH OFF
		SYSTEM.CONFIG CTICONFIG			   CORTEXV1
		;SYSTEM.CONFIG.FUNNELBASE	0X80055000	
		;SYSTEM.CONFIG.ETBBASE		0x80025000
		;SYSTEM.CONFIG.FUNNEL2BASE	0x80022000
		;SYSTEM.CONFIG.ETBFUNNELBASE	0x80023000
		;SYSTEM.CONFIG.ETMETBFUNNELPORT	3.

		// Core Specific Setup	
		IF ("&ARG1"=="0")
		(
			SYSTEM.CONFIG COREBASE         0X80040000 
			SYSTEM.CONFIG ETMBASE          0X8004C000 
			SYSTEM.CONFIG ETMFUNNELPORT    0.
			SYSTEM.CONFIG.CTIBASE		   0X80051000
		)
		IF ("&ARG1"=="1")
		(

			SYSTEM.CONFIG COREBASE         0X80042000 
			SYSTEM.CONFIG ETMBASE          0X8004D000
			SYSTEM.CONFIG ETMFUNNELPORT    1.
			SYSTEM.CONFIG.CTIBASE		   0X80052000
		)
		IF ("&ARG1"=="2")
		(

			SYSTEM.CONFIG COREBASE         0X80044000 
			SYSTEM.CONFIG ETMBASE          0X8004E000 
			SYSTEM.CONFIG ETMFUNNELPORT    2.
			SYSTEM.CONFIG.CTIBASE		   0X80053000
		)
		IF ("&ARG1"=="3")
		(

			SYSTEM.CONFIG COREBASE         0X80046000 
			SYSTEM.CONFIG ETMBASE          0X8004F000 
			SYSTEM.CONFIG ETMFUNNELPORT    3.
			SYSTEM.CONFIG.CTIBASE		   0X80054000
		)


		SYSTEM.MEMACCESS DAP
		TRONCHIP.SET FIQ OFF 
        TRONCHIP.SET IRQ OFF
	    TRONCHIP.SET DABORT OFF 
        TRONCHIP.SET PABORT OFF  
        TRONCHIP.SET UNDEF OFF
        TRONCHIP.SET SWI OFF 
        TRONCHIP.SET RESET OFF
		// Turn off ETM 
		ETM.OFF 
		
	)

	// Common settings for all chipsets
	IF (("&ARG2"=="SWD")||("&ARG2"=="swd"))
	(
		SYSTEM.CONFIG SWDP ON 
		SYSTEM.CONFIG DEBUGPORTTYPE SWD
	)

	// Launch startup scripts
	IF (OS.ENV(STARTUPCMM)!="")
	(
        &STARTUPSCRIPT=OS.ENV(STARTUPCMM)
	    do &STARTUPSCRIPT
	)

	GOTO EXIT

EXIT:
	ENDDO
