//============================================================================
//  Name:                                                                     
//    DAP_ADSP.cmm
//
//  Description:                                                              
//    Setup script for the Applications DSP Sub-system
//                                                                            
// Copyright (c) 2012 - 2014 by Qualcomm Technologies, Incorporated.  All Rights Reserved.        
//
//
//
//
//                      EDIT HISTORY FOR FILE
//  This section contains comments describing changes made to the module.
//  Notice that changes are listed in reverse chronological order.
//
// when       who     		what, where, why
// --------   ---     		---------------------------------------------------------
// 04/13/2013 AJCheriyan	Support for QDSS Gen 2
// 04/04/2013 AJCheriyan	Added SWD support
// 02/11/2013 AJCheriyan	Added 8x26 support
// 08/25/2012 AJCheriyan	Bumped up JTAG clock
// 08/08/2012 AJCheriyan	Updated Hexagon version for July 2012 version
// 07/10/2012 AJCheriyan    Created for B-family
//

// The script accepts two input arguments
// ARG0 - Chipset name
// ARG1 - Core number
// ARG2 - JTAG / SWD option
// Ideal case, the argument 'ARG0' would not have to be used
// as the parameters for a sub-system should be the same
// across the entire family of chipsets

ENTRY &ARG0 &ARG1 &ARG2

MAIN:

	IF (("&ARG0"=="MSM8974")||("&ARG0"=="msm8974"))
	(
		SYSTEM.CPU HEXAGONV5 
		SYSTEM.CONFIG SLAVE ON    

		SYSTEM.JTAGCLOCK 15.0MHZ

		SYSTEM.CONFIG.DAPIRPOST 16.
		SYSTEM.CONFIG.DAPDRPOST 2.
		SYSTEM.CONFIG.DAPIRPRE 0.
		SYSTEM.CONFIG.DAPDRPRE 0.
		SYSTEM.CONFIG.MEMORYACCESSPORT 0
		SYSTEM.CONFIG.DEBUGACCESSPORT 1
		SYSTEM.CONFIG.JTAGACCESSPORT 2
		SYSTEM.CONFIG.COREJTAGPORT 1

		MMU.TABLEWALK ON

	)

	IF (("&ARG0"=="MSM8X26")||("&ARG0"=="msm8x26")||("&ARG0"=="MSM8X10")||("&ARG0"=="msm8x10")||("&ARG0"=="APQ8084")||("&ARG0"=="apq8084")||("&ARG0"=="MSM8962")||("&ARG0"=="msm8962")||("&ARG0"=="MPQ8092")||("&ARG0"=="mpq8092"))
	(
		SYSTEM.CPU HEXAGONV5 
		SYSTEM.CONFIG SLAVE ON    

		SYSTEM.JTAGCLOCK 15.0MHZ
		SYSTEM.CONFIG.DAPIRPOST 16.
		SYSTEM.CONFIG.DAPDRPOST 2.
		SYSTEM.CONFIG.DAPIRPRE 0.
		SYSTEM.CONFIG.DAPDRPRE 0.
		SYSTEM.CONFIG.MEMORYACCESSPORT 0
		SYSTEM.CONFIG.AXIACCESSPORT 0
		SYSTEM.CONFIG.DEBUGACCESSPORT 1
		SYSTEM.CONFIG.JTAGACCESSPORT 2
		SYSTEM.CONFIG.COREJTAGPORT 1

		MMU.TABLEWALK ON
	)

	// Common settings for all chipsets
	IF (("&ARG2"=="SWD")||("&ARG2"=="swd"))
	(
		SYSTEM.CONFIG SWDP ON 
		SYSTEM.CONFIG DEBUGPORTTYPE SWD
	)

	// Launch startup scripts
	IF (OS.ENV(STARTUPCMM)!="")
	(
        &STARTUPSCRIPT=OS.ENV(STARTUPCMM)
	    do &STARTUPSCRIPT
	)

	GOTO EXIT

EXIT:
	ENDDO
