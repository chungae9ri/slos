//============================================================================
//  Name:                                                                     
//    DAP_RPM.cmm
//
//  Description:                                                              
//    Setup script for the RPM 
//                                                                            
// Copyright (c) 2012 - 2014 by Qualcomm Technologies, Incorporated.  All Rights Reserved.        
//
//
//
//
//                      EDIT HISTORY FOR FILE
//  This section contains comments describing changes made to the module.
//  Notice that changes are listed in reverse chronological order.
//
// when       who     		what, where, why
// --------   ---     		------------------------------------
// 11/21/2013 AJCheriyan    Update for Luxor
// 04/13/2013 AJCheriyan	Support for QDSS Gen 2
// 04/02/2013 AJCheriyan	Added SWD support
// 02/11/2013 AJCheriyan	Added 8x26 support
// 08/26/2012 AJCheriyan	Dropped JTAG clock down to 20 MHz
// 08/25/2012 AJCheriyan	Boosted JTAG clock speed
// 07/10/2012 AJCheriyan    Created for B-family
//

// The script accepts two input arguments
// ARG0 - Chipset name
// ARG1 - Core number
// Ideal case, the argument 'ARG0' would not have to be used
// as the parameters for a sub-system should be the same
// across the entire family of chipsets

ENTRY &ARG0 &ARG1 &ARG2

MAIN:
	IF (("&ARG0"=="MSM8974")||("&ARG0"=="msm8974"))
	(
		SYSTEM.CPU CORTEXM3
		SYSTEM.OPTION ENRESET ON
		SYSTEM.JTAGCLOCK 15.0MHZ 
		SYSTEM.OPTION RESBREAK OFF
		SYSTEM.CONFIG SLAVE OFF
		SYSTEM.CONFIG MEMORYACCESSPORT 3.
		SYSTEM.CONFIG DEBUGACCESSPORT 1. 
		SYSTEM.MEMACCESS DAP
		SYSTEM.CONFIG DAPIRPOST 16.
		SYSTEM.CONFIG DAPDRPOST 2.
		SYSTEM.CONFIG DAPIRPRE 0.
		SYSTEM.CONFIG DAPDRPRE 0.
		SYSTEM.OPTION RESBREAK ON
		SYSTEM.OPTION WAITRESET 3ms
	)

	IF (("&ARG0"=="MSM8X26")||("&ARG0"=="msm8x26"))
	(
		SYSTEM.CPU CORTEXM3
		SYSTEM.OPTION ENRESET ON
		SYSTEM.JTAGCLOCK 15.0MHZ 
		SYSTEM.OPTION RESBREAK OFF
		SYSTEM.CONFIG SLAVE OFF
		SYSTEM.CONFIG MEMORYACCESSPORT 3.
		SYSTEM.CONFIG DEBUGACCESSPORT 1. 
		SYSTEM.CONFIG.DAPIRPOST 16.
		SYSTEM.CONFIG.DAPDRPOST 2.
		SYSTEM.CONFIG.DAPIRPRE 0.
		SYSTEM.CONFIG.DAPDRPRE 0.
		SYSTEM.MEMACCESS DAP
		SYSTEM.OPTION RESBREAK ON
		SYSTEM.OPTION WAITRESET 3ms
	)

	IF (("&ARG0"=="MSM8X10")||("&ARG0"=="msm8x10"))
	(
		SYSTEM.CPU CORTEXM3
		SYSTEM.OPTION ENRESET ON
		SYSTEM.JTAGCLOCK 15.0MHZ 
		SYSTEM.OPTION RESBREAK OFF
		SYSTEM.CONFIG SLAVE OFF
		SYSTEM.CONFIG MEMORYACCESSPORT 3.
		SYSTEM.CONFIG DEBUGACCESSPORT 1.
	    SYSTEM.CONFIG AXIACCESSPORT 0.	
		SYSTEM.CONFIG.DAPIRPOST 16.
		SYSTEM.CONFIG.DAPDRPOST 2.
		SYSTEM.CONFIG.DAPIRPRE 0.
		SYSTEM.CONFIG.DAPDRPRE 0.
		SYSTEM.MEMACCESS DAP
		SYSTEM.OPTION RESBREAK ON
		SYSTEM.OPTION WAITRESET 3ms
	)

	IF (("&ARG0"=="APQ8084")||("&ARG0"=="apq8084")||("&ARG0"=="MSM8962")||("&ARG0"=="msm8962")||("&ARG0"=="MPQ8092")||("&ARG0"=="mpq8092"))
	(
		SYSTEM.CPU CORTEXM3
		SYSTEM.OPTION ENRESET ON
		SYSTEM.JTAGCLOCK 10.0MHZ 
		SYSTEM.OPTION RESBREAK OFF
		SYSTEM.CONFIG SLAVE OFF
		SYSTEM.CONFIG MEMORYACCESSPORT 3.
		SYSTEM.CONFIG DEBUGACCESSPORT 1.
	    SYSTEM.CONFIG AXIACCESSPORT 0.	
		SYSTEM.CONFIG.DAPIRPOST 16.
		SYSTEM.CONFIG.DAPDRPOST 2.
		SYSTEM.CONFIG.DAPIRPRE 0.
		SYSTEM.CONFIG.DAPDRPRE 0.
		SYSTEM.MEMACCESS DAP
		SYSTEM.OPTION RESBREAK ON
		SYSTEM.OPTION WAITRESET 3ms
	)

	// Common settings for all chipsets
	IF (("&ARG2"=="SWD")||("&ARG2"=="swd"))
	(
		SYSTEM.CONFIG SWDP ON 
		SYSTEM.CONFIG DEBUGPORTTYPE SWD
	)

	// Launch startup scripts
	IF (OS.ENV(STARTUPCMM)!="")
	(
        &STARTUPSCRIPT=OS.ENV(STARTUPCMM)
	    do &STARTUPSCRIPT
	)
	
EXIT:
	ENDDO
