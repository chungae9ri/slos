//============================================================================
//  Name:                                                                     
//    std_loadsyms_sensors.cmm 
//
//  Description:                                                              
//    Script to load Sensors Image symbols. Part of ADSP build
//                                                                            
// Copyright (c) 2012 - 2014 by Qualcomm Technologies, Incorporated.  All Rights Reserved.        
//
//
//
//
//                      EDIT HISTORY FOR FILE
//  This section contains comments describing changes made to the module.
//  Notice that changes are listed in reverse chronological order.
//
// when       who     		what, where, why
// --------   ---     		---------------------------------------------------------
// 12/5/2012 AJCheriyan    Created for B-family 
//

// ARG0 - Build from which symbols have to loaded
//
ENTRY &ADSPBUILD 
LOCAL &ELFILE1 &ELFILE2 &DEVCFG_ELF &ADSP_BUILDMSDIR &PBNFILE &ADSP_COREDIR
MAIN:
	IF ("&ADSPBUILD"=="")
	(
	
	    PRINT "Point to the ADSP .elf file."
        DIALOG.FILE "&ADSPBUILDROOT/adsp_proc/build/ms/*SENSOR_reloc.elf"
        ENTRY &ELFILE1
        &DEVCFG_ELF=STRING.CUT("&ELFILE",-4)+"_DEVCFG.elf"
        &ADSP_BUILDMSDIR=OS.FILE.PATH(&ELFILE)
        &ADSP_COREDIR="&ADSP_BUILDMSDIR\..\..\core"
        &ADSP_BUILDROOT="&ADSP_BUILDMSDIR\..\..\.."
        &PBNFILE="&ADSP_BUILDMSDIR\bootimage.pbn"
		
		D.LOAD.ELF &ELFILE1  EAHB: /nocode /noclear /strippart "adsp_proc" /sourcepath "&ADSP_BUILDROOT/adsp_proc"
	)
	ELSE
	(
	
		PRINT "Point to the ADSP .elf file."
        DIALOG.FILE "&ADSPBUILD/adsp_proc/build/ms/*SENSOR_reloc.elf"
        ENTRY &ELFILE1
        &DEVCFG_ELF=STRING.CUT("&ELFILE",-4)+"_DEVCFG.elf"
        &ADSP_BUILDMSDIR=OS.FILE.PATH(&ELFILE)
        &ADSP_COREDIR="&ADSP_BUILDMSDIR\..\..\core"
        &ADSP_BUILDROOT="&ADSP_BUILDMSDIR\..\..\.."
        &PBNFILE="&ADSP_BUILDMSDIR\bootimage.pbn"
		
		D.LOAD.ELF &ELFILE1  EAHB: /nocode /noclear /strippart "adsp_proc" /sourcepath "&ADSP_BUILDROOT/adsp_proc"
	)

	GOTO EXIT

EXIT:
	ENDDO
