//============================================================================
//  Name:                                                                     
//    std_trace_adsp.cmm 
//
//  Description:                                                              
//    Trace setup script for ADSP
//                                                                            
// Copyright (c) 2012 - 2014 by Qualcomm Technologies, Incorporated.  All Rights Reserved.        
//
//
//
//
//                      EDIT HISTORY FOR FILE
//  This section contains comments describing changes made to the module.
//  Notice that changes are listed in reverse chronological order.
//
// when       who     		what, where, why
// --------   ---     		---------------------------------------------------------
// 09/28/2012 jbilling           Created for B-family.

// Following arguments are supported. 
// ARG0 - Processor to debug. 
// ARG1 - Tracing Type . Currently supports TPIU 
// ARGn - n > 1 - Any other arguments to be passed to the script 
ENTRY &ARG0 &ARG1 &ARG2 &ARG3 &ARG4 &ARG5

MAIN:

	IF (("&ARG1"=="TPIU")||("&ARG1"=="tpiu")||("&ARG1"=="SDCARD")||("&ARG1"=="SDcard")||("&ARG1"=="sdcard"))
	(

		SYStem.CONFIG.FUNNEL1.BASE DAP:0x80021000
		SYStem.CONFIG.FUNNEL1.ATBSource ETM.1 ETM.2
		SYStem.CONFIG.FUNNEL2.BASE DAP:0x80022000
		SYStem.CONFIG.FUNNEL3.BASE DAP:0x80023000
		SYStem.CONFIG.FUNNEL3.ATBSource FUNNEL1 0 FUNNEL2 1
        
		SYStem.CONFIG.ETF.BASE DAP:0x80007000
        SYStem.CONFIG.ETB.BASE DAP:0x80025000
        
		SYStem.CONFIG.ETF.ATBSource FUNNEL3
		SYStem.CONFIG.TPIU.BASE DAP:0x80018000
		SYStem.CONFIG.TPIU.ATBSource ETF

		//Reset ETM
		etm.reset
        //set portsize. 
        
		IF (("&ARG2"=="4bit")||("&ARG3"=="4bit"))
        (
            ETM.PORTSIZE 8.
            area
            print " "
            print "Portsize of 4 not yet supported on Q6 for this version of T32. "
            print "Note - therefore tracing will not work with TPIU over SDCC2"
	    print "Please re-run script using TPIU command, as SDcard did not configure TLMM (needed for TPIU port)"
            print "Setting Portsize to 8"
        )
        ELSE IF (("&ARG2"=="8bit")||("&ARG3"=="8bit")) 
        (
            ETM.PORTSIZE 8.
            print "Configurtion Portsize to 8"
        )
        ELSE IF (("&ARG2"=="16bit")||("&ARG3"=="16bit"))
        (
            ETM.PORTSIZE 16.
            print "Configurtion Portsize to 16"
        )
        ELSE                       
        (
            ETM.PORTSIZE 8.
            print "Configurtion Portsize to 8"
        )
        
        
        IF (("&ARG2"=="CYCLEACCURATE")||("&ARG2"=="cycleaccurate")||("&ARG3"=="cycleaccurate")||("&ARG3"=="cycleaccurate"))
        (
            etm.cycleaccurate on
        )
        
		etm.traceid 11.
		etm.portmode bypass
		ETM.ON
		ETM.CLEAR
		etm.stall OFF

		trace.init 
		trace.list
		
				
		TRACE.METHOD ANALYZER
		TRACE.CLOCK 10.MHz
		TRACE.AUTOFOCUS
	)
	ELSE (("&ARG1"=="ETB")||("&ARG1"=="etb"))
	(
        SYStem.CONFIG.FUNNEL1.BASE DAP:0x80021000
        SYStem.CONFIG.FUNNEL2.BASE DAP:0x80022000
        SYStem.CONFIG.FUNNEL3.BASE DAP:0x80023000
        SYStem.CONFIG.ETB.BASE DAP:0x80025000

        SYStem.CONFIG.FUNNEL1.ATBSource ETM 2
        SYStem.CONFIG.FUNNEL3.ATBSource FUNNEL1 0
        SYStem.CONFIG.ETB.ATBSource FUNNEL3
         
        ;SYStem.CONFIG.ETF.BASE DAP:0x80007000
        ;SYStem.CONFIG.TPIU.BASE DAP:0x80018000
        ;SYStem.CONFIG.TPIU.ATBSource ETF
        ;SYS.MODE ATTACH

        etm.reset
        etm.portsize 8.
        etm.traceid 10.
        etm.portmode bypass
        etm.stall OFF
        etm.on
        etm.clear
        trace.method ONCHIP
        trace.clock 10.MHz
        trace.init 
        trace.list
        ;trace.AutoFocus

	)

	


	GOTO EXIT


FATALEXIT:
	END

EXIT:
	ENDDO

