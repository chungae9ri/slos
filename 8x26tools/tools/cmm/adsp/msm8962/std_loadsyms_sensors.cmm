//============================================================================
//  Name:                                                                     
//    std_loadsyms_sensors.cmm 
//
//  Description:                                                              
//    Script to load Sensors Image symbols. Part of ADSP build
//                                                                            
// Copyright (c) 2012 - 2014 by Qualcomm Technologies, Incorporated.  All Rights Reserved.        
//
//
//
//
//                      EDIT HISTORY FOR FILE
//  This section contains comments describing changes made to the module.
//  Notice that changes are listed in reverse chronological order.
//
// when       who     		what, where, why
// --------   ---     		---------------------------------------------------------
// 12/5/2012 AJCheriyan    Created for B-family 
//

// ARG0 - Build from which symbols have to loaded
//
ENTRY &ADSPBUILD 

MAIN:
	IF ("&ADSPBUILD"=="")
	(
		D.LOAD.ELF "&ADSP_BUILDROOT/adsp_proc/build/ms/*_reloc.elf" /nocode /noreg /noclear /strippart "adsp_proc" /sourcepath "&ADSP_BUILDROOT/adsp_proc"
	)
	ELSE
	(
		D.LOAD.ELF "&ADSPBUILD/adsp_proc/build/ms/*_reloc.elf" /nocode /noreg /noclear /strippart "adsp_proc" /sourcepath "&ADSPBUILD/adsp_proc"
	)

	GOTO EXIT

EXIT:
	ENDDO
