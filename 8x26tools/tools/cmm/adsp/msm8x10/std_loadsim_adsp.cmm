//============================================================================
//  Name:                                                                     
//    std_loadsim_adsp.cmm 
//
//  Description:                                                              
//    Script to load ADSP logs
//                                                                            
// Copyright (c) 2012 - 2014 by Qualcomm Technologies, Incorporated.  All Rights Reserved.        
//
//
//
//
//                      EDIT HISTORY FOR FILE
//  This section contains comments describing changes made to the module.
//  Notice that changes are listed in reverse chronological order.
//
// when       who     		what, where, why
// --------   ---     		---------------------------------------------------------
// 09/06/2012 AJCheriyan	Added USB RAM dump support
// 08/21/2012 AJCheriyan	Fixed references to mpss roots
// 07/10/2012 AJCheriyan    Created for B-family 
//

// We support the following arguments
// ARG0 - Chipset Name. Can be used to setup sub-system according to target if needed 
// Using this argument should be avoided unless absolutely necessary
// ARG1 - LOGTYPE 
// ARG2 - BUILD
// ARG3 - LOGLOCATION
//

ENTRY &ARG0 &ARG1 &ARG2 &ARG3

LOCAL &LOGTYPE &BUILD &LOGLOCATION
MAIN:
	&LOGTYPE="&ARG1"
	&BUILD="&ARG2"
	&LOGLOCATION="&ARG3"

	// Load the memory map
	do std_memorymap

	// Setup the environment
	do std_setupenv

	// First, all the sanity checks
	GOSUB CHECKBINARIES
	
	// Binaries look good. Else, we wouldn't be here	
	GOSUB SETUPSIM
	
	// Load the binaries
	GOSUB LOADBIN

	// Load the symbols
	do std_loadsyms_adsp &BUILD

	// Load the "state" at the time of the crash
	GOSUB RESTORESTATE

	// Off you go..
	GOTO EXIT

// Set the simulator for the processor we want
SETUPSIM:
	SYS.CPU HEXAGONV5
	SYS.UP
	
	// Other configuration options
	FRAME.CONFIG.EPILOG OFF

	RETURN

// Checks if the binaries for the system are present in the location
// Loglocation should not be empty and assumes memory map is loaded
CHECKBINARIES:
LOCAL &FILE1 &FILE2 &LOGCLASS


	// This is the best place to determine the type of the log too
	IF ("&LOGTYPE"=="AUTODETECT")
	(
	    &LOGCLASS="&LOGTYPE"
		
		do std_utils FILEXIST EXIT &LOGLOCATION &ADSP_SW_log
		ENTRY &FILE1
		//do std_utils FILEXIST EXIT &LOGLOCATION &MPSS_EFS_log
		//ENTRY &FILE1

	    IF ("&FILE1"=="TRUE")
		(
		     &LOGCLASS="JTAG"
	    )

		// Check for USB logs
		do std_utils FILEXIST EXIT &LOGLOCATION &DDR_1_USB_log
		ENTRY &FILE1

		IF ("&FILE1"=="TRUE")
		(
			&LOGCLASS="USB"
		)

		// If we even after that, we are stuck with "AUTODETECT" we have a problem
		IF ("&LOGCLASS"=="AUTODETECT")
		(
		    PRINT %%ERROR "Neither USB nor JTAG logs present in folder: &LOGLOCATION"
		    GOTO FATALEXIT
		)
		ELSE
		(
		    // Safe to change the logtype
			&LOGTYPE="&LOGCLASS"
			PRINT "Detected &LOGTYPE logs in folder: &LOGLOCATION"
		)
	)
			
	IF ("&LOGTYPE"=="JTAG")
	(
		
		// Check for JTAG logs
		do std_utils FILEXIST EXIT &LOGLOCATION &ADSP_SW_log
		ENTRY &FILE1

	    IF ("&FILE1"=="FALSE")
		(
			PRINT %ERROR "JTAG ADSP logs not present in folder: &LOGLOCATION"
			GOTO FATALEXIT
	    )

		// Check for Shared IMEM logs
		do std_utils FILEXIST EXIT &LOGLOCATION &SHARED_IMEM_log
		ENTRY &FILE1

	    IF ("&FILE1"=="FALSE")
		(
			PRINT %ERROR "JTAG Shared IMEM logs not present in folder: &LOGLOCATION"
			GOTO FATALEXIT
	    )

	)

	IF ("&LOGTYPE"=="USB")
	(
		
		// Check for USB logs
		do std_utils FILEXIST EXIT &LOGLOCATION &DDR_1_USB_log
		ENTRY &FILE1

	    IF ("&FILE1"=="FALSE")
		(
			PRINT %ERROR "USB ADSP logs not present in folder: &LOGLOCATION"
			GOTO FATALEXIT
	    )

		// Check for USB logs
		do std_utils FILEXIST EXIT &LOGLOCATION &MSGRAM_USB_log
		ENTRY &FILE1
		do std_utils FILEXIST EXIT &LOGLOCATION &OCIMEM_USB_log
		ENTRY &FILE2

	    IF ("&FILE1"=="FALSE")&&("&FILE2"=="FALSE")
		(
			PRINT %ERROR "USB Shared IMEM logs not present in folder: &LOGLOCATION"
			GOTO FATALEXIT
	    )
	)

	RETURN


// Function :LOADBIN
// Loads the saved binaries
LOADBIN:
	
	IF ("&LOGTYPE"=="JTAG")
	(
		do std_utils LOADBIN &LOGLOCATION &SHARED_IMEM_log &SHARED_IMEM_start
		
		// Load the memory map again for relocated images
		do std_memorymap
		
		// Now load the logs
		do std_utils LOADBIN &LOGLOCATION &ADSP_SW_log &ADSP_SW_start
	)
	
	IF ("&LOGTYPE"=="USB")
	(
		// Load the shared IMEM logs
	 	do std_utils LOADBIN &LOGLOCATION &OCIMEM_USB_log &OCIMEM_start
		do std_utils LOADBIN &LOGLOCATION &MSGRAM_USB_log &MSGRAM_start
		
		// Load the memory map again for relocated images
		do std_memorymap

		do std_utils LOADBIN &LOGLOCATION &DDR_1_USB_log &DDR_1_start
	)
	
	RETURN

// Function: RESTORESTATE
// To load the error information from the saved logs
RESTORESTATE:
	// Restore the registers from file if JTAG logs
	IF ("&LOGTYPE"=="JTAG")
	(
	    THREAD 0
	 	do std_utils EXECUTESCRIPT EXIT &LOGLOCATION/&ADSP_Thread0_regs
		THREAD 1
		do std_utils EXECUTESCRIPT EXIT &LOGLOCATION/&ADSP_Thread1_regs
		THREAD 2
		do std_utils EXECUTESCRIPT EXIT &LOGLOCATION/&ADSP_Thread2_regs
	)

	// Symbols should be loaded prior to this step
	IF ("&LOGTYPE"=="USB")
	(
		do std_utils EXECUTESCRIPT EXIT &ADSP_SCRIPTSDIR/../debugtools/err/cmm/load_coredump.cmm
	)

	RETURN

FATALEXIT:
	END

EXIT:
	ENDDO



