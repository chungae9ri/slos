//============================================================================
//  Name:                                                                     
//    std_loadsyms_adsp.cmm 
//
//  Description:                                                              
//    Script to load ADSP symbols
//                                                                            
// Copyright (c) 2012 - 2014 by Qualcomm Technologies, Incorporated.  All Rights Reserved.        
//
//
//
//
//                      EDIT HISTORY FOR FILE
//  This section contains comments describing changes made to the module.
//  Notice that changes are listed in reverse chronological order.
//
// when       who     		what, where, why
// --------   ---     		---------------------------------------------------------
// 07/03/2013 AJCheriyan        Removed breakpoints
// 09/10/2012 AJCheriyan	Added call to setup breakpoints while loading symbols, option for simulator
// 07/10/2012 AJCheriyan    Created for B-family 
//

// ARG0 - Build from which symbols have to loaded
//
//
LOCAL &ELFILE1 &ELFILE2 &DEVCFG_ELF &ADSP_BUILDMSDIR &ADSP_BUILDROOT &PBNFILE &ADSP_COREDIR
ENTRY &ADSPBUILD &noattach &ADSP_SW_start_given &ADSP_SW_size_given

MAIN:

	// If a build is not provided, we assume the meta build has provided everything and use that
	// information. 
	// Load the elf file first. 
	IF (("&ADSPBUILD"=="")||"&ADSPBUILD"=="NONE")
	(
        
        PRINT "Point to the ADSP .elf file."
        DIALOG.FILE "&ADSPBUILD/adsp_proc/build/ms/*_reloc.elf"
        ENTRY &ELFILE1
        &DEVCFG_ELF=STRING.CUT("&ELFILE",-4)+"_DEVCFG.elf"
        &ADSP_BUILDMSDIR=OS.FILE.PATH(&ELFILE)
        &ADSP_COREDIR="&ADSP_BUILDMSDIR\..\..\core"
        &ADSP_BUILDROOT="&ADSP_BUILDMSDIR\..\..\.."
        &PBNFILE="&ADSP_BUILDMSDIR\bootimage.pbn"
            
		IF ("&ADSPBUILD"=="NONE")
		(

			D.LOAD.ELF &ELFILE1  EAHB: /nocode /noclear /strippart "adsp_proc" /sourcepath "&ADSP_BUILDROOT/adsp_proc"
		)
		ELSE
		(
			D.LOAD.ELF &ELFILE1  EAHB: /nocode /strippart "adsp_proc" /sourcepath "&ADSP_BUILDROOT/adsp_proc"
		)

	    // Load anything else from the build
	    // Load the relative path info for the build
    	do std_utils EXECUTESCRIPT EXIT &ADSP_BUILDROOT/adsp_proc/core/products/scripts/std_toolsconfig.cmm
		
		// Program the menus for general debugging
		do std_utils EXECUTESCRIPT EXIT &ADSP_BUILDROOT/adsp_proc/core/products/scripts/std_scripts.men
		
		// Load the extensions for the system
    	do std_utils EXECUTESCRIPT EXIT &ADSP_BUILDROOT/adsp_proc/core/products/scripts/std_extensions.cmm

	)
	ELSE
	(
		D.LOAD.ELF "&ADSPBUILD/adsp_proc/build/ms/*.elf"  EAHB: /nocode /strippart "adsp_proc" /sourcepath "&ADSPBUILD/adsp_proc"
		//because qurt source mappings are different
		y.spath.srd ++ "&ADSPBUILD/adsp_proc/core/kernel/qurt"

		// Load the relative path info for the build
	    	do std_utils EXECUTESCRIPT EXIT &ADSPBUILD/adsp_proc/core/products/scripts/std_toolsconfig.cmm
		
		// Program the menus for general debugging
		do std_utils EXECUTESCRIPT EXIT &ADSPBUILD/adsp_proc/core/products/scripts/std_scripts.men
		
		// Load the extensions for the system
	    do std_utils EXECUTESCRIPT EXIT &ADSPBUILD/adsp_proc/core/products/scripts/std_extensions.cmm
	)

	// Setup MMU
	GOSUB SETUPMMU

	// Done
	GOTO EXIT


// Sub-routine to setup the MMU
SETUPMMU:
	LOCAL &MEMMAP_PHY &MEMMAP_VIRT &MEMMAP_SIZE

	// We need to get the start address of the ADSP image from
	// the memory map, unless it was given to us.
    IF ("&noattach"=="noattach")
    (
        do std_memorymap noattach
        &ADSP_SW_start=&ADSP_SW_start_given
        &ADSP_SW_size=&ADSP_SW_size_given
        &ADSP_SW_end=&ADSP_SW_start+&ADSP_SW_size-1
        RETURN
    )
    ELSE
    (

		&MEMMAP_VIRT=ADDRESS.OFFSET(start)
		&MEMMAP_PHY=&ADSP_SW_start

		// Now setup the page tables
		IF Y.EXIST(QURTK_pagetables)
		(
                   
                    TRANSlation.OFF
                    TRANSlation.RESet
                    &pagetables=d.l(QURTK_pagetables)
                    MMU.FORMAT QURT &pagetables &MEMMAP_VIRT++&ADSP_SW_size &MEMMAP_PHY
                    TRANSlation.TableWalk.ON
                    TRANSlation.on

		)
		ELSE
		(
			PRINT %ERROR "Could not locate kernel page tables"
		)
	)

	RETURN
		
// Sub-routine to setup MMU
SETUPBREAKPOINTS:

	IF (Y.EXIST(QURTK_handle_error))
	(
		BREAK.SET QURTK_handle_error
	)
	IF (Y.EXIST(QURTK_tlb_crash))
	(
		BREAK.SET QURTK_tlb_crash
	)
	IF (Y.EXIST(QURTK_error))
	(
		BREAK.SET QURTK_error
	)
	IF (Y.EXIST(QURTK_handle_nmi))
	(
		BREAK.SET QURTK_handle_nmi
	)
	IF (Y.EXIST(err_fatal_jettison_core))
	(
		BREAK.SET err_fatal_jettison_core
	)	

	RETURN


FATALEXIT:
    END

EXIT:
    ENDDO






