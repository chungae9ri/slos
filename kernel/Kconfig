## kernel/Kconfig
```kconfig
menu "Main Menu"

config SOC_ZYNQ7000
    bool "SOC is zynq7000"

config SOC_ZYNQMP
    bool "SOC is zynqmp"
endmenu

if SOC_ZYNQ7000
    source "arch/ca-9/Kconfig"
endif

if SOC_ZYNQMP
    source "arch/ca-53/Kconfig"
endif
```

## kernel/arch/ca-53/Kconfig
```kconfig
menu "CA53 Arch"

config ARCH_CORTEX_A53
    bool "Cortex-A53 architecture"
    default y
    help
        Cortex-A53 architecture

endmenu
```

## kernel/arch/ca-9/Kconfig
```kconfig
menu "CA9 Arch"

config ARCH_CORTEX_A9
    bool "Cortex-A9 architecture"
    default y
    help
        Cortex-A9 architecture
        
endmenu
```
