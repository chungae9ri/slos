// SPDX-License-Identifier: MIT OR Apache-2.0
//
// Copyright (c) 2024 kwangdo.yi<kwangdo.yi@gmail.com>

/dts-v1/;

#include "zynq-7000.dtsi"

/ {
	dma@43c10000 {
		compatible = "slos,modcore-dma";
		reg = <0x43c10000 0x100>;
		interrupts = <61 4>;
	};

	odev@43c00000 {
		compatible = "slos,odev";
		reg = <0x43c00000 0x100>;
		interrupts = <62 4>;
	};
};

